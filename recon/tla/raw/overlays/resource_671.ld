SECTIONS
{
    .text 0x2008000 :
    {
        "*/games/tla/src/scene/gabomba_statue/entry.o"(.text)
        "*/games/tla/src/field/object/set_sprite_priority.o"(.text)
        "*/games/tla/src/field/field_effect/move.o"(.text)
        "*/games/tla/src/scene/gabomba_statue/s00b8.o"(.text)
        "*/games/tla/src/scene/gabomba_statue/wander.o"(.text)
        "*/games/tla/src/scene/gabomba_statue/scene_tables.o"(.text)
        "*/games/tla/src/scene/gabomba_statue/s02dc.o"(.text)
        "*/games/tla/src/scene/gabomba_statue/exits.o"(.text)
        "*/games/tla/src/scene/gabomba_statue/orbit.o"(.text)
        "*/games/tla/src/scene/gabomba_statue/s047c.o"(.text)
        "*/games/tla/src/scene/gabomba_statue/s04b8.o"(.text)
        "*/games/tla/src/scene/gabomba_statue/find_near.o"(.text)
        "*/resource_671_overlay.o"(.text.x02008624)
        "*/games/tla/src/scene/gabomba_statue/hop.o"(.text)
        "*/games/tla/src/scene/gabomba_statue/s0740.o"(.text)
        "*/games/tla/src/scene/gabomba_statue/s0784.o"(.text)
        "*/games/tla/src/scene/gabomba_statue/s0978.o"(.text)
        "*/games/tla/src/scene/gabomba_statue/s0a20.o"(.text)
        "*/games/tla/src/scene/gabomba_statue/s0ad4.o"(.text)
        "*/games/tla/src/scene/gabomba_statue/push.o"(.text)
        "*/games/tla/src/scene/gabomba_statue/setup.o"(.text)
        "*/games/tla/src/scene/gabomba_statue/s1124.o"(.text)
        "*/games/tla/src/scene/gabomba_statue/s11bc.o"(.text)
        "*/games/tla/src/scene/gabomba_statue/warp.o"(.text)
        "*/games/tla/src/scene/gabomba_statue/s1630.o"(.text)
        "*/games/tla/src/scene/gabomba_statue/s1728.o"(.text)
        "*/games/tla/src/scene/gabomba_statue/slide.o"(.text)
        "*/games/tla/src/scene/gabomba_statue/s18ec.o"(.text)
        "*/games/tla/src/scene/gabomba_statue/gate.o"(.text)
        "*/games/tla/src/scene/gabomba_statue/s1950.o"(.text)
        "*/games/tla/src/scene/gabomba_statue/gate_timer.o"(.text)
        "*/games/tla/src/scene/gabomba_statue/s19d0.o"(.text)
        "*/games/tla/src/scene/gabomba_statue/statue.o"(.text)
        "*/games/tla/src/scene/gabomba_statue/s1c10.o"(.text)
        "*/games/tla/src/scene/gabomba_statue/s2074.o"(.text)
        "*/games/tla/src/scene/gabomba_statue/s20b0.o"(.text)
        "*/games/tla/src/scene/gabomba_statue/s20f0.o"(.text)
        "*/games/tla/src/scene/gabomba_statue/s22d0.o"(.text)
        "*/games/tla/src/field/field_effect/advance_motion.o"(.text)
        "*/games/tla/src/scene/gabomba_statue/s2394.o"(.text)
        "*/games/tla/src/scene/gabomba_statue/s253c.o"(.text)
        "*/games/tla/src/scene/gabomba_statue/s2a64.o"(.text)
        "*/games/tla/src/scene/gabomba_statue/gabomba.o"(.text)
        "*/games/tla/src/scene/gabomba_statue/s3398.o"(.text)
        "*/games/tla/src/scene/gabomba_statue/s3494.o"(.text)
        "*/games/tla/src/scene/gabomba_statue/statue_init.o"(.text)
        "*/games/tla/src/scene/gabomba_statue/s359c.o"(.text)
        "*/games/tla/src/scene/gabomba_statue/s35f0.o"(.text)
        "*/games/tla/src/scene/gabomba_statue/owner_sum.o"(.text)
        "*/games/tla/src/scene/gabomba_statue/s3634.o"(.text)
        "*/games/tla/src/scene/gabomba_statue/leader_flags.o"(.text)
        "*/games/tla/src/scene/gabomba_statue/s38ac.o"(.text)
        "*/games/tla/src/scene/gabomba_statue/cell_grid.o"(.text)
        "*/games/tla/src/scene/gabomba_statue/s3974.o"(.text)
        "*/games/tla/src/scene/gabomba_statue/s3a64.o"(.text)
        "*/games/tla/src/scene/gabomba_statue/s3fc0.o"(.text)
        "*/games/tla/src/scene/gabomba_statue/puzzle_cells.o"(.text)
        "*/games/tla/src/scene/gabomba_statue/s4288.o"(.text)
        "*/games/tla/src/scene/gabomba_statue/puzzle_turn.o"(.text)
        "*/games/tla/src/scene/gabomba_statue/s43ec.o"(.text)
        "*/games/tla/src/scene/gabomba_statue/puzzle_mode.o"(.text)
        "*/games/tla/src/scene/gabomba_statue/s44d0.o"(.text)
        "*/games/tla/src/scene/gabomba_statue/s45d8.o"(.text)
        "*/games/tla/src/scene/gabomba_statue/s46c8.o"(.text)
        "*/games/tla/src/scene/gabomba_statue/s4710.o"(.text)
        "*/games/tla/src/scene/gabomba_statue/s48a4.o"(.text)
        "*/resource_671_overlay.o"(.text.x0200c938)
        "*/resource_671_overlay.o"(.text.x0200cd48)
        "*/games/tla/src/scene/gabomba_statue/find_hole.o"(.text)
        "*/games/tla/src/scene/gabomba_statue/chime.o"(.text)
        "*/resource_671_overlay.o"(.text.x0200d090)
        "*/games/tla/src/scene/gabomba_statue/clock_count_down.o"(.text)
        "*/games/tla/src/scene/gabomba_statue/clock.o"(.text)
        "*/games/tla/src/scene/gabomba_statue/s53bc.o"(.text)
        "*/games/tla/src/scene/gabomba_statue/s5428.o"(.text)
        "*/games/tla/src/scene/gabomba_statue/s54ac.o"(.text)
        "*/games/tla/src/scene/gabomba_statue/import.o"(.text)
        "*/games/tla/src/scene/gabomba_statue/data.o"(.data)
        "*/games/tla/src/graphics/field/cached_a.o"(.rodata)
        "*/games/tla/src/scene/gabomba_statue/data2.o"(.data)
    }
    .bss : { "*/resource_671_overlay.o"(.bss) }
    /DISCARD/ : { *(.ARM.attributes) *(.comment) *(.note*) }
}
