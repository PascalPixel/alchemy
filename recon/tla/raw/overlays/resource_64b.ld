SECTIONS
{
    .text 0x2008000 :
    {
        "*/games/tla/src/scene/world_map/entry.o"(.text)
        "*/games/tla/src/scene/world_map/encounter.o"(.text)
        "*/games/tla/src/scene/world_map/scene_tables.o"(.text)
        "*/games/tla/src/scene/world_map/tile_sprite.o"(.text)
        "*/games/tla/src/scene/world_map/story_actor.o"(.text)
        "*/games/tla/src/scene/world_map/tile_sprite_b.o"(.text)
        "*/games/tla/src/scene/world_map/s03f8.o"(.text)
        "*/games/tla/src/scene/world_map/s050c.o"(.text)
        "*/games/tla/src/scene/world_map/s0574.o"(.text)
        "*/games/tla/src/scene/world_map/s06d0.o"(.text)
        "*/games/tla/src/scene/world_map/s0918.o"(.text)
        "*/games/tla/src/scene/world_map/s0994.o"(.text)
        "*/games/tla/src/scene/world_map/s0be0.o"(.text)
        "*/games/tla/src/scene/world_map/s0d1c.o"(.text)
        "*/games/tla/src/scene/world_map/tower_calls.o"(.text)
        "*/games/tla/src/scene/world_map/scene_events.o"(.text)
        "*/games/tla/src/scene/world_map/s0dc4.o"(.text)
        "*/games/tla/src/scene/world_map/prepare.o"(.text)
        "*/games/tla/src/scene/world_map/s12bc.o"(.text)
        "*/games/tla/src/scene/world_map/s1c5c.o"(.text)
        "*/resource_64b_overlay.o"(.text.x02009e34)
        "*/games/tla/src/scene/world_map/s2594.o"(.text)
        "*/games/tla/src/scene/world_map/s2618.o"(.text)
        "*/games/tla/src/scene/world_map/s2640.o"(.text)
        "*/games/tla/src/scene/world_map/s2698.o"(.text)
        "*/games/tla/src/scene/world_map/s28cc.o"(.text)
        "*/games/tla/src/scene/world_map/s29a4.o"(.text)
        "*/games/tla/src/scene/world_map/s2ab0.o"(.text)
        "*/games/tla/src/scene/world_map/s2e78.o"(.text)
        "*/games/tla/src/scene/world_map/s310c.o"(.text)
        "*/games/tla/src/scene/world_map/s3144.o"(.text)
        "*/games/tla/src/scene/world_map/twitch.o"(.text)
        "*/games/tla/src/scene/world_map/s343c.o"(.text)
        "*/games/tla/src/scene/world_map/s3490.o"(.text)
        "*/games/tla/src/scene/world_map/tile_sprite_c.o"(.text)
        "*/games/tla/src/scene/world_map/s3600.o"(.text)
        "*/games/tla/src/scene/world_map/s36a8.o"(.text)
        "*/games/tla/src/scene/world_map/s3960.o"(.text)
        "*/games/tla/src/scene/world_map/cell_index.o"(.text)
        "*/games/tla/src/scene/world_map/s39a8.o"(.text)
        "*/games/tla/src/scene/world_map/s39f4.o"(.text)
        "*/games/tla/src/scene/world_map/s3b38.o"(.text)
        "*/games/tla/src/scene/world_map/s3b70.o"(.text)
        "*/games/tla/src/scene/world_map/s3bb8.o"(.text)
        "*/games/tla/src/scene/world_map/s3bf0.o"(.text)
        "*/games/tla/src/scene/world_map/actor_call.o"(.text)
        "*/games/tla/src/scene/world_map/s3c50.o"(.text)
        "*/games/tla/src/scene/world_map/s3ca8.o"(.text)
        "*/games/tla/src/scene/world_map/s3d44.o"(.text)
        "*/games/tla/src/scene/world_map/s42e0.o"(.text)
        "*/games/tla/src/scene/world_map/s4500.o"(.text)
        "*/games/tla/src/scene/world_map/s4538.o"(.text)
        "*/games/tla/src/scene/world_map/cycle.o"(.text)
        "*/games/tla/src/scene/world_map/s4598.o"(.text)
        "*/games/tla/src/scene/world_map/s4634.o"(.text)
        "*/games/tla/src/scene/world_map/s4744.o"(.text)
        "*/games/tla/src/scene/world_map/s48f4.o"(.text)
        "*/games/tla/src/scene/world_map/s49bc.o"(.text)
        "*/games/tla/src/scene/world_map/release.o"(.text)
        "*/games/tla/src/scene/world_map/import.o"(.text)
        "*/games/tla/src/scene/world_map/data.o"(.data)
        "*/games/tla/src/graphics/world_map/story.o"(.rodata)
        "*/games/tla/src/graphics/world_map/storyb.o"(.rodata)
        "*/games/tla/src/graphics/world_map/storyc.o"(.rodata)
        "*/games/tla/src/scene/world_map/data2.o"(.data)
    }
    .bss : { "*/resource_64b_overlay.o"(.bss) }
    /DISCARD/ : { *(.ARM.attributes) *(.comment) *(.note*) }
}
