SECTIONS
{
    .text 0x2008000 :
    {
        "*/games/tla/src/scene/airs_rock/entry.o"(.text)
        "*/games/tla/src/field/object/set_sprite_priority.o"(.text)
        "*/games/tla/src/field/object/prepare_object.o"(.text)
        "*/games/tla/src/scene/airs_rock/s00d0.o"(.text)
        "*/games/tla/src/field/field_effect/move.o"(.text)
        "*/games/tla/src/scene/airs_rock/s015c.o"(.text)
        "*/games/tla/src/scene/airs_rock/s033c.o"(.text)
        "*/games/tla/src/field/object/wait_until_idle.o"(.text)
        "*/games/tla/src/scene/airs_rock/s03e8.o"(.text)
        "*/games/tla/src/scene/airs_rock/s0468.o"(.text)
        "*/games/tla/src/scene/airs_rock/scene_tables.o"(.text)
        "*/games/tla/src/scene/airs_rock/s04c0.o"(.text)
        "*/games/tla/src/scene/airs_rock/exits.o"(.text)
        "*/games/tla/src/scene/airs_rock/s0508.o"(.text)
        "*/games/tla/src/scene/airs_rock/s0548.o"(.text)
        "*/games/tla/src/scene/airs_rock/s0568.o"(.text)
        "*/games/tla/src/scene/airs_rock/s05ec.o"(.text)
        "*/games/tla/src/scene/airs_rock/s0620.o"(.text)
        "*/games/tla/src/scene/airs_rock/s06d4.o"(.text)
        "*/games/tla/src/scene/airs_rock/s0700.o"(.text)
        "*/games/tla/src/scene/airs_rock/s07e4.o"(.text)
        "*/games/tla/src/scene/airs_rock/s0824.o"(.text)
        "*/games/tla/src/scene/airs_rock/s0830.o"(.text)
        "*/games/tla/src/scene/airs_rock/s0840.o"(.text)
        "*/games/tla/src/scene/airs_rock/s092c.o"(.text)
        "*/games/tla/src/scene/airs_rock/s095c.o"(.text)
        "*/games/tla/src/scene/airs_rock/s0ef4.o"(.text)
        "*/games/tla/src/scene/airs_rock/s0f9c.o"(.text)
        "*/games/tla/src/scene/airs_rock/s1010.o"(.text)
        "*/games/tla/src/scene/airs_rock/s1560.o"(.text)
        "*/games/tla/src/scene/airs_rock/s18ac.o"(.text)
        "*/games/tla/src/scene/airs_rock/s18d8.o"(.text)
        "*/resource_663_overlay.o"(.text.x02009908)
        "*/games/tla/src/scene/airs_rock/s1b54.o"(.text)
        "*/games/tla/src/scene/airs_rock/s1ca4.o"(.text)
        "*/games/tla/src/scene/airs_rock/s1cc8.o"(.text)
        "*/games/tla/src/scene/airs_rock/s1da8.o"(.text)
        "*/games/tla/src/scene/airs_rock/s1dc4.o"(.text)
        "*/games/tla/src/scene/airs_rock/s1f7c.o"(.text)
        "*/games/tla/src/scene/airs_rock/s24b0.o"(.text)
        "*/games/tla/src/scene/airs_rock/s257c.o"(.text)
        "*/games/tla/src/scene/airs_rock/s26b8.o"(.text)
        "*/games/tla/src/scene/airs_rock/s2b88.o"(.text)
        "*/games/tla/src/scene/airs_rock/s2c24.o"(.text)
        "*/games/tla/src/scene/airs_rock/s2ca0.o"(.text)
        "*/games/tla/src/scene/airs_rock/s3a7c.o"(.text)
        "*/games/tla/src/scene/airs_rock/import.o"(.text)
        "*/games/tla/src/scene/airs_rock/data.o"(.data)
    }
    .bss : { "*/resource_663_overlay.o"(.bss) }
    /DISCARD/ : { *(.ARM.attributes) *(.comment) *(.note*) }
}
