SECTIONS
{
    .text 0x2008000 :
    {
        "*/games/tla/src/scene/aqua_rock/entry.o"(.text)
        "*/games/tla/src/field/object/set_sprite_priority.o"(.text)
        "*/games/tla/src/field/object/prepare_object.o"(.text)
        "*/games/tla/src/scene/aqua_rock/s00d0.o"(.text)
        "*/games/tla/src/field/field_effect/move.o"(.text)
        "*/games/tla/src/scene/aqua_rock/s015c.o"(.text)
        "*/games/tla/src/scene/aqua_rock/scene_tables.o"(.text)
        "*/games/tla/src/scene/aqua_rock/s0344.o"(.text)
        "*/games/tla/src/scene/aqua_rock/exits.o"(.text)
        "*/games/tla/src/scene/aqua_rock/s0384.o"(.text)
        "*/games/tla/src/scene/aqua_rock/s0468.o"(.text)
        "*/games/tla/src/scene/aqua_rock/events_a.o"(.text)
        "*/games/tla/src/scene/aqua_rock/s052c.o"(.text)
        "*/resource_67b_overlay.o"(.text.x02008580)
        "*/games/tla/src/scene/aqua_rock/s0740.o"(.text)
        "*/games/tla/src/scene/aqua_rock/s0844.o"(.text)
        "*/games/tla/src/scene/aqua_rock/events_b.o"(.text)
        "*/games/tla/src/scene/aqua_rock/s0b68.o"(.text)
        "*/games/tla/src/scene/aqua_rock/s0cd8.o"(.text)
        "*/games/tla/src/scene/aqua_rock/events_c.o"(.text)
        "*/games/tla/src/scene/aqua_rock/s0d80.o"(.text)
        "*/games/tla/src/scene/aqua_rock/s0f8c.o"(.text)
        "*/games/tla/src/scene/aqua_rock/s1010.o"(.text)
        "*/games/tla/src/scene/aqua_rock/events_d.o"(.text)
        "*/games/tla/src/scene/aqua_rock/s1224.o"(.text)
        "*/games/tla/src/scene/aqua_rock/events_e.o"(.text)
        "*/games/tla/src/scene/aqua_rock/s13f8.o"(.text)
        "*/games/tla/src/scene/aqua_rock/s1460.o"(.text)
        "*/games/tla/src/scene/aqua_rock/s153c.o"(.text)
        "*/games/tla/src/scene/aqua_rock/s15e8.o"(.text)
        "*/games/tla/src/scene/aqua_rock/events_f.o"(.text)
        "*/games/tla/src/scene/aqua_rock/s17f4.o"(.text)
        "*/games/tla/src/scene/aqua_rock/prepare.o"(.text)
        "*/games/tla/src/scene/aqua_rock/s1d30.o"(.text)
        "*/games/tla/src/scene/aqua_rock/events_g.o"(.text)
        "*/games/tla/src/scene/aqua_rock/s1e00.o"(.text)
        "*/games/tla/src/scene/aqua_rock/events_h.o"(.text)
        "*/games/tla/src/scene/aqua_rock/s1f90.o"(.text)
        "*/games/tla/src/scene/aqua_rock/s20bc.o"(.text)
        "*/resource_67b_overlay.o"(.text.x0200a250)
        "*/games/tla/src/scene/aqua_rock/s23c0.o"(.text)
        "*/games/tla/src/scene/aqua_rock/events_i.o"(.text)
        "*/games/tla/src/scene/aqua_rock/s2550.o"(.text)
        "*/games/tla/src/scene/aqua_rock/events_k.o"(.text)
        "*/games/tla/src/scene/aqua_rock/s25d4.o"(.text)
        "*/games/tla/src/scene/aqua_rock/s276c.o"(.text)
        "*/games/tla/src/scene/aqua_rock/events_j.o"(.text)
        "*/games/tla/src/scene/aqua_rock/import.o"(.text)
        "*/games/tla/src/scene/aqua_rock/data.o"(.data)
        "*/games/tla/src/scene/aqua_rock/tiles.o"(.rodata)
        "*/games/tla/src/scene/aqua_rock/data2.o"(.data)
        "*/games/tla/src/graphics/field/tiles679.o"(.rodata)
    }
    .bss : { "*/resource_67b_overlay.o"(.bss) }
    /DISCARD/ : { *(.ARM.attributes) *(.comment) *(.note*) }
}
