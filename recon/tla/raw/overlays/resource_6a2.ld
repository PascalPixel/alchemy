SECTIONS
{
    .text 0x2008000 :
    {
        "*/games/tla/src/scene/jupiter_lighthouse_room_9/entry.o"(.text)
        "*/recon/tla/raw/src/scene/jupiter_lighthouse_room_9/scene_tables.o"(.text)
        "*/games/tla/src/scene/jupiter_lighthouse_room_9/scene_events.o"(.text)
        "*/games/tla/src/scene/jupiter_lighthouse_room_9/prepare.o"(.text)
        "*/recon/tla/raw/src/scene/shared/scene_set_arrival_flags.o"(.text)
        "*/games/tla/src/scene/jupiter_lighthouse_room_9/lightflag.o"(.text)
        "*/recon/tla/raw/src/scene/jupiter_lighthouse_room_9/s03a4.o"(.text)
        "*/recon/tla/raw/src/scene/jupiter_lighthouse_room_9/lightset.o"(.text)
        "*/recon/tla/raw/src/scene/jupiter_lighthouse_room_9/s0538.o"(.text)
        "*/recon/tla/raw/src/scene/jupiter_lighthouse_room_9/dist.o"(.text)
        "*/recon/tla/raw/src/scene/jupiter_lighthouse_room_9/s0750.o"(.text)
        "*/recon/tla/raw/src/scene/jupiter_lighthouse_room_9/s0910.o"(.text)
        "*/recon/tla/raw/src/scene/jupiter_lighthouse_room_9/s09e8.o"(.text)
        "*/recon/tla/raw/src/scene/jupiter_lighthouse_room_9/s0a88.o"(.text)
        "*/recon/tla/raw/src/scene/jupiter_lighthouse_room_9/s0c18.o"(.text)
        "*/recon/tla/raw/src/scene/jupiter_lighthouse_room_9/light.o"(.text)
        "*/recon/tla/raw/src/scene/jupiter_lighthouse_room_9/lightcue.o"(.text)
        "*/games/tla/src/field/object/set_sprite_priority.o"(.text)
        "*/resource_6a2_overlay.o"(.text.x02008fde)
        "*/recon/tla/raw/src/field/field_effect/move.o"(.text)
        "*/resource_6a2_overlay.o"(.text.x02009016)
        "*/recon/tla/raw/src/scene/jupiter_lighthouse_room_9/s1018.o"(.text)
        "*/recon/tla/raw/src/scene/jupiter_lighthouse_room_9/s11e0.o"(.text)
        "*/recon/tla/raw/src/scene/jupiter_lighthouse_room_9/s130c.o"(.text)
        "*/recon/tla/raw/src/scene/jupiter_lighthouse_room_9/s1550.o"(.text)
        "*/recon/tla/raw/src/scene/jupiter_lighthouse_room_9/s1648.o"(.text)
        "*/recon/tla/raw/src/field/field_effect/advance_motion.o"(.text)
        "*/resource_6a2_overlay.o"(.text.x020097de)
        "*/recon/tla/raw/src/scene/jupiter_lighthouse_room_9/s17e0.o"(.text)
        "*/recon/tla/raw/src/scene/jupiter_lighthouse_room_9/s1978.o"(.text)
        "*/recon/tla/raw/src/scene/jupiter_lighthouse_room_9/s1a28.o"(.text)
        "*/games/tla/src/scene/jupiter_lighthouse_room_9/import.o"(.text)
        "*/games/tla/src/graphics/field/cached_a.o"(.rodata)
        "*/games/tla/src/graphics/field/cached_b.o"(.rodata)
        "*/games/tla/src/graphics/field/cached_c.o"(.rodata)
        "*/games/tla/src/scene/jupiter_lighthouse_room_9/data.o"(.data)
    }
    .bss : { "*/resource_6a2_overlay.o"(.bss) }
    /DISCARD/ : { *(.ARM.attributes) *(.comment) *(.note*) }
}
