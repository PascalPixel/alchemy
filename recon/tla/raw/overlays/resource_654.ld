SECTIONS
{
    .text 0x2008000 :
    {
        "*/games/tla/src/scene/shrine_of_the_sea_god/entry.o"(.text)
        "*/games/tla/src/field/object/set_sprite_priority.o"(.text)
        "*/games/tla/src/field/field_effect/move.o"(.text)
        "*/games/tla/src/scene/shrine_of_the_sea_god/s00b8.o"(.text)
        "*/games/tla/src/scene/shrine_of_the_sea_god/event0.o"(.text)
        "*/games/tla/src/scene/shrine_of_the_sea_god/scene_tables.o"(.text)
        "*/games/tla/src/scene/shrine_of_the_sea_god/exits.o"(.text)
        "*/games/tla/src/scene/shrine_of_the_sea_god/event7.o"(.text)
        "*/games/tla/src/scene/shrine_of_the_sea_god/s0568.o"(.text)
        "*/games/tla/src/scene/shrine_of_the_sea_god/event9.o"(.text)
        "*/games/tla/src/scene/shrine_of_the_sea_god/s063c.o"(.text)
        "*/games/tla/src/scene/shrine_of_the_sea_god/s0688.o"(.text)
        "*/games/tla/src/scene/shrine_of_the_sea_god/s087c.o"(.text)
        "*/games/tla/src/scene/shrine_of_the_sea_god/eventa.o"(.text)
        "*/games/tla/src/scene/shrine_of_the_sea_god/s0994.o"(.text)
        "*/games/tla/src/scene/shrine_of_the_sea_god/event1.o"(.text)
        "*/games/tla/src/scene/shrine_of_the_sea_god/event2.o"(.text)
        "*/games/tla/src/field/field_effect/advance_motion.o"(.text)
        "*/games/tla/src/scene/shrine_of_the_sea_god/s1340.o"(.text)
        "*/games/tla/src/scene/shrine_of_the_sea_god/event3.o"(.text)
        "*/games/tla/src/scene/shrine_of_the_sea_god/s1474.o"(.text)
        "*/games/tla/src/scene/shrine_of_the_sea_god/event4.o"(.text)
        "*/games/tla/src/scene/shrine_of_the_sea_god/event5.o"(.text)
        "*/games/tla/src/scene/shrine_of_the_sea_god/event6.o"(.text)
        "*/games/tla/src/scene/shrine_of_the_sea_god/s1d24.o"(.text)
        "*/games/tla/src/scene/shrine_of_the_sea_god/eventb.o"(.text)
        "*/games/tla/src/scene/shrine_of_the_sea_god/eventc.o"(.text)
        "*/games/tla/src/scene/shrine_of_the_sea_god/s2d50.o"(.text)
        "*/games/tla/src/scene/shrine_of_the_sea_god/evente.o"(.text)
        "*/games/tla/src/scene/shrine_of_the_sea_god/eventf.o"(.text)
        "*/games/tla/src/scene/shrine_of_the_sea_god/s3598.o"(.text)
        "*/games/tla/src/scene/shrine_of_the_sea_god/eventg.o"(.text)
        "*/games/tla/src/scene/shrine_of_the_sea_god/import.o"(.text)
        "*/games/tla/src/scene/shrine_of_the_sea_god/data.o"(.data)
    }
    .bss : { "*/resource_654_overlay.o"(.bss) }
    /DISCARD/ : { *(.ARM.attributes) *(.comment) *(.note*) }
}
