SECTIONS
{
    .text 0x2008000 :
    {
        "*/games/tla/src/scene/staff_credit/entry.o"(.text)
        "*/games/tla/src/scene/staff_credit/scene_tables.o"(.text)
        "*/games/tla/src/scene/staff_credit/s005c.o"(.text)
        "*/games/tla/src/scene/staff_credit/s00c0.o"(.text)
        "*/resource_64c_overlay.o"(.text.x02008138)
        "*/recon/tla/raw/src/scene/staff_credit/s020c.o"(.text)
        "*/games/tla/src/scene/staff_credit/s0b64.o"(.text)
        "*/games/tla/src/scene/staff_credit/prepare.o"(.text)
        "*/games/tla/src/scene/staff_credit/s0cbc.o"(.text)
        "*/resource_64c_overlay.o"(.text.x02008d64)
        "*/games/tla/src/scene/staff_credit/s0fa0.o"(.text)
        "*/games/tla/src/scene/staff_credit/cell_index.o"(.text)
        "*/recon/tla/raw/src/scene/staff_credit/s1064.o"(.text)
        "*/games/tla/src/scene/staff_credit/s10b0.o"(.text)
        "*/games/tla/src/scene/staff_credit/flicker.o"(.text)
        "*/games/tla/src/scene/staff_credit/s122c.o"(.text)
        "*/games/tla/src/scene/staff_credit/s1274.o"(.text)
        "*/games/tla/src/scene/staff_credit/s12ac.o"(.text)
        "*/games/tla/src/scene/staff_credit/s12f8.o"(.text)
        "*/games/tla/src/scene/staff_credit/s130c.o"(.text)
        "*/games/tla/src/scene/staff_credit/s1364.o"(.text)
        "*/recon/tla/raw/src/scene/staff_credit/s1400.o"(.text)
        "*/games/tla/src/scene/staff_credit/cycle.o"(.text)
        "*/games/tla/src/scene/staff_credit/s19d4.o"(.text)
        "*/games/tla/src/scene/staff_credit/cycle_b.o"(.text)
        "*/recon/tla/raw/src/scene/staff_credit/s1a34.o"(.text)
        "*/resource_64c_overlay.o"(.text.x02009ad0)
        "*/games/tla/src/scene/staff_credit/s1be0.o"(.text)
        "*/recon/tla/raw/src/scene/staff_credit/s1d90.o"(.text)
        "*/games/tla/src/scene/staff_credit/release.o"(.text)
        "*/games/tla/src/scene/staff_credit/import.o"(.text)
        "*/games/tla/src/scene/staff_credit/graphics.o"(.rodata)
        "*/games/tla/src/scene/staff_credit/data.o"(.data)
        "*/games/tla/src/graphics/world_map/story.o"(.rodata)
        "*/games/tla/src/graphics/world_map/storyc.o"(.rodata)
        "*/games/tla/src/scene/staff_credit/data2.o"(.data)
    }
    .bss : { "*/resource_64c_overlay.o"(.bss) }
    /DISCARD/ : { *(.ARM.attributes) *(.comment) *(.note*) }
}
