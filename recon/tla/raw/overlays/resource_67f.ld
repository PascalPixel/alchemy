SECTIONS
{
    .text 0x2008000 :
    {
        "*/games/tla/src/scene/izumo_ruins/entry.o"(.text)
        "*/recon/tla/raw/src/scene/izumo_ruins/s0038.o"(.text)
        "*/recon/tla/raw/src/scene/izumo_ruins/s00a4.o"(.text)
        "*/games/tla/src/scene/izumo_ruins/s0128.o"(.text)
        "*/recon/tla/raw/src/scene/izumo_ruins/s01d0.o"(.text)
        "*/recon/tla/raw/src/scene/izumo_ruins/s02f8.o"(.text)
        "*/recon/tla/raw/src/scene/izumo_ruins/s048c.o"(.text)
        "*/games/tla/src/scene/izumo_ruins/s056c.o"(.text)
        "*/recon/tla/raw/src/scene/izumo_ruins/s0584.o"(.text)
        "*/games/tla/src/scene/izumo_ruins/s06ec.o"(.text)
        "*/recon/tla/raw/src/scene/izumo_ruins/s0708.o"(.text)
        "*/recon/tla/raw/src/field/field_effect/advance_motion_priority.o"(.text)
        "*/recon/tla/raw/src/scene/izumo_ruins/s0974.o"(.text)
        "*/recon/tla/raw/src/scene/izumo_ruins/s0aa8.o"(.text)
        "*/games/tla/src/scene/izumo_ruins/s0bc0.o"(.text)
        "*/games/tla/src/scene/izumo_ruins/s0c4c.o"(.text)
        "*/games/tla/src/field/object/set_sprite_priority.o"(.text)
        "*/resource_67f_overlay.o"(.text.x02008caa)
        "*/recon/tla/raw/src/field/field_effect/move.o"(.text)
        "*/resource_67f_overlay.o"(.text.x02008ce2)
        "*/recon/tla/raw/src/scene/izumo_ruins/s0ce4.o"(.text)
        "*/games/tla/src/scene/izumo_ruins/s0eac.o"(.text)
        "*/recon/tla/raw/src/scene/izumo_ruins/s0f30.o"(.text)
        "*/recon/tla/raw/src/scene/izumo_ruins/s100c.o"(.text)
        "*/games/tla/src/scene/izumo_ruins/scene_tables.o"(.text)
        "*/games/tla/src/scene/izumo_ruins/s1070.o"(.text)
        "*/games/tla/src/scene/izumo_ruins/exits.o"(.text)
        "*/recon/tla/raw/src/scene/izumo_ruins/s10b0.o"(.text)
        "*/recon/tla/raw/src/scene/izumo_ruins/s1148.o"(.text)
        "*/games/tla/src/scene/izumo_ruins/events.o"(.text)
        "*/recon/tla/raw/src/scene/izumo_ruins/s1228.o"(.text)
        "*/recon/tla/raw/src/scene/izumo_ruins/s12dc.o"(.text)
        "*/games/tla/src/scene/izumo_ruins/prepare.o"(.text)
        "*/games/tla/src/scene/izumo_ruins/import.o"(.text)
        "*/games/tla/src/scene/izumo_ruins/data.o"(.data)
    }
    /DISCARD/ : { *(.ARM.attributes) *(.comment) *(.note*) }
}
