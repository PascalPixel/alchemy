SECTIONS
{
    .text 0x2008000 :
    {
        "*/games/tla/src/scene/jupiter_lighthouse_room_3/entry.o"(.text)
        "*/games/tla/src/scene/jupiter_lighthouse_room_3/scene_tables.o"(.text)
        "*/games/tla/src/scene/jupiter_lighthouse_room_3/scene_events.o"(.text)
        "*/games/tla/src/scene/shared/scene_set_arrival_flags.o"(.text)
        "*/games/tla/src/scene/jupiter_lighthouse_room_3/events_a.o"(.text)
        "*/resource_69c_overlay.o"(.text.x02008404)
        "*/games/tla/src/scene/jupiter_lighthouse_room_3/lightset.o"(.text)
        "*/resource_69c_overlay.o"(.text.x02008598)
        "*/games/tla/src/scene/jupiter_lighthouse_room_3/events_b.o"(.text)
        "*/resource_69c_overlay.o"(.text.x020087b0)
        "*/resource_69c_overlay.o"(.text.x02008970)
        "*/games/tla/src/scene/jupiter_lighthouse_room_3/s0a48.o"(.text)
        "*/resource_69c_overlay.o"(.text.x02008ae8)
        "*/resource_69c_overlay.o"(.text.x02008c78)
        "*/games/tla/src/field/map/cellfill.o"(.text)
        "*/resource_69c_overlay.o"(.text.x02008dcc)
        "*/resource_69c_overlay.o"(.text.x02008f34)
        "*/resource_69c_overlay.o"(.text.x02009050)
        "*/games/tla/src/scene/jupiter_lighthouse_room_3/s1300.o"(.text)
        "*/resource_69c_overlay.o"(.text.x02009388)
        "*/games/tla/src/scene/jupiter_lighthouse_room_3/light.o"(.text)
        "*/games/tla/src/scene/jupiter_lighthouse_room_3/lightcue.o"(.text)
        "*/games/tla/src/field/object/set_sprite_priority.o"(.text)
        "*/games/tla/src/field/field_effect/move.o"(.text)
        "*/games/tla/src/scene/jupiter_lighthouse_room_3/s1788.o"(.text)
        "*/games/tla/src/scene/jupiter_lighthouse_room_3/s1950.o"(.text)
        "*/resource_69c_overlay.o"(.text.x02009a7c)
        "*/games/tla/src/scene/jupiter_lighthouse_room_3/s1cc0.o"(.text)
        "*/resource_69c_overlay.o"(.text.x02009db8)
        "*/games/tla/src/field/field_effect/advance_motion.o"(.text)
        "*/resource_69c_overlay.o"(.text.x02009f50)
        "*/resource_69c_overlay.o"(.text.x0200a0e8)
        "*/games/tla/src/scene/jupiter_lighthouse_room_3/s2198.o"(.text)
        "*/games/tla/src/scene/jupiter_lighthouse_room_3/import.o"(.text)
        "*/games/tla/src/scene/jupiter_lighthouse_room_3/data.o"(.data)
        "*/games/tla/src/graphics/field/cached_a.o"(.rodata)
        "*/games/tla/src/graphics/field/cached_b.o"(.rodata)
        "*/games/tla/src/graphics/field/cached_c.o"(.rodata)
        "*/games/tla/src/scene/jupiter_lighthouse_room_3/data2.o"(.data)
    }
    .bss : { "*/resource_69c_overlay.o"(.bss) }
    /DISCARD/ : { *(.ARM.attributes) *(.comment) *(.note*) }
}
