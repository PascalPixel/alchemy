SECTIONS
{
    .text 0x2008000 :
    {
        "*/games/tla/src/scene/jupiter_lighthouse_room_8/entry.o"(.text)
        "*/games/tla/src/scene/jupiter_lighthouse_room_8/scene_tables.o"(.text)
        "*/games/tla/src/scene/jupiter_lighthouse_room_8/s0054.o"(.text)
        "*/games/tla/src/scene/jupiter_lighthouse_room_8/s0094.o"(.text)
        "*/games/tla/src/scene/jupiter_lighthouse_room_8/scene_events.o"(.text)
        "*/games/tla/src/scene/jupiter_lighthouse_room_8/s0110.o"(.text)
        "*/games/tla/src/scene/jupiter_lighthouse_room_8/s01d4.o"(.text)
        "*/games/tla/src/scene/shared/scene_set_arrival_flags.o"(.text)
        "*/games/tla/src/scene/jupiter_lighthouse_room_8/s0270.o"(.text)
        "*/games/tla/src/scene/jupiter_lighthouse_room_8/s027c.o"(.text)
        "*/games/tla/src/scene/jupiter_lighthouse_room_8/lightset.o"(.text)
        "*/games/tla/src/scene/jupiter_lighthouse_room_8/s0410.o"(.text)
        "*/games/tla/src/scene/jupiter_lighthouse_room_8/dist.o"(.text)
        "*/games/tla/src/scene/jupiter_lighthouse_room_8/s0628.o"(.text)
        "*/games/tla/src/scene/jupiter_lighthouse_room_8/s07e8.o"(.text)
        "*/games/tla/src/scene/jupiter_lighthouse_room_8/s08c0.o"(.text)
        "*/games/tla/src/scene/jupiter_lighthouse_room_8/s0960.o"(.text)
        "*/resource_6a1_overlay.o"(.text.x02008af0)
        "*/games/tla/src/field/map/cellfill.o"(.text)
        "*/resource_6a1_overlay.o"(.text.x02008c44)
        "*/games/tla/src/scene/jupiter_lighthouse_room_8/s0dac.o"(.text)
        "*/games/tla/src/scene/jupiter_lighthouse_room_8/s0ec8.o"(.text)
        "*/resource_6a1_overlay.o"(.text.x02009178)
        "*/resource_6a1_overlay.o"(.text.x02009200)
        "*/games/tla/src/scene/jupiter_lighthouse_room_8/light.o"(.text)
        "*/games/tla/src/scene/jupiter_lighthouse_room_8/lightcue.o"(.text)
        "*/games/tla/src/field/object/set_sprite_priority.o"(.text)
        "*/resource_6a1_overlay.o"(.text.x020095c6)
        "*/games/tla/src/field/field_effect/move.o"(.text)
        "*/resource_6a1_overlay.o"(.text.x020095fe)
        "*/games/tla/src/scene/jupiter_lighthouse_room_8/s1600.o"(.text)
        "*/games/tla/src/scene/jupiter_lighthouse_room_8/s17c8.o"(.text)
        "*/games/tla/src/scene/jupiter_lighthouse_room_8/s18f4.o"(.text)
        "*/games/tla/src/scene/jupiter_lighthouse_room_8/s1b38.o"(.text)
        "*/games/tla/src/scene/jupiter_lighthouse_room_8/s1c30.o"(.text)
        "*/games/tla/src/field/field_effect/advance_motion.o"(.text)
        "*/resource_6a1_overlay.o"(.text.x02009dc6)
        "*/games/tla/src/scene/jupiter_lighthouse_room_8/s1dc8.o"(.text)
        "*/games/tla/src/scene/jupiter_lighthouse_room_8/s1f60.o"(.text)
        "*/games/tla/src/scene/jupiter_lighthouse_room_8/s2010.o"(.text)
        "*/games/tla/src/scene/jupiter_lighthouse_room_8/import.o"(.text)
        "*/games/tla/src/scene/jupiter_lighthouse_room_8/data.o"(.data)
        "*/games/tla/src/graphics/field/cached_a.o"(.rodata)
        "*/games/tla/src/graphics/field/cached_b.o"(.rodata)
        "*/games/tla/src/graphics/field/cached_c.o"(.rodata)
        "*/games/tla/src/scene/jupiter_lighthouse_room_8/data2.o"(.data)
    }
    .bss : { "*/resource_6a1_overlay.o"(.bss) }
    /DISCARD/ : { *(.ARM.attributes) *(.comment) *(.note*) }
}
