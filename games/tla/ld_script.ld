/* The Lost Age, all six editions: the one linker script, run through the C
   preprocessor with -DTLA_EDITION_<LANG>=1 as the C is. version.h gives it
   LANGUAGE and the patch levels, so an edition's differences here are the
   same tests the C makes.

   The build preprocesses it once for the main image, and once for each
   overlay with OVERLAY defined as the overlay's number; it reads each
   image's objects from the statements below, in order, and links them in
   that order.

   The main image lists its objects in the order the Game Pak holds them;
   each statement names the sections of its object it places there. */
#include "version.h"

/* The shift test (make SHIFT=n) moves everything after the header n bytes,
   so every bank starts n bytes later; 0 in every other build. */
#ifndef ROM_SHIFT
#define ROM_SHIFT 0
#endif
#if ROM_SHIFT % 4 != 0
#error "SHIFT must be a multiple of 4: words and Thumb literal pools in byte-aligned sections would misalign"
#endif

/* Where the far-call banks that move start, in each edition. English and
   Italian share every address; Japanese and French share the last ones
   with them. The other banks start at the same address in every edition. */
#if LANGUAGE == LANGUAGE_JAPANESE
#define GAME_BANK_START           0x080a8000
#define FIELD_SEQUENCE_BANK_START 0x080c8000
#define MENU_BANK_START           0x080f8000
#define SHOP_BANK_START           0x08108000
#elif LANGUAGE == LANGUAGE_GERMAN
#define GAME_BANK_START           0x080ba000
#define FIELD_SEQUENCE_BANK_START 0x080d5000
#define MENU_BANK_START           0x08102000
#define SHOP_BANK_START           0x08110000
#elif LANGUAGE == LANGUAGE_SPANISH
#define GAME_BANK_START           0x080b6000
#define FIELD_SEQUENCE_BANK_START 0x080d1000
#define MENU_BANK_START           0x080fe000
#define SHOP_BANK_START           0x0810c000
#elif LANGUAGE == LANGUAGE_FRENCH
#define GAME_BANK_START           0x080b2000
#define FIELD_SEQUENCE_BANK_START 0x080cd000
#define MENU_BANK_START           0x080fa000
#define SHOP_BANK_START           0x08108000
#else
#define GAME_BANK_START           0x080ad000
#define FIELD_SEQUENCE_BANK_START 0x080c8000
#define MENU_BANK_START           0x080f8000
#define SHOP_BANK_START           0x08108000
#endif

#ifdef OVERLAY
#include "src/system/overlay/overlay.ld"
#else
OUTPUT_ARCH(arm)
ENTRY(Entry)
Resource_Decode2CodeSize = Resource_Decode2End - Resource_Decode2Code;
Tile_Decompress4bppCodeSize = Tile_Decompress4bppEnd - Tile_Decompress4bppCode;
Tile_ExpandMaskedCodeSize = Tile_ExpandMaskedEnd - Tile_ExpandMaskedCode;
Tile_ExpandOpaqueCodeSize = Tile_ExpandOpaqueEnd - Tile_ExpandOpaqueCode;
Tile_BuildCellPicturesCodeSize = Tile_Decompress4bppCode - Tile_BuildCellPicturesCode;
Glyph_DrawCodeSize = Tile_BuildCellPicturesCode - Glyph_DrawCode;
BattleEffect_DecodePictureBlockSize = BattleEffect_DecodePictureEnd - BattleEffect_DecodePictureCode;
Render_DecodePictureBlockSize = Render_DecodePictureEnd - Render_DecodePictureCode;
Text_DecodeSymbolCodeSize = Text_DecodeSymbolEnd - Text_DecodeSymbolCode;
BattleEffect_ExpandCodeSize = BattleEffect_DotProduct2 - BattleEffect_ExpandCode;
BattleEffect_Expand2CodeSize = BattleEffect_Expand2End - BattleEffect_Expand2Code;
Model_DecodeCodeSize = Model_DecodeEnd - Model_DecodeCode;
Grid_DrawOutlineCodeSize = Resource_GetMetadataRecordFar - Grid_DrawOutlineCode;
Transform_UpdateVerticesCodeSize = Render_ConvertMapCode - Transform_UpdateVerticesCode;

MEMORY
{
    EWRAM (rwx) : ORIGIN = 0x2000000, LENGTH = 256K
    IWRAM (rwx) : ORIGIN = 0x3000000, LENGTH = 32K
    ROM    (rx) : ORIGIN = 0x8000000, LENGTH = 32M
}
SECTIONS
{
    ewram (NOLOAD) :
    {
        "*/games/tla/src/system/ewram.o"(.sym_ewram)
    } > EWRAM
    .rom_start :
    {
        "*/games/tla/src/gamepak/rom_header.o"(.text .rodata .data .padding)
        "*/games/tla/src/gamepak/far_call/system.o"(.text .rodata .data .padding)
        "*/games/tla/src/system/entry.o"(.text .rodata .data .padding)
        "*/games/tla/src/sound/driver/resampler_records.o"(.text .rodata .data .padding)
        "*/games/tla/src/sound/driver/resampler_records_pad.o"(.text .rodata .data .padding)
        "*/games/tla/src/sound/driver/resampler_records_2.o"(.text .rodata .data .padding)
        "*/games/tla/src/sound/driver/resampler_records_pad_1.o"(.text .rodata .data .padding)
        "*/games/tla/src/sound/driver/resampler_records_3.o"(.text .rodata .data .padding)
        "*/games/tla/src/sound/driver/resampler_records_pad_2.o"(.text .rodata .data .padding)
        "*/games/tla/src/sound/driver/resampler_records_4.o"(.text .rodata .data .padding)
        "*/games/tla/src/sound/driver/vsync_dma_refresh.o"(.text .rodata .data .padding)
        "*/games/tla/src/sound/driver/enter_vblank_update.o"(.text)
    } > ROM
    iwram_slots 0x3000000 (NOLOAD) :
    {
        "*/games/tla/src/system/iwram.o"(.sym_iwram_slots)
    } > IWRAM
    .iwram_resident 0x3000100 :
    {
        "*/games/tla/src/system/irq.o"(.text .rodata .data .padding)
        "*/games/tla/src/system/irq_table.o"(.text .rodata .data .padding)
        "*/games/tla/src/system/iwram_mul_q16.o"(.text .rodata .data .padding)
        "*/games/tla/src/system/iwram_ratio_q14.o"(.text .rodata .data .padding)
        "*/games/tla/src/system/iwram_math.o"(.text .rodata .data .padding)
        "*/games/tla/src/system/iwram_transform.o"(.text .rodata .data .padding)
        "*/games/tla/src/system/iwram_transform_state.o"(.text .rodata .data .padding)
        "*/games/tla/src/system/iwram_divide.o"(.text .rodata .data .padding)
        "*/games/tla/src/system/iwram_decompress.o"(.text .rodata .data .padding)
        "*/games/tla/src/system/iwram_copy_words.o"(.text .rodata .data .padding)
        "*/games/tla/src/system/iwram_halt.o"(.text .rodata .data .padding)
        "*/games/tla/src/sound/resident_mixer.o"(.text .rodata .data .padding)
        "*/games/tla/src/sound/resident_mixer_lanes.o"(.text .rodata .data .padding)
        "*/games/tla/src/sound/resident_mixer_state.o"(.text .rodata .data .padding)
        "*/games/tla/src/sound/resident_mixer_channel.o"(.text .rodata .data .padding)
        "*/games/tla/src/sound/resident_mixer_render_state.o"(.text .rodata .data .padding)
        "*/games/tla/src/sound/resident_mixer_render.o"(.text .rodata .data .padding)
        "*/games/tla/src/sound/resident_mixer_modes.o"(.text .rodata .data .padding)
    } > IWRAM AT>ROM
    iwram (NOLOAD) :
    {
        "*/games/tla/src/system/iwram.o"(.sym_iwram)
    } > IWRAM
    .rom_main :
    {
        "*/games/tla/src/system/decompress_byte_lz.o"(.text .rodata .data .padding)
        "*/games/tla/src/system/build_oam_list.o"(.text .rodata .data .padding)
        "*/games/tla/src/system/color_backup_kernels.o"(.text .rodata .data .padding)
        "*/games/tla/src/system/color_brighten_kernel.o"(.text .rodata .data .padding)
        "*/games/tla/src/system/color_backup_loaders.o"(.text .rodata .data .padding)
        "*/games/tla/src/system/color_kernels.o"(.text .rodata .data .padding)
        "*/games/tla/src/system/color_kernel_loaders.o"(.text .rodata .data .padding)
        "*/games/tla/src/system/decompress_halfword_lz.o"(.text .rodata .data .padding)
        "*/games/tla/src/system/iwram_entry.o"(.text .rodata .data .padding)
        "*/games/tla/src/system/long_multiply.o"(.text .rodata .data .padding)
        "*/games/tla/src/system/trig.o"(.text .rodata .data .padding)
        "*/games/tla/src/system/sine_table.o"(.text .rodata .data .padding)
        "*/games/tla/src/system/reciprocal_table.o"(.text .rodata .data .padding)
        "*/games/tla/src/system/decode_01.o"(.text .rodata .data .padding)
        "*/games/tla/src/system/decode_2.o"(.text .rodata .data .padding)
        "*/games/tla/src/system/decode_2_nibbles.o"(.text .rodata .data .padding)
        "*/games/tla/src/system/decode_2_loop.o"(.text .rodata .data .padding)
        "*/games/tla/src/system/execute_transfer.o"(.text .rodata .data .padding)
        "*/games/tla/src/system/patch_thumb_branch.o"(.text .rodata .data .padding)
        "*/games/tla/src/system/heap_slot_release.o"(.text .rodata .data .padding)
        "*/games/tla/src/system/heap_release.o"(.text .rodata .data .padding)
        "*/games/tla/src/system/system.o"(.text)
        "*/games/tla/src/system/bios.o"(.text .rodata .data .padding)
        "*/games/tla/src/system/bios_sound_bias_on.o"(.text .rodata .data .padding)
        "*/games/tla/src/gamepak/flash/flash.o"(.text)
        "*/games/tla/src/gamepak/flash/sst.o"(.text)
        "*/games/tla/src/gamepak/flash/program_flash_sector.o"(.text)
        "*/games/tla/src/gamepak/flash/atmel.o"(.text)
        "*libgcc.a:_call_via_rX.o"(.text)
        "*/games/tla/src/system/irq_table.o"(.rodata.irq_handlers)
        "*/games/tla/src/system/mathtan.o"(.rodata)
        "*/games/tla/src/graphics/palettes/palettes.o"(.rodata)
        "*/games/tla/src/system/number_text.o"(.rodata)
        "*/games/tla/src/system/q16_dot_product.o"(.text .rodata .data .padding)
        "*/games/tla/src/system/savedata.o"(.rodata)
        "*/games/tla/src/gamepak/flash/flashtab.o"(.rodata)
        "*/games/tla/src/gamepak/flash/flash.o"(.rodata)
        "*/games/tla/src/gamepak/flash/flashsst.o"(.rodata)
        "*/games/tla/src/gamepak/flash/sst.o"(.rodata)
        "*/games/tla/src/gamepak/flash/flashmx.o"(.rodata)
        "*/games/tla/src/gamepak/flash/program_flash_sector.o"(.rodata)
        "*/games/tla/src/gamepak/flash/flashat.o"(.rodata)
        "*/games/tla/src/gamepak/flash/atmel.o"(.rodata)
        . = ABSOLUTE(ROM_SHIFT + 0x08020000);
        "*/games/tla/src/gamepak/far_call/field.o"(.text .rodata .data .padding)
        "*/games/tla/src/field/sprite_color_tables.o"(.rodata)
        "*/games/tla/src/field/picture_decode.o"(.text .rodata .data .padding)
        "*/games/tla/src/field/picture_decode_data.o"(.text .rodata .data .padding)
        "*/games/tla/src/field/draw_map.o"(.text .rodata .data .padding)
        "*/games/tla/src/field/world_map_scanlines.o"(.text)
        "*/games/tla/src/field/world_map_lines_entry.o"(.text)
        "*/games/tla/src/field/world_map_lines.o"(.text)
        "*/games/tla/src/field/world_map_lines_call_thumb.o"(.text .rodata .data .padding)
        "*/games/tla/src/field/map_grid_convert.o"(.text .rodata .data .padding)
        "*/games/tla/src/field/copy_strided.o"(.text .rodata .data .padding)
        "*/games/tla/src/field/grid_outline_entry.o"(.text)
        "*/games/tla/src/field/grid_outline.o"(.text)
        "*/games/tla/src/field/field.o"(.text)
        "*/games/tla/src/field/animdata.o"(.rodata)
        "*/games/tla/src/field/object/objdata.o"(.rodata)
        "*/games/tla/src/field/curve_data.o"(.rodata)
        "*/games/tla/src/field/map_grid_data.o"(.rodata)
        . = ABSOLUTE(ROM_SHIFT + 0x08038000);
        "*/games/tla/src/gamepak/far_call/window.o"(.text .rodata .data .padding)
        "*/games/tla/src/window/message_decode.o"(.text .rodata .data .padding)
        "*/games/tla/src/window/lookup_symbol.o"(.text .rodata .data .padding)
        "*/games/tla/src/window/glyph_arm_entries.o"(.text)
        "*/games/tla/src/window/glyph_arm.o"(.text)
        "*/games/tla/src/window/cell_picture_entries.o"(.text)
        "*/games/tla/src/window/cell_picture.o"(.text)
        "*/games/tla/src/window/decompress_4bpp.o"(.text .rodata .data .padding)
        "*/games/tla/src/window/decompress_4bpp_nibbles.o"(.text .rodata .data .padding)
        "*/games/tla/src/window/decompress_4bpp_loop.o"(.text .rodata .data .padding)
        "*/games/tla/src/window/expand_masked.o"(.text .rodata .data .padding)
        "*/games/tla/src/window/expand_masked_masks.o"(.text .rodata .data .padding)
        "*/games/tla/src/window/expand_opaque.o"(.text .rodata .data .padding)
        "*/games/tla/src/window/expand_opaque_masks.o"(.text .rodata .data .padding)
        "*/games/tla/src/window/window.o"(.text)
        "*/games/tla/src/graphics/ui/slider.o"(.rodata)
        "*/games/tla/src/graphics/ui/marks.o"(.rodata)
        "*/games/tla/src/graphics/ui/menu_icons.o"(.rodata)
        "*/games/tla/src/graphics/ui/pointing_hand.o"(.rodata)
        "*/games/tla/src/graphics/ui/menu_titles.o"(.rodata)
        "*/games/tla/src/graphics/font/text.o"(.rodata)
        "*/games/tla/src/window/articles.o"(.rodata)
        "*/games/tla/src/graphics/ui/sprite_cursors.o"(.rodata)
        "*/games/tla/src/window/scales.o"(.rodata)
        "*/games/tla/src/graphics/ui/page_arrow.o"(.rodata)
        "*/games/tla/src/window/window_tables.o"(.rodata)
        "*/games/tla/text/messages.o"(.rodata)
        /* Only German and Italian link the item genders, each its own table. */
#if LANGUAGE == LANGUAGE_GERMAN || LANGUAGE == LANGUAGE_ITALIAN
        "*/games/tla/src/window/item_genders.o"(.rodata)
#endif
        "*/games/tla/src/window/text_speed.o"(.rodata)
        /* Only German links the counted nouns: their own object, since its table
           is word-aligned while the text speeds before it start at an odd
           address, which no one section holding both can do. */
#if LANGUAGE == LANGUAGE_GERMAN
        "*/games/tla/src/window/counted_nouns.o"(.rodata)
#endif
        "*/games/tla/src/graphics/ui/slider_palette.o"(.rodata)
        "*/games/tla/src/window/keyboard.o"(.rodata)
        . = ABSOLUTE(ROM_SHIFT + GAME_BANK_START);
        "*/games/tla/src/gamepak/far_call/game.o"(.text .rodata .data .padding)
        "*/games/tla/src/game/game.o"(.text)
        "*/games/tla/src/game/game.o"(.rodata)
        . = ABSOLUTE(ROM_SHIFT + FIELD_SEQUENCE_BANK_START);
        "*/games/tla/src/gamepak/far_call/field_sequence.o"(.text .rodata .data .padding)
        "*/games/tla/src/field/field_sequence/integrate_vectors.o"(.text .rodata .data .padding)
        "*/games/tla/src/field/field_sequence/sprite_color_tables.o"(.rodata)
        "*/games/tla/src/field/field_sequence/decode_picture.o"(.text .rodata .data .padding)
        "*/games/tla/src/field/field_sequence/decode_picture_data.o"(.text .rodata .data .padding)
        "*/games/tla/src/system/main_routine.o"(.text)
        "*/games/tla/src/field/field_sequence.o"(.text)
        "*/games/tla/src/field/object/step_angle.o"(.text)
        "*/games/tla/src/field/object/visual_attributes.o"(.text)
        "*/games/tla/src/field/field_effect/move.o"(.text)
        "*/games/tla/src/field/field_effect/spawn_resident.o"(.text)
        "*/games/tla/src/field/field_effect/advance_motion.o"(.text)
        "*/games/tla/src/field/event_commands/radial.o"(.text)
        "*/games/tla/src/graphics/field_effects/field_effects.o"(.rodata)
        "*/games/tla/src/field/event_commands/event_commands_tables.o"(.rodata)
        "*/games/tla/src/field/event_commands/FIELD_ENCOUNTERS.o"(.rodata)
        "*/games/tla/src/field/event_commands/encounter_rules.o"(.rodata)
        "*/games/tla/src/field/event_commands/cue_rules.o"(.rodata)
        "*/games/tla/src/field/event_commands/area_name_rules.o"(.rodata)
        "*/games/tla/src/field/event_commands/pair_rules.o"(.rodata)
        "*/games/tla/src/graphics/palette_editor/swatch.o"(.rodata)
        "*/games/tla/src/field/event_commands/descent.o"(.rodata)
        "*/games/tla/src/field/event_commands/marker_script.o"(.rodata)
        "*/games/tla/src/field/event_commands/event_commands_tables.o"(.rodata.a)
        "*/games/tla/src/field/object/variant_motion.o"(.rodata)
        "*/games/tla/src/field/event_commands/event_commands_tables.o"(.rodata.b)
        "*/games/tla/src/field/event_commands/fxtables.o"(.rodata)
        "*/games/tla/src/field/event_commands/marker_blend_cycle.o"(.rodata)
        "*/games/tla/src/field/event_commands/flag_entries.o"(.rodata)
        "*/games/tla/src/field/scenes.o"(.rodata)
        "*/games/tla/src/field/object/placement.o"(.rodata)
        "*/games/tla/src/field/scene_items.o"(.rodata)
        "*/games/tla/src/field/object/transition_shapes.o"(.rodata)
        "*/games/tla/src/field/object/scripts.o"(.rodata)
        "*/games/tla/src/field/field_effect/particles.o"(.rodata)
        "*/games/tla/src/field/field_effect/fxdata.o"(.rodata)
        "*/games/tla/src/field/event_commands/event_commands_tables.o"(.rodata.c)
        . = ABSOLUTE(ROM_SHIFT + MENU_BANK_START);
        "*/games/tla/src/gamepak/far_call/menu.o"(.text .rodata .data .padding)
        "*/games/tla/src/menu/menu.o"(.text)
        "*/games/tla/src/graphics/ui/menu_sprites.o"(.rodata)
        "*/games/tla/src/menu/menu_strings.o"(.rodata)
        "*/games/tla/src/menu/menu_tables.o"(.data)
        . = ABSOLUTE(ROM_SHIFT + SHOP_BANK_START);
        "*/games/tla/src/gamepak/far_call/shop.o"(.text .rodata .data .padding)
        "*/games/tla/src/shop/shop.o"(.text)
        "*/games/tla/src/graphics/ui/shop_sprites.o"(.rodata)
        "*/games/tla/src/shop/shop_tables.o"(.rodata)
        . = ABSOLUTE(ROM_SHIFT + 0x08118000);
        "*/games/tla/src/gamepak/far_call/battle.o"(.text .rodata .data .padding)
        "*/games/tla/src/battle/model_decode.o"(.text .rodata .data .padding)
        "*/games/tla/src/battle/model_bit_dispatch.o"(.text .rodata .data .padding)
        "*/games/tla/src/battle/model_bit_commands.o"(.text .rodata .data .padding)
        "*/games/tla/src/battle/color_scale_kernel.o"(.text .rodata .data .padding)
        "*/games/tla/src/battle/color_scale_loader.o"(.text .rodata .data .padding)
        "*/games/tla/src/battle/battle.o"(.text)
        "*/games/tla/src/battle/battle_tables.o"(.rodata)
        "*/games/tla/src/graphics/ui/page_arrow_2.o"(.rodata)
        "*/games/tla/src/battle/battle_tables.o"(.rodata.a)
        . = ABSOLUTE(ROM_SHIFT + 0x08138000);
        "*/games/tla/src/gamepak/far_call/battle_effect.o"(.text .rodata .data .padding)
        "*/games/tla/src/battle_effect/kernel_bank_integrate_vectors.o"(.text .rodata .data .padding)
        "*/games/tla/src/battle_effect/relocated_kernel_0.o"(.text .rodata .data .padding)
        "*/games/tla/src/battle_effect/relocated_kernels.o"(.text .rodata .data .padding)
        "*/games/tla/src/battle_effect/relocated_kernel_4.o"(.text .rodata .data .padding)
        "*/games/tla/src/battle_effect/relocated_kernel_5.o"(.text .rodata .data .padding)
        "*/games/tla/src/battle_effect/relocated_kernel_6.o"(.text .rodata .data .padding)
        "*/games/tla/src/battle_effect/relocated_kernel_7.o"(.text .rodata .data .padding)
        "*/games/tla/src/battle_effect/relocated_kernel_8.o"(.text .rodata .data .padding)
        "*/games/tla/src/battle_effect/relocated_kernel_9.o"(.text .rodata .data .padding)
        "*/games/tla/src/battle_effect/relocated_kernel_10.o"(.text .rodata .data .padding)
        "*/games/tla/src/battle_effect/relocated_kernel_11.o"(.text .rodata .data .padding)
        "*/games/tla/src/battle_effect/battle_effect.o"(.text)
        "*/games/tla/src/battle_effect/fxconst.o"(.rodata)
        "*/games/tla/src/battle_effect/blitter_fragments.o"(.text)
        "*/games/tla/src/battle_effect/blitter_color_fragments.o"(.text .rodata .data .padding)
        "*/games/tla/src/battle_effect/patch_template.o"(.text .rodata .data .padding)
        "*/games/tla/src/battle_effect/effect_bits.o"(.rodata)
        "*/games/tla/src/battle_effect/effect_table.o"(.rodata)
        . = ABSOLUTE(ROM_SHIFT + 0x081a0000);
        "*/games/tla/src/gamepak/far_call/credits.o"(.text)
        "*/games/tla/src/menu/credits_background_decode.o"(.text .rodata .data .padding)
        "*/games/tla/src/menu/credits_background_expand.o"(.text .rodata .data .padding)
        "*/games/tla/src/menu/credits_background_expand_link.o"(.text .rodata .data .padding)
        "*/games/tla/src/menu/credits_background_expand_dispatch.o"(.text .rodata .data .padding)
        "*/games/tla/src/menu/credits_background_expand_tables.o"(.text .rodata .data .padding)
        "*/games/tla/src/menu/credits_background_expand_commands.o"(.text .rodata .data .padding)
        "*/games/tla/src/menu/credits_background_decode_2.o"(.text .rodata .data .padding)
        "*/games/tla/src/menu/credits_background_expand_2.o"(.text .rodata .data .padding)
        "*/games/tla/src/menu/credits_background_expand_2_link.o"(.text .rodata .data .padding)
        "*/games/tla/src/menu/credits_background_expand_2_dispatch.o"(.text .rodata .data .padding)
        "*/games/tla/src/menu/credits_background_expand_2_tables.o"(.text .rodata .data .padding)
        "*/games/tla/src/menu/credits_background_expand_2_commands.o"(.text .rodata .data .padding)
        "*/games/tla/src/menu/credits.o"(.text)
        "*/games/tla/src/menu/credits.o"(.rodata)
        "*/games/tla/src/menu/credits.o"(.data)
        "*/games/tla/src/graphics/credits/font.o"(.rodata)
        . = ABSOLUTE(ROM_SHIFT + 0x081a6000);
        "*/games/tla/src/gamepak/far_call/title.o"(.text)
        "*/games/tla/src/menu/title_intro.o"(.text)
        "*/games/tla/src/graphics/title/prompt.o"(.rodata)
        "*/games/tla/src/menu/logo.o"(.rodata)
        "*/games/tla/src/graphics/title/prompt_blend_levels.o"(.rodata)
        "*/games/tla/src/menu/title_intro_tables.o"(.rodata)
        . = ABSOLUTE(ROM_SHIFT + 0x081ac000);
        "*/games/tla/src/gamepak/far_call/lucky_dice.o"(.text)
        "*/games/tla/src/field/lucky_dice.o"(.text)
        "*/games/tla/src/field/lucky_dice.o"(.rodata)
        . = ABSOLUTE(ROM_SHIFT + 0x081b2000);
        "*/games/tla/src/gamepak/far_call/lucky_wheels.o"(.text)
        "*/games/tla/src/field/lucky_wheels.o"(.text)
        "*/games/tla/src/field/lucky_wheels.o"(.rodata)
        . = ABSOLUTE(ROM_SHIFT + 0x081b8000);
        "*/games/tla/src/gamepak/far_call/resource_f.o"(.text)
        "*/games/tla/src/field/dice_game.o"(.text)
        "*/games/tla/src/field/dice_game.o"(.rodata)
        . = ABSOLUTE(ROM_SHIFT + 0x081c0000);
        "*/games/tla/src/gamepak/far_call/sound.o"(.text .rodata .data .padding)
        "*/games/tla/src/sound/driver/leftover_mplay_main_tail.o"(.text .rodata .data .padding)
        "*/games/tla/src/sound/driver/leftover_handle_note.o"(.text .rodata .data .padding)
        "*/games/tla/src/sound/driver/leftover_release_key.o"(.text .rodata .data .padding)
        "*/games/tla/src/sound/driver/leftover_clear_modulation.o"(.text)
        "*/games/tla/src/sound/driver/leftover_command_byte_reader.o"(.text .rodata .data .padding)
        "*/games/tla/src/sound/driver/leftover_command_byte_setters.o"(.text .rodata .data .padding)
        "*/games/tla/src/sound/midi_key_to_freq_work_copy.o"(.text .rodata .data .padding)
        "*/games/tla/src/sound/noop_stub_work_copy.o"(.text)
        "*/games/tla/src/sound/player_work_copy.o"(.text)
        "*/games/tla/src/sound/sound_work_copy.o"(.text .rodata .data .padding)
        "*/games/tla/src/sound/driver/midi_key_to_frequency.o"(.text .rodata .data .padding)
        "*/games/tla/src/sound/driver/midi_key_frequency_tables.o"(.text .rodata .data .padding)
        "*/games/tla/src/sound/driver/channel_unlink.o"(.text .rodata .data .padding)
        "*/games/tla/src/sound/driver/handle_note.o"(.text .rodata .data .padding)
        "*/games/tla/src/sound/driver/mplay_main.o"(.text .rodata .data .padding)
        "*/games/tla/src/sound/sound_stub.o"(.text)
        "*/games/tla/src/sound/bios_sound_driver_mode.o"(.text .rodata .data .padding)
        "*/games/tla/src/sound/noop_stub.o"(.text)
        "*/games/tla/src/sound/driver/umul_high.o"(.text .rodata .data .padding)
        "*/games/tla/src/sound/driver/mixer_entry.o"(.text .rodata .data .padding)
    } > ROM
    .iwram_mixer 0x3006000 :
    {
        "*/games/tla/src/sound/driver/mixer.o"(.text .rodata .data .padding)
    } > IWRAM AT>ROM
    iwram_high (NOLOAD) :
    {
        "*/games/tla/src/system/iwram_high.o"(.sym_iwram_high)
    } > IWRAM
    .rom_tail :
    {
        "*/games/tla/src/sound/driver/clear_buffer.o"(.text .rodata .data .padding)
        "*/games/tla/src/sound/driver/clear_chain.o"(.text)
        "*/games/tla/src/sound/driver/sequence_commands.o"(.text .rodata .data .padding)
        "*/games/tla/src/sound/driver/update.o"(.text .rodata .data .padding)
        "*/games/tla/src/sound/driver/track_stop.o"(.text .rodata .data .padding)
        "*/games/tla/src/sound/driver/calculate_stereo_volume.o"(.text .rodata .data .padding)
        "*/games/tla/src/sound/driver/handle_note_unreferenced.o"(.text .rodata .data .padding)
        "*/games/tla/src/sound/driver/release_key.o"(.text .rodata .data .padding)
        "*/games/tla/src/sound/driver/clear_modulation.o"(.text .rodata .data .padding)
        "*/games/tla/src/sound/driver/command_byte_reader.o"(.text .rodata .data .padding)
        "*/games/tla/src/sound/driver/command_byte_setters.o"(.text .rodata .data .padding)
        "*/games/tla/src/sound/sound.o"(.text)
        "*/games/tla/src/sound/sound_get_jump_list.o"(.text .rodata .data .padding)
        "*/games/tla/src/sound/driver.o"(.text)
        "*/games/tla/src/sound/empty_callback.o"(.text)
        "*/games/tla/src/sound/noop_stub.o"(.rodata)
        "*/games/tla/src/sound/tables.o"(.rodata)
        "*/games/tla/sound/voice_groups.o"(.rodata)
        "*/games/tla/sound/programmable_wave_samples.o"(.rodata)
        "*/games/tla/sound/music_player_table.o"(.rodata)
        "*/games/tla/sound/song_table.o"(.rodata)
        "*/games/tla/sound/direct_sound_samples.o"(.rodata)
        "*/games/tla/sound/songs/mus_000.o"(.rodata)
        "*/games/tla/sound/songs/mus_001.o"(.rodata)
        "*/games/tla/sound/songs/mus_002.o"(.rodata)
        "*/games/tla/sound/songs/mus_003.o"(.rodata)
        "*/games/tla/sound/songs/mus_004.o"(.rodata)
        "*/games/tla/sound/songs/mus_005.o"(.rodata)
        "*/games/tla/sound/songs/mus_006.o"(.rodata)
        "*/games/tla/sound/songs/mus_007.o"(.rodata)
        "*/games/tla/sound/songs/mus_008.o"(.rodata)
        "*/games/tla/sound/songs/mus_009.o"(.rodata)
        "*/games/tla/sound/songs/mus_010.o"(.rodata)
        "*/games/tla/sound/songs/mus_011.o"(.rodata)
        "*/games/tla/sound/songs/mus_012.o"(.rodata)
        "*/games/tla/sound/songs/mus_013.o"(.rodata)
        "*/games/tla/sound/songs/mus_014.o"(.rodata)
        "*/games/tla/sound/songs/mus_015.o"(.rodata)
        "*/games/tla/sound/songs/mus_016.o"(.rodata)
        "*/games/tla/sound/songs/mus_017.o"(.rodata)
        "*/games/tla/sound/songs/mus_018.o"(.rodata)
        "*/games/tla/sound/songs/mus_020.o"(.rodata)
        "*/games/tla/sound/songs/mus_021.o"(.rodata)
        "*/games/tla/sound/songs/mus_022.o"(.rodata)
        "*/games/tla/sound/songs/mus_023.o"(.rodata)
        "*/games/tla/sound/songs/mus_024.o"(.rodata)
        "*/games/tla/sound/songs/mus_025.o"(.rodata)
        "*/games/tla/sound/songs/mus_026.o"(.rodata)
        "*/games/tla/sound/songs/mus_027.o"(.rodata)
        "*/games/tla/sound/songs/mus_028.o"(.rodata)
        "*/games/tla/sound/songs/mus_029.o"(.rodata)
        "*/games/tla/sound/songs/mus_030.o"(.rodata)
        "*/games/tla/sound/songs/mus_031.o"(.rodata)
        "*/games/tla/sound/songs/mus_034.o"(.rodata)
        "*/games/tla/sound/songs/mus_035.o"(.rodata)
        "*/games/tla/sound/songs/mus_036.o"(.rodata)
        "*/games/tla/sound/songs/mus_037.o"(.rodata)
        "*/games/tla/sound/songs/mus_038.o"(.rodata)
        "*/games/tla/sound/songs/mus_039.o"(.rodata)
        "*/games/tla/sound/songs/mus_040.o"(.rodata)
        "*/games/tla/sound/songs/mus_041.o"(.rodata)
        "*/games/tla/sound/songs/mus_042.o"(.rodata)
        "*/games/tla/sound/songs/mus_043.o"(.rodata)
        "*/games/tla/sound/songs/mus_044.o"(.rodata)
        "*/games/tla/sound/songs/mus_049.o"(.rodata)
        "*/games/tla/sound/songs/mus_050.o"(.rodata)
        "*/games/tla/sound/songs/mus_051.o"(.rodata)
        "*/games/tla/sound/songs/mus_052.o"(.rodata)
        "*/games/tla/sound/songs/mus_053.o"(.rodata)
        "*/games/tla/sound/songs/mus_054.o"(.rodata)
        "*/games/tla/sound/songs/mus_055.o"(.rodata)
        "*/games/tla/sound/songs/mus_056.o"(.rodata)
        "*/games/tla/sound/songs/mus_057.o"(.rodata)
        "*/games/tla/sound/songs/mus_058.o"(.rodata)
        "*/games/tla/sound/songs/mus_059.o"(.rodata)
        "*/games/tla/sound/songs/mus_060.o"(.rodata)
        "*/games/tla/sound/songs/mus_061.o"(.rodata)
        "*/games/tla/sound/songs/mus_062.o"(.rodata)
        "*/games/tla/sound/songs/mus_063.o"(.rodata)
        "*/games/tla/sound/songs/mus_064.o"(.rodata)
        "*/games/tla/sound/songs/mus_065.o"(.rodata)
        "*/games/tla/sound/songs/mus_067.o"(.rodata)
        "*/games/tla/sound/songs/mus_068.o"(.rodata)
        "*/games/tla/sound/songs/mus_070.o"(.rodata)
        "*/games/tla/sound/songs/mus_071.o"(.rodata)
        "*/games/tla/sound/songs/mus_072.o"(.rodata)
        "*/games/tla/sound/songs/mus_073.o"(.rodata)
        "*/games/tla/sound/songs/mus_074.o"(.rodata)
        "*/games/tla/sound/songs/mus_075.o"(.rodata)
        "*/games/tla/sound/songs/mus_076.o"(.rodata)
        "*/games/tla/sound/songs/mus_080.o"(.rodata)
        "*/games/tla/sound/songs/mus_081.o"(.rodata)
        "*/games/tla/sound/songs/mus_082.o"(.rodata)
        "*/games/tla/sound/songs/mus_083.o"(.rodata)
        "*/games/tla/sound/songs/mus_084.o"(.rodata)
        "*/games/tla/sound/songs/mus_085.o"(.rodata)
        "*/games/tla/sound/songs/mus_086.o"(.rodata)
        "*/games/tla/sound/songs/mus_087.o"(.rodata)
        "*/games/tla/sound/songs/mus_088.o"(.rodata)
        "*/games/tla/sound/songs/mus_089.o"(.rodata)
        "*/games/tla/sound/songs/mus_091.o"(.rodata)
        "*/games/tla/sound/songs/mus_092.o"(.rodata)
        "*/games/tla/sound/songs/mus_093.o"(.rodata)
        "*/games/tla/sound/songs/mus_095.o"(.rodata)
        "*/games/tla/sound/songs/se_bell.o"(.rodata)
        "*/games/tla/sound/songs/se_shop_purchase.o"(.rodata)
        "*/games/tla/sound/songs/se_shop_sell.o"(.rodata)
        "*/games/tla/sound/songs/se_curse.o"(.rodata)
        "*/games/tla/sound/songs/se_104.o"(.rodata)
        "*/games/tla/sound/songs/se_105.o"(.rodata)
        "*/games/tla/sound/songs/se_drip.o"(.rodata)
        "*/games/tla/sound/songs/se_tremor.o"(.rodata)
        "*/games/tla/sound/songs/se_triple_tone_low.o"(.rodata)
        "*/games/tla/sound/songs/se_triple_tone_high.o"(.rodata)
        "*/games/tla/sound/songs/se_chime.o"(.rodata)
        "*/games/tla/sound/songs/se_menu_cursor_move.o"(.rodata)
        "*/games/tla/sound/songs/se_menu_confirm.o"(.rodata)
        "*/games/tla/sound/songs/se_menu_cancel.o"(.rodata)
        "*/games/tla/sound/songs/se_menu_error.o"(.rodata)
        "*/games/tla/sound/songs/se_ice.o"(.rodata)
        "*/games/tla/sound/songs/se_tolbi_spring_toss_prompt.o"(.rodata)
        "*/games/tla/sound/songs/se_item_remove.o"(.rodata)
        "*/games/tla/sound/songs/se_footstep.o"(.rodata)
        "*/games/tla/sound/songs/se_119.o"(.rodata)
        "*/games/tla/sound/songs/se_120.o"(.rodata)
        "*/games/tla/sound/songs/se_scuffle.o"(.rodata)
        "*/games/tla/sound/songs/se_122.o"(.rodata)
        "*/games/tla/sound/songs/se_map_exit.o"(.rodata)
        "*/games/tla/sound/songs/se_chest_open.o"(.rodata)
        "*/games/tla/sound/songs/se_chest_close.o"(.rodata)
        "*/games/tla/sound/songs/se_recovery.o"(.rodata)
        "*/games/tla/sound/songs/se_landing_thud.o"(.rodata)
        "*/games/tla/sound/songs/se_stairs_up.o"(.rodata)
        "*/games/tla/sound/songs/se_stairs_down.o"(.rodata)
        "*/games/tla/sound/songs/se_psynergy_start.o"(.rodata)
        "*/games/tla/sound/songs/se_psynergy_sparkle.o"(.rodata)
        "*/games/tla/sound/songs/se_water.o"(.rodata)
        "*/games/tla/sound/songs/se_impact.o"(.rodata)
        "*/games/tla/sound/songs/se_heavy_impact.o"(.rodata)
        "*/games/tla/sound/songs/se_click.o"(.rodata)
        "*/games/tla/sound/songs/se_whoosh.o"(.rodata)
        "*/games/tla/sound/songs/se_137.o"(.rodata)
        "*/games/tla/sound/songs/se_item_break.o"(.rodata)
        "*/games/tla/sound/songs/se_139.o"(.rodata)
        "*/games/tla/sound/songs/se_spin.o"(.rodata)
        "*/games/tla/sound/songs/se_rumble.o"(.rodata)
        "*/games/tla/sound/songs/se_swirl.o"(.rodata)
        "*/games/tla/sound/songs/se_crack.o"(.rodata)
        "*/games/tla/sound/songs/se_clatter.o"(.rodata)
        "*/games/tla/sound/songs/se_crash.o"(.rodata)
        "*/games/tla/sound/songs/se_enemy_cry.o"(.rodata)
        "*/games/tla/sound/songs/se_beast_cry.o"(.rodata)
        "*/games/tla/sound/songs/se_boss_roar.o"(.rodata)
        "*/games/tla/sound/songs/se_monster_roar.o"(.rodata)
        "*/games/tla/sound/songs/se_unused_defeat_cry.o"(.rodata)
        "*/games/tla/sound/songs/se_light_appear.o"(.rodata)
        "*/games/tla/sound/songs/se_jump.o"(.rodata)
        "*/games/tla/sound/songs/se_high_jump.o"(.rodata)
        "*/games/tla/sound/songs/se_cast.o"(.rodata)
        "*/games/tla/sound/songs/se_switch.o"(.rodata)
        "*/games/tla/sound/songs/se_switch_mechanism.o"(.rodata)
        "*/games/tla/sound/songs/se_gate_move.o"(.rodata)
        "*/games/tla/sound/songs/se_door_open.o"(.rodata)
        "*/games/tla/sound/songs/se_door_close.o"(.rodata)
        "*/games/tla/sound/songs/se_160.o"(.rodata)
        "*/games/tla/sound/songs/se_rattle.o"(.rodata)
        "*/games/tla/sound/songs/se_162.o"(.rodata)
        "*/games/tla/sound/songs/se_163.o"(.rodata)
        "*/games/tla/sound/songs/se_scatter.o"(.rodata)
        "*/games/tla/sound/songs/se_165.o"(.rodata)
        "*/games/tla/sound/songs/se_166.o"(.rodata)
        "*/games/tla/sound/songs/se_map_transition.o"(.rodata)
        "*/games/tla/sound/songs/se_168.o"(.rodata)
        "*/games/tla/sound/songs/se_169.o"(.rodata)
        "*/games/tla/sound/songs/se_170.o"(.rodata)
        "*/games/tla/sound/songs/se_thunder.o"(.rodata)
        "*/games/tla/sound/songs/se_thunder_loud.o"(.rodata)
        "*/games/tla/sound/songs/se_note_low.o"(.rodata)
        "*/games/tla/sound/songs/se_note_mid.o"(.rodata)
        "*/games/tla/sound/songs/se_note_high.o"(.rodata)
        "*/games/tla/sound/songs/se_kolima_bridge_hop.o"(.rodata)
        "*/games/tla/sound/songs/se_177.o"(.rodata)
        "*/games/tla/sound/songs/se_178.o"(.rodata)
        "*/games/tla/sound/songs/se_179.o"(.rodata)
        "*/games/tla/sound/songs/se_settle.o"(.rodata)
        "*/games/tla/sound/songs/se_boom.o"(.rodata)
        "*/games/tla/sound/songs/se_gem_set.o"(.rodata)
        "*/games/tla/sound/songs/se_stone_rumble.o"(.rodata)
        "*/games/tla/sound/songs/se_184.o"(.rodata)
        "*/games/tla/sound/songs/se_push.o"(.rodata)
        "*/games/tla/sound/songs/se_sol_sanctum_light_up.o"(.rodata)
        "*/games/tla/sound/songs/se_falling_light.o"(.rodata)
        "*/games/tla/sound/songs/se_thump.o"(.rodata)
        "*/games/tla/sound/songs/se_stone_grind.o"(.rodata)
        "*/games/tla/sound/songs/se_warp.o"(.rodata)
        "*/games/tla/sound/songs/se_191.o"(.rodata)
        "*/games/tla/sound/songs/se_192.o"(.rodata)
        "*/games/tla/sound/songs/se_193.o"(.rodata)
        "*/games/tla/sound/songs/se_194.o"(.rodata)
        "*/games/tla/sound/songs/se_195.o"(.rodata)
        "*/games/tla/sound/songs/se_wise_one_quest.o"(.rodata)
        "*/games/tla/sound/songs/se_197.o"(.rodata)
        "*/games/tla/sound/songs/se_kolima_bridge_post.o"(.rodata)
        "*/games/tla/sound/songs/se_199.o"(.rodata)
        "*/games/tla/sound/songs/se_sparkle_fall.o"(.rodata)
        "*/games/tla/sound/songs/se_ascend.o"(.rodata)
        "*/games/tla/sound/songs/se_flame_flare.o"(.rodata)
        "*/games/tla/sound/songs/se_203.o"(.rodata)
        "*/games/tla/sound/songs/se_dust_puff.o"(.rodata)
        "*/games/tla/sound/songs/se_205.o"(.rodata)
        "*/games/tla/sound/songs/se_curse_fall.o"(.rodata)
        "*/games/tla/sound/songs/se_207.o"(.rodata)
        "*/games/tla/sound/songs/se_bane_escape.o"(.rodata)
        "*/games/tla/sound/songs/se_mercury_lighthouse_door_open.o"(.rodata)
        "*/games/tla/sound/songs/se_hidden_passage_open.o"(.rodata)
        "*/games/tla/sound/songs/se_mercury_lighthouse_mechanism.o"(.rodata)
        "*/games/tla/sound/songs/se_power_up.o"(.rodata)
        "*/games/tla/sound/songs/se_heavy_stop.o"(.rodata)
        "*/games/tla/sound/songs/se_rising_chimes.o"(.rodata)
        "*/games/tla/sound/songs/se_splash_small.o"(.rodata)
        "*/games/tla/sound/songs/se_burst.o"(.rodata)
        "*/games/tla/sound/songs/se_floor_switch.o"(.rodata)
        "*/games/tla/sound/songs/se_218.o"(.rodata)
        "*/games/tla/sound/songs/se_gush.o"(.rodata)
        "*/games/tla/sound/songs/se_shimmer.o"(.rodata)
        "*/games/tla/sound/songs/se_rise_with_sparks.o"(.rodata)
        "*/games/tla/sound/songs/se_222.o"(.rodata)
        "*/games/tla/sound/songs/se_lift.o"(.rodata)
        "*/games/tla/sound/songs/se_224.o"(.rodata)
        "*/games/tla/sound/songs/se_225.o"(.rodata)
        "*/games/tla/sound/songs/se_log_push.o"(.rodata)
        "*/games/tla/sound/songs/se_topple.o"(.rodata)
        "*/games/tla/sound/songs/se_sparkling_passage.o"(.rodata)
        "*/games/tla/sound/songs/se_splash.o"(.rodata)
        "*/games/tla/sound/songs/se_230.o"(.rodata)
        "*/games/tla/sound/songs/se_water_level.o"(.rodata)
        "*/games/tla/sound/songs/se_crunch.o"(.rodata)
        "*/games/tla/sound/songs/se_cart_roll.o"(.rodata)
        "*/games/tla/sound/songs/se_run_back.o"(.rodata)
        "*/games/tla/sound/songs/se_235.o"(.rodata)
        "*/games/tla/sound/songs/se_colosso_countdown.o"(.rodata)
        "*/games/tla/sound/songs/se_colosso_go.o"(.rodata)
        "*/games/tla/sound/songs/se_push_step.o"(.rodata)
        "*/games/tla/sound/songs/se_heavy_move.o"(.rodata)
        "*/games/tla/sound/songs/se_log_fall.o"(.rodata)
        "*/games/tla/sound/songs/se_water_move.o"(.rodata)
        "*/games/tla/sound/songs/se_242.o"(.rodata)
        "*/games/tla/sound/songs/se_243.o"(.rodata)
        "*/games/tla/sound/songs/se_sandstorm.o"(.rodata)
        "*/games/tla/sound/songs/se_245.o"(.rodata)
        "*/games/tla/sound/songs/se_glitter.o"(.rodata)
        "*/games/tla/sound/songs/se_colosso_lettering.o"(.rodata)
        "*/games/tla/sound/songs/se_248.o"(.rodata)
        "*/games/tla/sound/songs/se_249.o"(.rodata)
        "*/games/tla/sound/songs/se_250.o"(.rodata)
        "*/games/tla/sound/songs/se_251.o"(.rodata)
        "*/games/tla/sound/songs/se_colosso_warrior_appear.o"(.rodata)
        "*/games/tla/sound/songs/se_253.o"(.rodata)
        "*/games/tla/sound/songs/se_voice_first.o"(.rodata)
        "*/games/tla/sound/songs/se_257.o"(.rodata)
        "*/games/tla/sound/songs/se_258.o"(.rodata)
        "*/games/tla/sound/songs/se_259.o"(.rodata)
        "*/games/tla/sound/songs/se_260.o"(.rodata)
        "*/games/tla/sound/songs/se_261.o"(.rodata)
        "*/games/tla/sound/songs/se_262.o"(.rodata)
        "*/games/tla/sound/songs/se_263.o"(.rodata)
        "*/games/tla/sound/songs/se_264.o"(.rodata)
        "*/games/tla/sound/songs/se_265.o"(.rodata)
        "*/games/tla/sound/songs/se_266.o"(.rodata)
        "*/games/tla/sound/songs/se_267.o"(.rodata)
        "*/games/tla/sound/songs/se_268.o"(.rodata)
        "*/games/tla/sound/songs/se_269.o"(.rodata)
        "*/games/tla/sound/songs/se_270.o"(.rodata)
        "*/games/tla/sound/songs/se_271.o"(.rodata)
        "*/games/tla/sound/songs/se_272.o"(.rodata)
        "*/games/tla/sound/songs/se_273.o"(.rodata)
        "*/games/tla/sound/songs/se_274.o"(.rodata)
        "*/games/tla/sound/songs/se_275.o"(.rodata)
        "*/games/tla/sound/songs/se_276.o"(.rodata)
        "*/games/tla/sound/songs/se_277.o"(.rodata)
        "*/games/tla/sound/songs/se_278.o"(.rodata)
        "*/games/tla/sound/songs/se_279.o"(.rodata)
        "*/games/tla/sound/songs/se_280.o"(.rodata)
        "*/games/tla/sound/songs/se_281.o"(.rodata)
        "*/games/tla/sound/songs/se_282.o"(.rodata)
        "*/games/tla/sound/songs/se_283.o"(.rodata)
        "*/games/tla/sound/songs/se_284.o"(.rodata)
        "*/games/tla/sound/songs/se_285.o"(.rodata)
        "*/games/tla/sound/songs/se_286.o"(.rodata)
        "*/games/tla/sound/songs/se_287.o"(.rodata)
        "*/games/tla/sound/songs/se_288.o"(.rodata)
        "*/games/tla/sound/songs/se_290.o"(.rodata)
        "*/games/tla/sound/songs/se_291.o"(.rodata)
        "*/games/tla/sound/songs/se_eruption_columns.o"(.rodata)
        "*/games/tla/sound/songs/se_293.o"(.rodata)
        "*/games/tla/sound/songs/se_298.o"(.rodata)
        "*/games/tla/sound/songs/se_tolbi_spring_toss.o"(.rodata)
        "*/games/tla/sound/songs/se_tolbi_spring_obstacle_hit.o"(.rodata)
        "*/games/tla/sound/songs/se_lucky_dice_throw.o"(.rodata)
        "*/games/tla/sound/songs/se_lucky_dice_number.o"(.rodata)
        "*/games/tla/sound/songs/se_lucky_wheels_spin.o"(.rodata)
        "*/games/tla/sound/songs/se_lucky_wheels_hold.o"(.rodata)
        "*/games/tla/sound/songs/se_lucky_wheels_stop_prompt.o"(.rodata)
        "*/games/tla/sound/songs/se_lucky_wheels_stop.o"(.rodata)
        "*/games/tla/sound/songs/se_materialize.o"(.rodata)
        "*/games/tla/sound/songs/se_star_bounce.o"(.rodata)
        "*/games/tla/sound/songs/se_310.o"(.rodata)
        "*/games/tla/sound/songs/se_311.o"(.rodata)
        "*/games/tla/sound/songs/se_512.o"(.rodata)
        "*/games/tla/sound/songs/se_520.o"(.rodata)
        "*/games/tla/sound/songs/se_521.o"(.rodata)
        "*/games/tla/sound/songs/se_522.o"(.rodata)
        "*/games/tla/sound/songs/se_523.o"(.rodata)
        "*/games/tla/sound/songs/se_524.o"(.rodata)
        "*/games/tla/sound/songs/se_525.o"(.rodata)
        "*/games/tla/sound/songs/se_526.o"(.rodata)
        "*/games/tla/sound/songs/se_527.o"(.rodata)
        "*/games/tla/sound/songs/se_528.o"(.rodata)
        "*/games/tla/sound/songs/se_529.o"(.rodata)
        "*/games/tla/sound/songs/se_530.o"(.rodata)
        "*/games/tla/sound/songs/se_531.o"(.rodata)
        "*/games/tla/sound/songs/se_532.o"(.rodata)
        "*/games/tla/sound/songs/se_533.o"(.rodata)
        "*/games/tla/sound/songs/se_534.o"(.rodata)
        "*/games/tla/sound/songs/se_535.o"(.rodata)
        "*/games/tla/sound/songs/se_536.o"(.rodata)
        "*/games/tla/sound/songs/se_538.o"(.rodata)
        "*/games/tla/sound/songs/se_539.o"(.rodata)
        "*/games/tla/sound/songs/se_542.o"(.rodata)
        "*/games/tla/sound/songs/se_543.o"(.rodata)
        "*/games/tla/sound/songs/se_544.o"(.rodata)
        "*/games/tla/sound/songs/se_545.o"(.rodata)
        "*/games/tla/sound/songs/se_546.o"(.rodata)
        "*/games/tla/sound/songs/se_547.o"(.rodata)
        "*/games/tla/sound/songs/se_548.o"(.rodata)
        "*/games/tla/sound/songs/se_549.o"(.rodata)
        "*/games/tla/sound/songs/se_550.o"(.rodata)
        "*/games/tla/sound/songs/se_551.o"(.rodata)
        "*/games/tla/sound/songs/se_552.o"(.rodata)
        "*/games/tla/sound/songs/se_554.o"(.rodata)
        "*/games/tla/sound/songs/se_555.o"(.rodata)
        "*/games/tla/sound/songs/se_556.o"(.rodata)
        "*/games/tla/sound/songs/se_557.o"(.rodata)
        "*/games/tla/sound/songs/se_558.o"(.rodata)
        "*/games/tla/sound/songs/se_559.o"(.rodata)
        "*/games/tla/sound/songs/se_560.o"(.rodata)
        "*/games/tla/sound/songs/se_561.o"(.rodata)
        "*/games/tla/sound/songs/se_562.o"(.rodata)
        "*/games/tla/sound/songs/se_563.o"(.rodata)
        "*/games/tla/sound/songs/se_564.o"(.rodata)
        "*/games/tla/sound/songs/se_565.o"(.rodata)
        "*/games/tla/sound/songs/se_566.o"(.rodata)
        "*/games/tla/sound/songs/se_567.o"(.rodata)
        "*/games/tla/sound/songs/se_568.o"(.rodata)
        "*/games/tla/sound/songs/se_569.o"(.rodata)
        "*/games/tla/sound/songs/se_570.o"(.rodata)
        "*/games/tla/sound/songs/se_571.o"(.rodata)
        "*/games/tla/sound/songs/se_572.o"(.rodata)
        "*/games/tla/sound/songs/se_573.o"(.rodata)
        "*/games/tla/sound/songs/se_574.o"(.rodata)
        "*/games/tla/sound/songs/se_575.o"(.rodata)
        "*/games/tla/sound/songs/se_576.o"(.rodata)
        "*/games/tla/sound/songs/se_577.o"(.rodata)
        "*/games/tla/sound/songs/se_578.o"(.rodata)
        "*/games/tla/sound/songs/se_579.o"(.rodata)
        "*/games/tla/sound/songs/se_580.o"(.rodata)
        "*/games/tla/sound/songs/se_581.o"(.rodata)
        "*/games/tla/sound/songs/se_582.o"(.rodata)
        "*/games/tla/sound/songs/se_583.o"(.rodata)
        "*/games/tla/sound/songs/se_584.o"(.rodata)
        "*/games/tla/sound/songs/se_585.o"(.rodata)
        "*/games/tla/sound/songs/se_586.o"(.rodata)
        "*/games/tla/sound/songs/se_587.o"(.rodata)
        "*/games/tla/sound/songs/se_588.o"(.rodata)
        "*/games/tla/sound/songs/se_589.o"(.rodata)
        "*/games/tla/sound/songs/se_590.o"(.rodata)
        "*/games/tla/sound/songs/se_591.o"(.rodata)
        "*/games/tla/sound/songs/se_592.o"(.rodata)
        "*/games/tla/sound/songs/se_593.o"(.rodata)
        "*/games/tla/sound/songs/se_594.o"(.rodata)
        "*/games/tla/sound/songs/se_595.o"(.rodata)
        "*/games/tla/sound/songs/se_596.o"(.rodata)
        "*/games/tla/sound/songs/se_597.o"(.rodata)
        "*/games/tla/sound/songs/se_598.o"(.rodata)
        "*/games/tla/sound/songs/se_610.o"(.rodata)
        "*/games/tla/sound/songs/se_611.o"(.rodata)
        "*/games/tla/sound/songs/se_612.o"(.rodata)
        "*/games/tla/sound/songs/se_613.o"(.rodata)
        "*/games/tla/sound/songs/se_614.o"(.rodata)
        "*/games/tla/sound/songs/se_615.o"(.rodata)
        "*/games/tla/sound/songs/se_616.o"(.rodata)
        "*/games/tla/sound/songs/se_617.o"(.rodata)
        "*/games/tla/sound/songs/se_618.o"(.rodata)
        "*/games/tla/sound/songs/se_619.o"(.rodata)
        "*/games/tla/sound/songs/se_620.o"(.rodata)
        "*/games/tla/sound/songs/se_621.o"(.rodata)
        "*/games/tla/sound/songs/se_622.o"(.rodata)
        "*/games/tla/sound/songs/se_623.o"(.rodata)
        "*/games/tla/sound/songs/mus_700.o"(.rodata)
        "*/games/tla/sound/songs/mus_701.o"(.rodata)
        "*/games/tla/sound/songs/mus_702.o"(.rodata)
        "*/games/tla/sound/songs/mus_703.o"(.rodata)
        "*/games/tla/sound/songs/mus_704.o"(.rodata)
        "*/games/tla/sound/songs/mus_705.o"(.rodata)
        "*/games/tla/sound/songs/mus_706.o"(.rodata)
        "*/games/tla/sound/songs/mus_707.o"(.rodata)
        "*/games/tla/sound/songs/mus_708.o"(.rodata)
        "*/games/tla/sound/songs/mus_709.o"(.rodata)
        "*/games/tla/sound/songs/mus_710.o"(.rodata)
        "*/games/tla/sound/songs/mus_720.o"(.rodata)
        "*/games/tla/sound/songs/mus_721.o"(.rodata)
        "*/games/tla/sound/songs/mus_722.o"(.rodata)
        "*/games/tla/sound/songs/mus_723.o"(.rodata)
        "*/games/tla/sound/songs/mus_724.o"(.rodata)
        "*/games/tla/sound/songs/mus_725.o"(.rodata)
        "*/games/tla/sound/songs/mus_726.o"(.rodata)
        "*/games/tla/sound/songs/mus_727.o"(.rodata)
        "*/games/tla/sound/songs/mus_728.o"(.rodata)
        "*/games/tla/sound/songs/mus_729.o"(.rodata)
        "*/games/tla/sound/songs/mus_730.o"(.rodata)
        "*/games/tla/sound/songs/mus_741.o"(.rodata)
        "*/games/tla/sound/songs/mus_742.o"(.rodata)
        "*/games/tla/sound/songs/mus_743.o"(.rodata)
        "*/games/tla/sound/songs/mus_750.o"(.rodata)
        "*/games/tla/sound/songs/mus_751.o"(.rodata)
        "*/games/tla/sound/songs/mus_752.o"(.rodata)
        "*/games/tla/sound/songs/mus_753.o"(.rodata)
        "*/games/tla/sound/songs/mus_754.o"(.rodata)
        "*/games/tla/sound/songs/mus_799.o"(.rodata)
        . = ABSOLUTE(ROM_SHIFT + 0x08300000);
        "*/games/tla/src/graphics/sprite/sprites.o"(.rodata)
        . = ABSOLUTE(ROM_SHIFT + 0x08680000);
        "*/games/tla/src/gamepak/resource_directory.o"(.rodata)
        "*/games/tla/src/graphics/ui/ui.o"(.rodata.a)
        "*/games/tla/src/graphics/field/clock_digits.o"(.rodata)
        "*/games/tla/src/graphics/title/title.o"(.rodata.c)
        "*/games/tla/src/graphics/title/title.o"(.rodata)
        "*/games/tla/src/graphics/title/title.o"(.rodata.d)
        "*/games/tla/src/graphics/title/title.o"(.rodata.a)
        "*/games/tla/src/graphics/title/logo_on_black.o"(.rodata)
        "*/games/tla/src/graphics/title/title.o"(.rodata.b)
        "*/games/tla/src/graphics/ui/headings.o"(.rodata)
        "*/games/tla/src/graphics/battle_backgrounds/battle_backgrounds.o"(.rodata)
        "*/games/tla/src/graphics/battle_backgrounds/stone_corridor.o"(.rodata)
        "*/games/tla/src/graphics/battle_backgrounds/battle_backgrounds.o"(.rodata.a)
        "*/games/tla/src/graphics/ending/ending.o"(.rodata)
        "*/games/tla/src/graphics/lucky_wheels/lucky_wheels.o"(.rodata)
        "*/games/tla/src/graphics/lucky_dice/board.o"(.rodata)
        "*/games/tla/src/graphics/lucky_wheels/dome.o"(.rodata)
        "*/games/tla/src/graphics/lucky_dice/lucky_dice.o"(.rodata)
        "*/games/tla/src/graphics/lucky_wheels/lucky_wheels.o"(.rodata.a)
        "*/games/tla/src/graphics/summon/summon.o"(.rodata)
        "*/games/tla/src/graphics/summon/crimson_beast.o"(.rodata)
        "*/games/tla/src/graphics/summon/summon.o"(.rodata.a)
        "*/games/tla/src/graphics/summon/summon.o"(.rodata.d)
        "*/games/tla/src/graphics/summon/summon.o"(.rodata.b)
        "*/games/tla/src/graphics/summon/golden_dragon.o"(.rodata)
        "*/games/tla/src/graphics/summon/summon.o"(.rodata.c)
        "*/games/tla/src/graphics/battle_effects/battle_effects.o"(.rodata)
        "*/games/tla/src/graphics/battle_effects/sheet_0d7.o"(.rodata)
        "*/games/tla/src/graphics/battle_effects/battle_effects.o"(.rodata.a)
        "*/games/tla/src/graphics/battle_effects/corner_rune_a.o"(.rodata)
        "*/games/tla/src/graphics/battle_effects/battle_effects.o"(.rodata.b)
        "*/games/tla/src/graphics/battle_effects/cloud_puff.o"(.rodata)
        "*/games/tla/src/graphics/battle_effects/battle_effects.o"(.rodata.c)
        "*/games/tla/src/graphics/battle_effects/comet_b.o"(.rodata)
        "*/games/tla/src/graphics/battle_effects/battle_effects.o"(.rodata.d)
        "*/games/tla/src/graphics/battle_effects/rock_wall.o"(.rodata)
        "*/games/tla/src/graphics/battle_effects/battle_effects.o"(.rodata.e)
        "*/games/tla/src/map/world/blocks.o"(.rodata)
        "*/games/tla/src/map/default/default.o"(.rodata)
        "*/games/tla/src/graphics/world_map/palette_a.o"(.rodata)
        "*/games/tla/src/map/default/default.o"(.rodata.a)
        "*/games/tla/src/graphics/world_map/world_map.o"(.rodata)
        "*/games/tla/src/graphics/world_map/anim_c.o"(.rodata)
        "*/games/tla/src/graphics/world_map/world_map.o"(.rodata.a)
        "*/games/tla/src/graphics/field/field.o"(.rodata)
        "*/games/tla/src/graphics/lettering/banner.o"(.rodata)
        "*/games/tla/src/graphics/ui/ui.o"(.rodata)
        "*/games/tla/src/graphics/field_effects/field_effects.o"(.rodata.a)
        "*/games/tla/src/graphics/field_effects/field_effects.o"(.rodata.d)
        "*/games/tla/src/graphics/field_effects/field_effects.o"(.rodata.b)
        "*/games/tla/src/graphics/field_effects/coloured_orbs.o"(.rodata)
        "*/games/tla/src/graphics/field_effects/field_effects.o"(.rodata.c)
        "*/games/tla/src/graphics/field/green_panel.o"(.rodata)
        "*/games/tla/src/graphics/ui/menu_sprites_packed.o"(.rodata)
        "*/games/tla/src/graphics/monster/monster.o"(.rodata)
        "*/games/tla/src/graphics/monster/serpent.o"(.rodata)
        "*/games/tla/src/graphics/monster/monster.o"(.rodata.a)
        "*/games/tla/src/map/maps.o"(.rodata)
        "*/games/tla/src/system/overlay/overlays.o"(.overlays)
    } > ROM
    IwramResident_Rom = LOADADDR(.iwram_resident);
    Sound_Mixer = LOADADDR(.iwram_mixer) + 1;
    Mixer_CallViaR3Rom = LOADADDR(.iwram_mixer) + (Mixer_CallViaR3 - ADDR(.iwram_mixer));
    /DISCARD/ : { *(.ARM.attributes) *(.comment) *(.note*) }
}
#endif
