SECTIONS
{
    .text 0x2008000 :
    {
        "*/games/tla/src/scene/anemos_inner_sanctum/entry.o"(.text)
        "*/recon/tla/raw/src/scene/anemos_inner_sanctum/s0038.o"(.text)
        "*/recon/tla/raw/src/scene/anemos_inner_sanctum/s00f4.o"(.text)
        "*/games/tla/src/scene/anemos_inner_sanctum/s0158.o"(.text)
        "*/recon/tla/raw/src/scene/anemos_inner_sanctum/s0178.o"(.text)
        "*/games/tla/src/scene/anemos_inner_sanctum/s01d4.o"(.text)
        "*/recon/tla/raw/src/scene/anemos_inner_sanctum/s01f8.o"(.text)
        "*/recon/tla/raw/src/scene/anemos_inner_sanctum/s0328.o"(.text)
        "*/games/tla/src/field/object/set_sprite_priority.o"(.text)
        "*/resource_6b0_overlay.o"(.text.x020083f6)
        "*/games/tla/src/field/object/prepare_object.o"(.text)
        "*/resource_6b0_overlay.o"(.text.x02008446)
        "*/recon/tla/raw/src/field/field_effect/move.o"(.text)
        "*/resource_6b0_overlay.o"(.text.x0200847e)
        "*/recon/tla/raw/src/scene/anemos_inner_sanctum/s0480.o"(.text)
        "*/games/tla/src/scene/anemos_inner_sanctum/s0654.o"(.text)
        "*/recon/tla/raw/src/scene/anemos_inner_sanctum/s0660.o"(.text)
        "*/games/tla/src/scene/anemos_inner_sanctum/s06a4.o"(.text)
        "*/recon/tla/raw/src/scene/anemos_inner_sanctum/s06f8.o"(.text)
        "*/recon/tla/raw/src/scene/anemos_inner_sanctum/s0794.o"(.text)
        "*/games/tla/src/field/object/wait_until_idle.o"(.text)
        "*/games/tla/src/scene/anemos_inner_sanctum/scene_tables.o"(.text)
        "*/games/tla/src/scene/anemos_inner_sanctum/s0818.o"(.text)
        "*/recon/tla/raw/src/scene/anemos_inner_sanctum/s088c.o"(.text)
        "*/recon/tla/raw/src/scene/anemos_inner_sanctum/s09b8.o"(.text)
        "*/games/tla/src/scene/anemos_inner_sanctum/s0a78.o"(.text)
        "*/recon/tla/raw/src/scene/anemos_inner_sanctum/s0ac8.o"(.text)
        "*/games/tla/src/scene/anemos_inner_sanctum/s1090.o"(.text)
        "*/games/tla/src/scene/anemos_inner_sanctum/s109c.o"(.text)
        "*/recon/tla/raw/src/scene/anemos_inner_sanctum/s1160.o"(.text)
        "*/recon/tla/raw/src/scene/anemos_inner_sanctum/s1398.o"(.text)
        "*/games/tla/src/scene/anemos_inner_sanctum/s1518.o"(.text)
        "*/games/tla/src/scene/anemos_inner_sanctum/s1614.o"(.text)
        "*/games/tla/src/scene/anemos_inner_sanctum/s1644.o"(.text)
        "*/games/tla/src/scene/anemos_inner_sanctum/s1660.o"(.text)
        "*/games/tla/src/scene/anemos_inner_sanctum/s16fc.o"(.text)
        "*/games/tla/src/scene/anemos_inner_sanctum/s178c.o"(.text)
        "*/games/tla/src/scene/anemos_inner_sanctum/s17a0.o"(.text)
        "*/recon/tla/raw/src/scene/anemos_inner_sanctum/s17b4.o"(.text)
        "*/games/tla/src/scene/anemos_inner_sanctum/s1938.o"(.text)
        "*/recon/tla/raw/src/scene/anemos_inner_sanctum/s19a8.o"(.text)
        "*/recon/tla/raw/src/scene/anemos_inner_sanctum/s1a94.o"(.text)
        "*/games/tla/src/scene/anemos_inner_sanctum/s1b88.o"(.text)
        "*/games/tla/src/scene/anemos_inner_sanctum/s1bec.o"(.text)
        "*/recon/tla/raw/src/scene/anemos_inner_sanctum/s1c60.o"(.text)
        "*/recon/tla/raw/src/scene/anemos_inner_sanctum/s1c94.o"(.text)
        "*/recon/tla/raw/src/scene/anemos_inner_sanctum/s1d68.o"(.text)
        "*/recon/tla/raw/src/scene/anemos_inner_sanctum/s1e64.o"(.text)
        "*/games/tla/src/scene/anemos_inner_sanctum/prepare.o"(.text)
        "*/games/tla/src/field/object/set_sprite_priority_b.o"(.text)
        "*/resource_6b0_overlay.o"(.text.x0200a746)
        "*/recon/tla/raw/src/scene/anemos_inner_sanctum/move.o"(.text)
        "*/recon/tla/raw/src/scene/anemos_inner_sanctum/s2780.o"(.text)
        "*/recon/tla/raw/src/scene/anemos_inner_sanctum/s2948.o"(.text)
        "*/recon/tla/raw/src/scene/anemos_inner_sanctum/s2a74.o"(.text)
        "*/recon/tla/raw/src/scene/anemos_inner_sanctum/s2cb8.o"(.text)
        "*/recon/tla/raw/src/scene/anemos_inner_sanctum/s2db0.o"(.text)
        "*/recon/tla/raw/src/field/field_effect/advance_motion.o"(.text)
        "*/resource_6b0_overlay.o"(.text.x0200af46)
        "*/recon/tla/raw/src/scene/anemos_inner_sanctum/s2f48.o"(.text)
        "*/recon/tla/raw/src/scene/anemos_inner_sanctum/s30e0.o"(.text)
        "*/recon/tla/raw/src/scene/anemos_inner_sanctum/s3190.o"(.text)
        "*/games/tla/src/scene/anemos_inner_sanctum/import.o"(.text)
        "*/games/tla/src/scene/anemos_inner_sanctum/data.o"(.data)
    }
    .bss : { "*/resource_6b0_overlay.o"(.bss) }
    /DISCARD/ : { *(.ARM.attributes) *(.comment) *(.note*) }
}
