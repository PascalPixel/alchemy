SECTIONS
{
    .text 0x2008000 :
    {
        "*/games/tla/src/scene/islets/entry.o"(.text)
        "*/games/tla/src/scene/islets/scene_tables.o"(.text)
        "*/games/tla/src/scene/islets/s004c.o"(.text)
        "*/games/tla/src/scene/islets/s019c.o"(.text)
        "*/games/tla/src/scene/islets/events2.o"(.text)
        "*/resource_674_overlay.o"(.text.x020086f4)
        "*/games/tla/src/scene/islets/s0da0.o"(.text)
        "*/games/tla/src/scene/islets/s0e38.o"(.text)
        "*/games/tla/src/scene/islets/s1278.o"(.text)
        "*/games/tla/src/scene/islets/s129c.o"(.text)
        "*/games/tla/src/scene/islets/s14e0.o"(.text)
        "*/games/tla/src/scene/islets/s1bf4.o"(.text)
        "*/games/tla/src/scene/islets/s1cac.o"(.text)
        "*/games/tla/src/scene/islets/s1cfc.o"(.text)
        "*/games/tla/src/scene/islets/s1d90.o"(.text)
        "*/games/tla/src/scene/islets/s1f58.o"(.text)
        "*/games/tla/src/scene/islets/s1f74.o"(.text)
        "*/games/tla/src/scene/islets/events3.o"(.text)
        "*/games/tla/src/scene/islets/s20ec.o"(.text)
        "*/games/tla/src/scene/islets/s21d0.o"(.text)
        "*/games/tla/src/scene/islets/s2430.o"(.text)
        "*/games/tla/src/scene/islets/s24c8.o"(.text)
        "*/games/tla/src/scene/islets/events.o"(.text)
        "*/games/tla/src/scene/islets/s267c.o"(.text)
        "*/games/tla/src/scene/islets/s274c.o"(.text)
        "*/games/tla/src/scene/islets/s2780.o"(.text)
        "*/games/tla/src/scene/islets/s2830.o"(.text)
        "*/games/tla/src/scene/islets/s29c4.o"(.text)
        "*/games/tla/src/scene/islets/s2b64.o"(.text)
        "*/games/tla/src/scene/islets/s2c38.o"(.text)
        "*/games/tla/src/scene/islets/s2d0c.o"(.text)
        "*/games/tla/src/scene/islets/s2d7c.o"(.text)
        "*/games/tla/src/scene/islets/s2f1c.o"(.text)
        "*/games/tla/src/scene/islets/s3164.o"(.text)
        "*/games/tla/src/scene/islets/s329c.o"(.text)
        "*/games/tla/src/scene/islets/prepare.o"(.text)
        "*/games/tla/src/scene/islets/s3410.o"(.text)
        "*/games/tla/src/scene/islets/palqueue.o"(.text)
        "*/games/tla/src/scene/islets/events4.o"(.text)
        "*/games/tla/src/scene/islets/s34fc.o"(.text)
        "*/games/tla/src/scene/islets/events5.o"(.text)
        "*/games/tla/src/scene/islets/s3684.o"(.text)
        "*/games/tla/src/scene/islets/s3790.o"(.text)
        "*/resource_674_overlay.o"(.text.x0200b7d8)
        "*/games/tla/src/scene/islets/s3940.o"(.text)
        "*/games/tla/src/scene/islets/s3a5c.o"(.text)
        "*/games/tla/src/scene/islets/s3d0c.o"(.text)
        "*/games/tla/src/scene/islets/import.o"(.text)
        "*/games/tla/src/scene/islets/data.o"(.data)
    }
    .bss : { "*/resource_674_overlay.o"(.bss) }
    /DISCARD/ : { *(.ARM.attributes) *(.comment) *(.note*) }
}
