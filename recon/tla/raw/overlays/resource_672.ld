SECTIONS
{
    .text 0x2008000 :
    {
        "*/games/tla/src/scene/gabomba_statue_chamber/entry.o"(.text)
        "*/games/tla/src/scene/gabomba_statue_chamber/scene_tables.o"(.text)
        "*/games/tla/src/scene/gabomba_statue_chamber/s0040.o"(.text)
        "*/games/tla/src/scene/gabomba_statue_chamber/exits.o"(.text)
        "*/games/tla/src/scene/gabomba_statue_chamber/s0070.o"(.text)
        "*/games/tla/src/scene/gabomba_statue_chamber/s0100.o"(.text)
        "*/resource_672_overlay.o"(.text.x02008184)
        "*/games/tla/src/scene/gabomba_statue_chamber/s0a98.o"(.text)
        "*/games/tla/src/scene/gabomba_statue_chamber/call_b60.o"(.text)
        "*/games/tla/src/scene/gabomba_statue_chamber/s0b70.o"(.text)
        "*/resource_672_overlay.o"(.text.x02008be8)
        "*/resource_672_overlay.o"(.text.x02008d3c)
        "*/games/tla/src/scene/gabomba_statue_chamber/flag_e50.o"(.text)
        "*/games/tla/src/scene/gabomba_statue_chamber/s0e60.o"(.text)
        "*/games/tla/src/scene/gabomba_statue_chamber/follow.o"(.text)
        "*/games/tla/src/scene/gabomba_statue_chamber/s0f00.o"(.text)
        "*/games/tla/src/scene/gabomba_statue_chamber/s1010.o"(.text)
        "*/games/tla/src/scene/gabomba_statue_chamber/panels.o"(.text)
        "*/games/tla/src/scene/gabomba_statue_chamber/s1094.o"(.text)
        "*/games/tla/src/scene/gabomba_statue_chamber/s10d4.o"(.text)
        "*/resource_672_overlay.o"(.text.x02009710)
        "*/games/tla/src/scene/gabomba_statue_chamber/prepare.o"(.text)
        "*/resource_672_overlay.o"(.text.x02009ba8)
        "*/games/tla/src/scene/gabomba_statue_chamber/s1c44.o"(.text)
        "*/games/tla/src/scene/gabomba_statue_chamber/import.o"(.text)
        "*/games/tla/src/scene/gabomba_statue_chamber/data.o"(.data)
    }
    /DISCARD/ : { *(.ARM.attributes) *(.comment) *(.note*) }
}
