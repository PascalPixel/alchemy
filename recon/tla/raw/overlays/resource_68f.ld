SECTIONS
{
    .text 0x2008000 :
    {
        "*/games/tla/src/scene/tundaria_tower/entry.o"(.text)
        "*/games/tla/src/field/object/set_sprite_priority.o"(.text)
        "*/resource_68f_overlay.o"(.text.x0200807e)
        "*/games/tla/src/field/field_effect/move.o"(.text)
        "*/resource_68f_overlay.o"(.text.x020080b6)
        "*/games/tla/src/scene/tundaria_tower/s00b8.o"(.text)
        "*/games/tla/src/scene/tundaria_tower/script0.o"(.text)
        "*/games/tla/src/field/object/wait_until_idle.o"(.text)
        "*/games/tla/src/field/map/cell_get.o"(.text)
        "*/games/tla/src/field/map/cell_set.o"(.text)
        "*/games/tla/src/scene/tundaria_tower/s0338.o"(.text)
        "*/games/tla/src/scene/tundaria_tower/s0404.o"(.text)
        "*/games/tla/src/scene/tundaria_tower/scene_tables.o"(.text)
        "*/games/tla/src/scene/tundaria_tower/exits.o"(.text)
        "*/games/tla/src/scene/tundaria_tower/script1.o"(.text)
        "*/games/tla/src/scene/tundaria_tower/s05d0.o"(.text)
        "*/games/tla/src/scene/tundaria_tower/fall.o"(.text)
        "*/resource_68f_overlay.o"(.text.x02008708)
        "*/games/tla/src/scene/tundaria_tower/events_a.o"(.text)
        "*/games/tla/src/scene/tundaria_tower/script2.o"(.text)
        "*/games/tla/src/scene/tundaria_tower/s0964.o"(.text)
        "*/games/tla/src/scene/tundaria_tower/s0a48.o"(.text)
        "*/games/tla/src/scene/tundaria_tower/script3.o"(.text)
        "*/games/tla/src/scene/tundaria_tower/s0b3c.o"(.text)
        "*/games/tla/src/scene/tundaria_tower/events_b.o"(.text)
        "*/games/tla/src/scene/tundaria_tower/s0c64.o"(.text)
        "*/games/tla/src/scene/tundaria_tower/s0d2c.o"(.text)
        "*/games/tla/src/scene/tundaria_tower/s0de4.o"(.text)
        "*/games/tla/src/scene/tundaria_tower/s0e78.o"(.text)
        "*/games/tla/src/scene/tundaria_tower/script4.o"(.text)
        "*/games/tla/src/scene/tundaria_tower/s0f0c.o"(.text)
        "*/games/tla/src/scene/tundaria_tower/script5.o"(.text)
        "*/games/tla/src/scene/tundaria_tower/events_c.o"(.text)
        "*/games/tla/src/scene/tundaria_tower/s10d4.o"(.text)
        "*/games/tla/src/field/field_effect/advance_motion.o"(.text)
        "*/resource_68f_overlay.o"(.text.x020091de)
        "*/games/tla/src/scene/tundaria_tower/s11e0.o"(.text)
        "*/games/tla/src/scene/tundaria_tower/events_d.o"(.text)
        "*/games/tla/src/scene/tundaria_tower/s13b8.o"(.text)
        "*/games/tla/src/scene/tundaria_tower/prepare.o"(.text)
        "*/games/tla/src/scene/tundaria_tower/s17dc.o"(.text)
        "*/games/tla/src/scene/tundaria_tower/events_e.o"(.text)
        "*/games/tla/src/scene/tundaria_tower/s189c.o"(.text)
        "*/resource_68f_overlay.o"(.text.x02009b48)
        "*/games/tla/src/scene/tundaria_tower/s1b48.o"(.text)
        "*/games/tla/src/scene/tundaria_tower/events_f.o"(.text)
        "*/games/tla/src/scene/tundaria_tower/s1e68.o"(.text)
        "*/games/tla/src/scene/tundaria_tower/s2094.o"(.text)
        "*/games/tla/src/scene/tundaria_tower/s2100.o"(.text)
        "*/games/tla/src/scene/tundaria_tower/s2184.o"(.text)
        "*/games/tla/src/scene/tundaria_tower/s222c.o"(.text)
        "*/games/tla/src/scene/tundaria_tower/s2354.o"(.text)
        "*/games/tla/src/scene/tundaria_tower/s24e8.o"(.text)
        "*/games/tla/src/scene/tundaria_tower/events_g.o"(.text)
        "*/resource_68f_overlay.o"(.text.x0200a5e0)
        "*/games/tla/src/scene/tundaria_tower/events_h.o"(.text)
        "*/games/tla/src/scene/tundaria_tower/s2764.o"(.text)
        "*/games/tla/src/field/field_effect/advance_motion_priority.o"(.text)
        "*/games/tla/src/scene/tundaria_tower/s29d0.o"(.text)
        "*/games/tla/src/scene/tundaria_tower/s2b04.o"(.text)
        "*/games/tla/src/scene/tundaria_tower/s2c1c.o"(.text)
        "*/games/tla/src/scene/tundaria_tower/events_i.o"(.text)
        "*/games/tla/src/scene/tundaria_tower/s2cc0.o"(.text)
        "*/games/tla/src/scene/tundaria_tower/s2d44.o"(.text)
        "*/resource_68f_overlay.o"(.text.x0200ae00)
        "*/games/tla/src/scene/tundaria_tower/sparks.o"(.text)
        "*/games/tla/src/scene/tundaria_tower/import.o"(.text)
        "*/games/tla/src/scene/tundaria_tower/data.o"(.data)
    }
    .bss : { "*/resource_68f_overlay.o"(.bss) }
    /DISCARD/ : { *(.ARM.attributes) *(.comment) *(.note*) }
}
