SECTIONS
{
    .text 0x2008000 :
    {
        "*/games/tla/src/scene/venus_lighthouse/entry.o"(.text)
        "*/games/tla/src/field/object/set_sprite_priority.o"(.text)
        "*/games/tla/src/scene/venus_lighthouse/objects.o"(.text)
        "*/recon/tla/raw/src/field/field_effect/move.o"(.text)
        "*/resource_64e_overlay.o"(.text.x0200814e)
        "*/recon/tla/raw/src/scene/venus_lighthouse/s0150.o"(.text)
        "*/recon/tla/raw/src/scene/venus_lighthouse/distance.o"(.text)
        "*/recon/tla/raw/src/field/object/find_in_cell.o"(.text)
        "*/recon/tla/raw/src/scene/venus_lighthouse/s038c.o"(.text)
        "*/recon/tla/raw/src/field/map/cell_fill_byte.o"(.text)
        "*/games/tla/src/scene/venus_lighthouse/cellfill.o"(.text)
        "*/recon/tla/raw/src/scene/venus_lighthouse/flicker.o"(.text)
        "*/recon/tla/raw/src/scene/venus_lighthouse/s05a8.o"(.text)
        "*/games/tla/src/scene/venus_lighthouse/scene_tables.o"(.text)
        "*/recon/tla/raw/src/scene/venus_lighthouse/floor.o"(.text)
        "*/games/tla/src/scene/venus_lighthouse/push.o"(.text)
        "*/games/tla/src/scene/venus_lighthouse/statue.o"(.text)
        "*/recon/tla/raw/src/scene/venus_lighthouse/scene_events.o"(.text)
        "*/recon/tla/raw/src/scene/venus_lighthouse/s0a54.o"(.text)
        "*/games/tla/src/scene/venus_lighthouse/prepare.o"(.text)
        "*/recon/tla/raw/src/scene/venus_lighthouse/leave.o"(.text)
        "*/games/tla/src/scene/venus_lighthouse/import.o"(.text)
        "*/games/tla/src/scene/venus_lighthouse/data.o"(.data)
    }
    /DISCARD/ : { *(.ARM.attributes) *(.comment) *(.note*) }
}
