SECTIONS
{
    .text 0x2008000 :
    {
        "*/games/tla/src/scene/treasure_isle/entry.o"(.text)
        "*/games/tla/src/field/common/object/set_sprite_priority.o"(.text)
        "*/games/tla/src/field/common/object/prepare_object.o"(.text)
        "*/games/tla/src/scene/treasure_isle/s00d0.o"(.text)
        "*/games/tla/src/field/common/effect/move.o"(.text)
        "*/resource_6af_overlay.o"(.text.x0200815c)
        "*/games/tla/src/scene/treasure_isle/scene_tables.o"(.text)
        "*/games/tla/src/scene/treasure_isle/s0350.o"(.text)
        "*/games/tla/src/scene/treasure_isle/s03b4.o"(.text)
        "*/games/tla/src/scene/treasure_isle/s03fc.o"(.text)
        "*/games/tla/src/scene/treasure_isle/s043c.o"(.text)
        "*/games/tla/src/scene/treasure_isle/s05ac.o"(.text)
        "*/games/tla/src/scene/treasure_isle/s0864.o"(.text)
        "*/games/tla/src/scene/treasure_isle/s0870.o"(.text)
        "*/games/tla/src/scene/treasure_isle/s0880.o"(.text)
        "*/games/tla/src/scene/treasure_isle/s0914.o"(.text)
        "*/games/tla/src/scene/treasure_isle/s0940.o"(.text)
        "*/games/tla/src/scene/treasure_isle/s0970.o"(.text)
        "*/games/tla/src/scene/treasure_isle/s09a0.o"(.text)
        "*/games/tla/src/scene/treasure_isle/s09d0.o"(.text)
        "*/games/tla/src/scene/treasure_isle/s09fc.o"(.text)
        "*/games/tla/src/scene/treasure_isle/s0a2c.o"(.text)
        "*/games/tla/src/scene/treasure_isle/s0a5c.o"(.text)
        "*/games/tla/src/scene/treasure_isle/s0a8c.o"(.text)
        "*/games/tla/src/scene/treasure_isle/s0b3c.o"(.text)
        "*/resource_6af_overlay.o"(.text.x02008ba0)
        "*/games/tla/src/scene/treasure_isle/s0cf4.o"(.text)
        "*/games/tla/src/scene/treasure_isle/prepare.o"(.text)
        "*/games/tla/src/scene/treasure_isle/s0f4c.o"(.text)
        "*/games/tla/src/scene/treasure_isle/import.o"(.text)
        "*/games/tla/src/scene/treasure_isle/data.o"(.data)
    }
    .bss : { "*/resource_6af_overlay.o"(.bss) }
    /DISCARD/ : { *(.ARM.attributes) *(.comment) *(.note*) }
}
