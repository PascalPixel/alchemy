SECTIONS
{
    .text 0x2008000 :
    {
        "*/games/tla/src/scene/champa/entry.o"(.text)
        "*/games/tla/src/scene/champa/scene_tables.o"(.text)
        "*/games/tla/src/scene/champa/s006c.o"(.text)
        "*/games/tla/src/scene/champa/s0080.o"(.text)
        "*/games/tla/src/scene/champa/s014c.o"(.text)
        "*/games/tla/src/scene/champa/s0178.o"(.text)
        "*/games/tla/src/scene/champa/s0188.o"(.text)
        "*/games/tla/src/scene/champa/s0430.o"(.text)
        "*/games/tla/src/scene/champa/s04b4.o"(.text)
        "*/games/tla/src/scene/champa/s0554.o"(.text)
        "*/games/tla/src/scene/champa/s0590.o"(.text)
        "*/games/tla/src/scene/champa/s05dc.o"(.text)
        "*/games/tla/src/scene/champa/s060c.o"(.text)
        "*/games/tla/src/scene/champa/s0638.o"(.text)
        "*/games/tla/src/scene/champa/s0a60.o"(.text)
        "*/games/tla/src/scene/champa/s0b18.o"(.text)
        "*/games/tla/src/scene/champa/s0c04.o"(.text)
        "*/games/tla/src/scene/champa/s0c40.o"(.text)
        "*/games/tla/src/scene/champa/s0c90.o"(.text)
        "*/games/tla/src/scene/champa/s0d4c.o"(.text)
        "*/games/tla/src/scene/champa/s0e04.o"(.text)
        "*/games/tla/src/scene/champa/s0e24.o"(.text)
        "*/games/tla/src/scene/champa/s0e30.o"(.text)
        "*/games/tla/src/scene/champa/import.o"(.text)
        "*/games/tla/src/scene/champa/data.o"(.data)
    }
    /DISCARD/ : { *(.ARM.attributes) *(.comment) *(.note*) }
}
