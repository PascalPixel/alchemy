SECTIONS
{
    .text 0x2008000 :
    {
        "*/games/tla/src/scene/gaia_rock_inside/entry.o"(.text)
        "*/games/tla/src/field/object/set_sprite_priority.o"(.text)
        "*/games/tla/src/field/object/prepare_object.o"(.text)
        "*/games/tla/src/scene/gaia_rock_inside/s00d0.o"(.text)
        "*/games/tla/src/field/field_effect/move.o"(.text)
        "*/games/tla/src/scene/gaia_rock_inside/s015c.o"(.text)
        "*/games/tla/src/scene/gaia_rock_inside/scene_tables.o"(.text)
        "*/games/tla/src/scene/gaia_rock_inside/s0344.o"(.text)
        "*/games/tla/src/scene/gaia_rock_inside/s036c.o"(.text)
        "*/games/tla/src/scene/gaia_rock_inside/effadv.o"(.text)
        "*/resource_681_overlay.o"(.text.x0200842a)
        "*/games/tla/src/scene/gaia_rock_inside/s042c.o"(.text)
        "*/games/tla/src/scene/gaia_rock_inside/exits.o"(.text)
        "*/games/tla/src/scene/gaia_rock_inside/s05dc.o"(.text)
        "*/games/tla/src/scene/gaia_rock_inside/s05f8.o"(.text)
        "*/games/tla/src/scene/gaia_rock_inside/s0610.o"(.text)
        "*/games/tla/src/scene/gaia_rock_inside/s06e0.o"(.text)
        "*/games/tla/src/scene/gaia_rock_inside/s06f8.o"(.text)
        "*/games/tla/src/scene/gaia_rock_inside/s0718.o"(.text)
        "*/games/tla/src/scene/gaia_rock_inside/s0748.o"(.text)
        "*/games/tla/src/field/field_effect/advance_motion_priority.o"(.text)
        "*/games/tla/src/scene/gaia_rock_inside/s07f4.o"(.text)
        "*/games/tla/src/scene/gaia_rock_inside/s08b4.o"(.text)
        "*/games/tla/src/scene/gaia_rock_inside/s0900.o"(.text)
        "*/games/tla/src/scene/gaia_rock_inside/s0a60.o"(.text)
        "*/games/tla/src/scene/gaia_rock_inside/s0b6c.o"(.text)
        "*/games/tla/src/scene/gaia_rock_inside/s0c38.o"(.text)
        "*/games/tla/src/scene/gaia_rock_inside/s0cd8.o"(.text)
        "*/games/tla/src/scene/gaia_rock_inside/s0cf8.o"(.text)
        "*/games/tla/src/scene/gaia_rock_inside/s0d18.o"(.text)
        "*/games/tla/src/scene/gaia_rock_inside/s0edc.o"(.text)
        "*/games/tla/src/scene/gaia_rock_inside/s0f00.o"(.text)
        "*/games/tla/src/scene/gaia_rock_inside/s0fac.o"(.text)
        "*/games/tla/src/scene/gaia_rock_inside/s1048.o"(.text)
        "*/games/tla/src/scene/gaia_rock_inside/s11c8.o"(.text)
        "*/games/tla/src/scene/gaia_rock_inside/s12ac.o"(.text)
        "*/games/tla/src/scene/gaia_rock_inside/s1314.o"(.text)
        "*/games/tla/src/scene/gaia_rock_inside/s136c.o"(.text)
        "*/games/tla/src/scene/gaia_rock_inside/s142c.o"(.text)
        "*/games/tla/src/scene/gaia_rock_inside/s14d0.o"(.text)
        "*/games/tla/src/scene/gaia_rock_inside/s1548.o"(.text)
        "*/games/tla/src/scene/gaia_rock_inside/s15d0.o"(.text)
        "*/games/tla/src/scene/gaia_rock_inside/s19cc.o"(.text)
        "*/games/tla/src/scene/gaia_rock_inside/advance.o"(.text)
        "*/games/tla/src/scene/gaia_rock_inside/s1c9c.o"(.text)
        "*/games/tla/src/scene/gaia_rock_inside/s1d14.o"(.text)
        "*/games/tla/src/scene/gaia_rock_inside/s1ebc.o"(.text)
        "*/games/tla/src/scene/gaia_rock_inside/s1f68.o"(.text)
        "*/games/tla/src/scene/gaia_rock_inside/s1f84.o"(.text)
        "*/games/tla/src/scene/gaia_rock_inside/s1fa0.o"(.text)
        "*/games/tla/src/scene/gaia_rock_inside/s2020.o"(.text)
        "*/games/tla/src/scene/gaia_rock_inside/s225c.o"(.text)
        "*/games/tla/src/scene/gaia_rock_inside/s2974.o"(.text)
        "*/games/tla/src/scene/gaia_rock_inside/s2a14.o"(.text)
        "*/games/tla/src/scene/gaia_rock_inside/s2a24.o"(.text)
        "*/games/tla/src/scene/gaia_rock_inside/s2a34.o"(.text)
        "*/games/tla/src/scene/gaia_rock_inside/s2a44.o"(.text)
        "*/games/tla/src/scene/gaia_rock_inside/s2ac8.o"(.text)
        "*/games/tla/src/scene/gaia_rock_inside/s2b04.o"(.text)
        "*/games/tla/src/scene/gaia_rock_inside/s2b58.o"(.text)
        "*/games/tla/src/scene/gaia_rock_inside/s2b8c.o"(.text)
        "*/games/tla/src/scene/gaia_rock_inside/s2cb4.o"(.text)
        "*/games/tla/src/scene/gaia_rock_inside/s2d30.o"(.text)
        "*/games/tla/src/scene/gaia_rock_inside/s2f30.o"(.text)
        "*/games/tla/src/scene/gaia_rock_inside/s4274.o"(.text)
        "*/resource_681_overlay.o"(.text.x0200c280)
        "*/resource_681_overlay.o"(.text.x0200c4f8)
        "*/games/tla/src/scene/gaia_rock_inside/s485c.o"(.text)
        "*/games/tla/src/scene/gaia_rock_inside/s48a0.o"(.text)
        "*/games/tla/src/scene/gaia_rock_inside/s4904.o"(.text)
        "*/games/tla/src/scene/gaia_rock_inside/s495c.o"(.text)
        "*/games/tla/src/scene/gaia_rock_inside/s49e4.o"(.text)
        "*/games/tla/src/scene/gaia_rock_inside/s4a5c.o"(.text)
        "*/games/tla/src/scene/gaia_rock_inside/s4af0.o"(.text)
        "*/games/tla/src/scene/gaia_rock_inside/s4d00.o"(.text)
        "*/games/tla/src/scene/gaia_rock_inside/import.o"(.text)
        "*/games/tla/src/scene/gaia_rock_inside/data.o"(.data)
    }
    .bss : { "*/resource_681_overlay.o"(.bss) }
    /DISCARD/ : { *(.ARM.attributes) *(.comment) *(.note*) }
}
