SECTIONS
{
    .text 0x2008000 :
    {
        "*/games/tla/src/scene/airs_rock_inside/entry.o"(.text)
        "*/resource_664_overlay.o"(.text.x02008038)
        "*/resource_664_overlay.o"(.text.x020080a4)
        "*/games/tla/src/scene/airs_rock_inside/s0128.o"(.text)
        "*/games/tla/src/field/object/set_sprite_priority.o"(.text)
        "*/resource_664_overlay.o"(.text.x02008216)
        "*/games/tla/src/field/object/prepare_object.o"(.text)
        "*/resource_664_overlay.o"(.text.x02008266)
        "*/games/tla/src/scene/airs_rock_inside/object.o"(.text)
        "*/games/tla/src/field/field_effect/move.o"(.text)
        "*/resource_664_overlay.o"(.text.x020082f2)
        "*/games/tla/src/scene/airs_rock_inside/s02f4.o"(.text)
        "*/games/tla/src/scene/airs_rock_inside/s0550.o"(.text)
        "*/games/tla/src/scene/airs_rock_inside/map_cell.o"(.text)
        "*/games/tla/src/field/object/wait_until_idle.o"(.text)
        "*/resource_664_overlay.o"(.text.x0200868e)
        "*/games/tla/src/scene/airs_rock_inside/cell_get.o"(.text)
        "*/games/tla/src/scene/airs_rock_inside/s06cc.o"(.text)
        "*/games/tla/src/scene/airs_rock_inside/s07b4.o"(.text)
        "*/resource_664_overlay.o"(.text.x02008908)
        "*/resource_664_overlay.o"(.text.x02008988)
        "*/games/tla/src/scene/airs_rock_inside/dist.o"(.text)
        "*/resource_664_overlay.o"(.text.x02008d48)
        "*/resource_664_overlay.o"(.text.x02008f34)
        "*/games/tla/src/scene/airs_rock_inside/s1084.o"(.text)
        "*/resource_664_overlay.o"(.text.x020090b4)
        "*/resource_664_overlay.o"(.text.x02009290)
        "*/games/tla/src/scene/airs_rock_inside/s1420.o"(.text)
        "*/resource_664_overlay.o"(.text.x02009458)
        "*/games/tla/src/scene/airs_rock_inside/s160c.o"(.text)
        "*/resource_664_overlay.o"(.text.x02009690)
        "*/games/tla/src/scene/airs_rock_inside/s17f4.o"(.text)
        "*/resource_664_overlay.o"(.text.x02009828)
        "*/games/tla/src/scene/airs_rock_inside/placements.o"(.text)
        "*/games/tla/src/scene/airs_rock_inside/scene_tables.o"(.text)
        "*/games/tla/src/scene/airs_rock_inside/s2604.o"(.text)
        "*/resource_664_overlay.o"(.text.x0200a6c0)
        "*/games/tla/src/scene/airs_rock_inside/s2770.o"(.text)
        "*/resource_664_overlay.o"(.text.x0200a790)
        "*/resource_664_overlay.o"(.text.x0200a898)
        "*/games/tla/src/scene/airs_rock_inside/s2980.o"(.text)
        "*/resource_664_overlay.o"(.text.x0200aaa8)
        "*/resource_664_overlay.o"(.text.x0200ab58)
        "*/games/tla/src/scene/airs_rock_inside/s2bd0.o"(.text)
        "*/games/tla/src/scene/airs_rock_inside/s2c40.o"(.text)
        "*/games/tla/src/scene/airs_rock_inside/s2cc0.o"(.text)
        "*/games/tla/src/scene/airs_rock_inside/s2cf0.o"(.text)
        "*/games/tla/src/scene/airs_rock_inside/s3170.o"(.text)
        "*/games/tla/src/scene/airs_rock_inside/s3254.o"(.text)
        "*/games/tla/src/scene/airs_rock_inside/s332c.o"(.text)
        "*/games/tla/src/scene/airs_rock_inside/s3654.o"(.text)
        "*/games/tla/src/scene/airs_rock_inside/s3ac4.o"(.text)
        "*/games/tla/src/scene/airs_rock_inside/s3b08.o"(.text)
        "*/resource_664_overlay.o"(.text.x0200bb7c)
        "*/games/tla/src/scene/airs_rock_inside/s3cac.o"(.text)
        "*/games/tla/src/scene/airs_rock_inside/s3d40.o"(.text)
        "*/games/tla/src/scene/airs_rock_inside/s3dd4.o"(.text)
        "*/resource_664_overlay.o"(.text.x0200bed4)
        "*/resource_664_overlay.o"(.text.x0200bf94)
        "*/games/tla/src/scene/airs_rock_inside/s4038.o"(.text)
        "*/resource_664_overlay.o"(.text.x0200c0b0)
        "*/resource_664_overlay.o"(.text.x0200c138)
        "*/games/tla/src/scene/airs_rock_inside/s4740.o"(.text)
        "*/games/tla/src/scene/airs_rock_inside/s4884.o"(.text)
        "*/resource_664_overlay.o"(.text.x0200c8c4)
        "*/games/tla/src/scene/airs_rock_inside/s4ab8.o"(.text)
        "*/games/tla/src/scene/airs_rock_inside/s4bb4.o"(.text)
        "*/resource_664_overlay.o"(.text.x0200ccc8)
        "*/resource_664_overlay.o"(.text.x0200ceb0)
        "*/resource_664_overlay.o"(.text.x0200cf3c)
        "*/games/tla/src/field/field_effect/advance_motion.o"(.text)
        "*/resource_664_overlay.o"(.text.x0200d05a)
        "*/resource_664_overlay.o"(.text.x0200d05c)
        "*/resource_664_overlay.o"(.text.x0200d1f8)
        "*/games/tla/src/scene/airs_rock_inside/s5cb8.o"(.text)
        "*/games/tla/src/scene/airs_rock_inside/import.o"(.text)
        "*/games/tla/src/scene/airs_rock_inside/data.o"(.data)
    }
    .bss : { "*/resource_664_overlay.o"(.bss) }
    /DISCARD/ : { *(.ARM.attributes) *(.comment) *(.note*) }
}
