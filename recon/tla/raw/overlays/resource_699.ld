SECTIONS
{
    .text 0x2008000 :
    {
        "*/games/tla/src/scene/jupiter_lighthouse_basement/entry.o"(.text)
        "*/games/tla/src/scene/jupiter_lighthouse_basement/scene_tables.o"(.text)
        "*/games/tla/src/scene/jupiter_lighthouse_basement/s0054.o"(.text)
        "*/games/tla/src/scene/jupiter_lighthouse_basement/s01d8.o"(.text)
        "*/resource_699_overlay.o"(.text.x02008298)
        "*/resource_699_overlay.o"(.text.x02008324)
        "*/games/tla/src/scene/jupiter_lighthouse_basement/prepare.o"(.text)
        "*/games/tla/src/field/common/scene_set_arrival_flags.o"(.text)
        "*/games/tla/src/scene/jupiter_lighthouse_basement/s0414.o"(.text)
        "*/resource_699_overlay.o"(.text.x02008420)
        "*/games/tla/src/scene/jupiter_lighthouse_basement/lightset.o"(.text)
        "*/resource_699_overlay.o"(.text.x020085b4)
        "*/games/tla/src/scene/jupiter_lighthouse_basement/dist.o"(.text)
        "*/resource_699_overlay.o"(.text.x020087cc)
        "*/resource_699_overlay.o"(.text.x0200898c)
        "*/resource_699_overlay.o"(.text.x02008a64)
        "*/resource_699_overlay.o"(.text.x02008b04)
        "*/resource_699_overlay.o"(.text.x02008c94)
        "*/games/tla/src/scene/jupiter_lighthouse_basement/light.o"(.text)
        "*/games/tla/src/scene/jupiter_lighthouse_basement/lightcue.o"(.text)
        "*/games/tla/src/field/common/object/set_sprite_priority.o"(.text)
        "*/resource_699_overlay.o"(.text.x0200905a)
        "*/games/tla/src/field/common/effect/move.o"(.text)
        "*/resource_699_overlay.o"(.text.x02009092)
        "*/resource_699_overlay.o"(.text.x02009094)
        "*/resource_699_overlay.o"(.text.x0200925c)
        "*/resource_699_overlay.o"(.text.x02009388)
        "*/games/tla/src/scene/jupiter_lighthouse_basement/s15cc.o"(.text)
        "*/resource_699_overlay.o"(.text.x020096c4)
        "*/games/tla/src/field/common/effect/advance_motion.o"(.text)
        "*/resource_699_overlay.o"(.text.x0200985a)
        "*/resource_699_overlay.o"(.text.x0200985c)
        "*/resource_699_overlay.o"(.text.x020099f4)
        "*/resource_699_overlay.o"(.text.x02009aa4)
        "*/games/tla/src/scene/jupiter_lighthouse_basement/import.o"(.text)
        "*/games/tla/src/graphics/field/cached_a.o"(.rodata)
        "*/games/tla/src/graphics/field/cached_b.o"(.rodata)
        "*/games/tla/src/graphics/field/cached_c.o"(.rodata)
        "*/games/tla/src/scene/jupiter_lighthouse_basement/data.o"(.data)
    }
    .bss : { "*/resource_699_overlay.o"(.bss) }
    /DISCARD/ : { *(.ARM.attributes) *(.comment) *(.note*) }
}
