SECTIONS
{
    .text 0x2008000 :
    {
        "*/games/tla/src/scene/champa_cliff_caves/entry.o"(.text)
        "*/games/tla/src/scene/champa_cliff_caves/s0038.o"(.text)
        "*/games/tla/src/scene/champa_cliff_caves/scene_tables.o"(.text)
        "*/games/tla/src/scene/champa_cliff_caves/s0070.o"(.text)
        "*/games/tla/src/scene/champa_cliff_caves/warp.o"(.text)
        "*/games/tla/src/scene/champa_cliff_caves/s0208.o"(.text)
        "*/games/tla/src/scene/champa_cliff_caves/events.o"(.text)
        "*/games/tla/src/scene/champa_cliff_caves/s0464.o"(.text)
        "*/games/tla/src/scene/champa_cliff_caves/s04d4.o"(.text)
        "*/games/tla/src/scene/champa_cliff_caves/prepare.o"(.text)
        "*/games/tla/src/scene/champa_cliff_caves/s05e8.o"(.text)
        "*/resource_685_overlay.o"(.text.x02008734)
        "*/games/tla/src/scene/champa_cliff_caves/s0804.o"(.text)
        "*/games/tla/src/scene/champa_cliff_caves/s0978.o"(.text)
        "*/games/tla/src/scene/champa_cliff_caves/s0a34.o"(.text)
        "*/resource_685_overlay.o"(.text.x02008f48)
        "*/games/tla/src/scene/champa_cliff_caves/s1138.o"(.text)
        "*/resource_685_overlay.o"(.text.x0200915c)
        "*/games/tla/src/scene/champa_cliff_caves/s1774.o"(.text)
        "*/games/tla/src/scene/champa_cliff_caves/s29f8.o"(.text)
        "*/games/tla/src/scene/champa_cliff_caves/s2c88.o"(.text)
        "*/games/tla/src/scene/champa_cliff_caves/s2d34.o"(.text)
        "*/resource_685_overlay.o"(.text.x0200ade4)
        "*/games/tla/src/scene/champa_cliff_caves/s2f58.o"(.text)
        "*/games/tla/src/scene/champa_cliff_caves/s3078.o"(.text)
        "*/games/tla/src/scene/champa_cliff_caves/s3164.o"(.text)
        "*/games/tla/src/scene/champa_cliff_caves/s320c.o"(.text)
        "*/games/tla/src/scene/champa_cliff_caves/s32a4.o"(.text)
        "*/games/tla/src/scene/champa_cliff_caves/import.o"(.text)
        "*/games/tla/src/scene/champa_cliff_caves/data.o"(.data)
        "*/games/tla/src/graphics/field/pal685.o"(.rodata)
        "*/games/tla/src/scene/champa_cliff_caves/data2.o"(.data)
    }
    /DISCARD/ : { *(.ARM.attributes) *(.comment) *(.note*) }
}
