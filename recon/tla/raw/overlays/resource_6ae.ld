SECTIONS
{
    .text 0x2008000 :
    {
        "*/games/tla/src/scene/mars_lighthouse_aerie/entry.o"(.text)
        "*/games/tla/src/scene/mars_lighthouse_aerie/update_a.o"(.text)
        "*/games/tla/src/scene/mars_lighthouse_aerie/scene_tables.o"(.text)
        "*/games/tla/src/scene/mars_lighthouse_aerie/events_a.o"(.text)
        "*/games/tla/src/scene/mars_lighthouse_aerie/scene_events.o"(.text)
        "*/games/tla/src/scene/mars_lighthouse_aerie/s01d8.o"(.text)
        "*/games/tla/src/scene/mars_lighthouse_aerie/s0314.o"(.text)
        "*/games/tla/src/scene/mars_lighthouse_aerie/s0450.o"(.text)
        "*/games/tla/src/scene/mars_lighthouse_aerie/s04a4.o"(.text)
        "*/games/tla/src/scene/mars_lighthouse_aerie/arc.o"(.text)
        "*/games/tla/src/scene/mars_lighthouse_aerie/events_b.o"(.text)
        "*/games/tla/src/scene/mars_lighthouse_aerie/s065c.o"(.text)
        "*/games/tla/src/scene/mars_lighthouse_aerie/blink.o"(.text)
        "*/games/tla/src/scene/mars_lighthouse_aerie/s1f10.o"(.text)
        "*/games/tla/src/scene/mars_lighthouse_aerie/events_c.o"(.text)
        "*/games/tla/src/scene/mars_lighthouse_aerie/orbit.o"(.text)
        "*/games/tla/src/scene/mars_lighthouse_aerie/s326c.o"(.text)
        "*/games/tla/src/field/object/park_record.o"(.text)
        "*/games/tla/src/scene/mars_lighthouse_aerie/s3370.o"(.text)
        "*/games/tla/src/scene/mars_lighthouse_aerie/events_d.o"(.text)
        "*/games/tla/src/scene/mars_lighthouse_aerie/events_e.o"(.text)
        "*/games/tla/src/scene/mars_lighthouse_aerie/s3658.o"(.text)
        "*/games/tla/src/scene/mars_lighthouse_aerie/s3ff4.o"(.text)
        "*/games/tla/src/scene/mars_lighthouse_aerie/s4bc4.o"(.text)
        "*/games/tla/src/scene/mars_lighthouse_aerie/events_f.o"(.text)
        "*/games/tla/src/scene/mars_lighthouse_aerie/s4d50.o"(.text)
        "*/games/tla/src/scene/mars_lighthouse_aerie/events_g.o"(.text)
        "*/games/tla/src/scene/mars_lighthouse_aerie/s4e80.o"(.text)
        "*/games/tla/src/scene/mars_lighthouse_aerie/events_h.o"(.text)
        "*/games/tla/src/scene/mars_lighthouse_aerie/s4ef0.o"(.text)
        "*/games/tla/src/scene/mars_lighthouse_aerie/stop.o"(.text)
        "*/games/tla/src/scene/mars_lighthouse_aerie/s508c.o"(.text)
        "*/games/tla/src/scene/mars_lighthouse_aerie/s50b0.o"(.text)
        "*/games/tla/src/scene/mars_lighthouse_aerie/s51e0.o"(.text)
        "*/games/tla/src/scene/mars_lighthouse_aerie/s5268.o"(.text)
        "*/games/tla/src/scene/mars_lighthouse_aerie/s53e4.o"(.text)
        "*/games/tla/src/scene/mars_lighthouse_aerie/mark.o"(.text)
        "*/games/tla/src/scene/mars_lighthouse_aerie/import.o"(.text)
        "*/games/tla/src/scene/mars_lighthouse_aerie/data.o"(.data)
    }
    .bss : { "*/resource_6ae_overlay.o"(.bss) }
    /DISCARD/ : { *(.ARM.attributes) *(.comment) *(.note*) }
}
