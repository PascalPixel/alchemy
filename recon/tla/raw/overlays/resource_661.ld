SECTIONS
{
    .text 0x2008000 :
    {
        "*/games/tla/src/scene/yampi_desert/entry.o"(.text)
        "*/games/tla/src/field/object/set_sprite_priority.o"(.text)
        "*/games/tla/src/field/field_effect/move.o"(.text)
        "*/games/tla/src/scene/yampi_desert/s00b8.o"(.text)
        "*/games/tla/src/scene/yampi_desert/placements.o"(.text)
        "*/games/tla/src/scene/yampi_desert/scene_tables.o"(.text)
        "*/games/tla/src/scene/yampi_desert/s02f8.o"(.text)
        "*/games/tla/src/scene/yampi_desert/s03b8.o"(.text)
        "*/games/tla/src/scene/yampi_desert/s03c8.o"(.text)
        "*/games/tla/src/scene/yampi_desert/s04bc.o"(.text)
        "*/games/tla/src/scene/yampi_desert/s04e0.o"(.text)
        "*/games/tla/src/scene/yampi_desert/s0550.o"(.text)
        "*/games/tla/src/scene/yampi_desert/s05a8.o"(.text)
        "*/games/tla/src/scene/yampi_desert/signs.o"(.text)
        "*/games/tla/src/scene/yampi_desert/s06ac.o"(.text)
        "*/games/tla/src/scene/yampi_desert/s07e0.o"(.text)
        "*/games/tla/src/scene/yampi_desert/s0918.o"(.text)
        "*/games/tla/src/scene/yampi_desert/s0994.o"(.text)
        "*/games/tla/src/scene/yampi_desert/s0a10.o"(.text)
        "*/games/tla/src/scene/yampi_desert/s0a8c.o"(.text)
        "*/games/tla/src/field/field_effect/advance_motion_priority.o"(.text)
        "*/games/tla/src/scene/yampi_desert/s0b84.o"(.text)
        "*/games/tla/src/scene/yampi_desert/s0c34.o"(.text)
        "*/games/tla/src/scene/yampi_desert/s0e78.o"(.text)
        "*/games/tla/src/scene/yampi_desert/s0fc8.o"(.text)
        "*/games/tla/src/scene/yampi_desert/s1288.o"(.text)
        "*/games/tla/src/scene/yampi_desert/s12d4.o"(.text)
        "*/games/tla/src/scene/yampi_desert/s12dc.o"(.text)
        "*/games/tla/src/scene/yampi_desert/s13f8.o"(.text)
        "*/games/tla/src/scene/yampi_desert/s1518.o"(.text)
        "*/games/tla/src/scene/yampi_desert/events_a.o"(.text)
        "*/games/tla/src/scene/yampi_desert/s1690.o"(.text)
        "*/games/tla/src/scene/yampi_desert/s1b70.o"(.text)
        "*/games/tla/src/scene/yampi_desert/s1bec.o"(.text)
        "*/games/tla/src/scene/yampi_desert/s1c5c.o"(.text)
        "*/games/tla/src/scene/yampi_desert/s1cc4.o"(.text)
        "*/games/tla/src/scene/yampi_desert/s1e58.o"(.text)
        "*/games/tla/src/scene/yampi_desert/s2010.o"(.text)
        "*/games/tla/src/scene/yampi_desert/s20a8.o"(.text)
        "*/games/tla/src/scene/yampi_desert/s20e4.o"(.text)
        "*/games/tla/src/scene/yampi_desert/s2140.o"(.text)
        "*/games/tla/src/scene/yampi_desert/s2180.o"(.text)
        "*/games/tla/src/scene/yampi_desert/events_b.o"(.text)
        "*/games/tla/src/scene/yampi_desert/s21f0.o"(.text)
        "*/games/tla/src/scene/yampi_desert/s2208.o"(.text)
        "*/games/tla/src/scene/yampi_desert/s2318.o"(.text)
        "*/games/tla/src/scene/yampi_desert/s23cc.o"(.text)
        "*/games/tla/src/scene/yampi_desert/s26a0.o"(.text)
        "*/games/tla/src/scene/yampi_desert/s2764.o"(.text)
        "*/games/tla/src/scene/yampi_desert/s2b84.o"(.text)
        "*/games/tla/src/scene/yampi_desert/s2c6c.o"(.text)
        "*/games/tla/src/scene/yampi_desert/events_c.o"(.text)
        "*/games/tla/src/scene/yampi_desert/s2d6c.o"(.text)
        "*/games/tla/src/scene/yampi_desert/s2e14.o"(.text)
        "*/games/tla/src/scene/yampi_desert/s2e98.o"(.text)
        "*/games/tla/src/scene/yampi_desert/s2ebc.o"(.text)
        "*/games/tla/src/scene/yampi_desert/s3094.o"(.text)
        "*/games/tla/src/scene/yampi_desert/prepare.o"(.text)
        "*/games/tla/src/scene/yampi_desert/s316c.o"(.text)
        "*/games/tla/src/scene/yampi_desert/events_d.o"(.text)
        "*/games/tla/src/scene/yampi_desert/s3364.o"(.text)
        "*/games/tla/src/scene/yampi_desert/s35b8.o"(.text)
        "*/games/tla/src/scene/yampi_desert/s36d0.o"(.text)
        "*/games/tla/src/scene/yampi_desert/events_e.o"(.text)
        "*/games/tla/src/scene/yampi_desert/s3820.o"(.text)
        "*/games/tla/src/scene/yampi_desert/s388c.o"(.text)
        "*/games/tla/src/scene/yampi_desert/s3910.o"(.text)
        "*/games/tla/src/scene/yampi_desert/s39b8.o"(.text)
        "*/games/tla/src/scene/yampi_desert/s3b80.o"(.text)
        "*/games/tla/src/scene/yampi_desert/s3da0.o"(.text)
        "*/games/tla/src/scene/yampi_desert/s3e3c.o"(.text)
        "*/games/tla/src/scene/yampi_desert/import.o"(.text)
        "*/games/tla/src/scene/yampi_desert/data.o"(.data)
        "*/games/tla/src/graphics/field/tiles64d.o"(.rodata)
        "*/games/tla/src/scene/yampi_desert/data2.o"(.data)
    }
    /DISCARD/ : { *(.ARM.attributes) *(.comment) *(.note*) }
}
