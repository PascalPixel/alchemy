EXTERN(_call_via_r0)
SECTIONS
{
    .text 0x2008000 :
    {
        "*/games/THE BROKEN SEAL/SRC/FIELD/KOROSSEO_MARUTA/ENTRY.o"(.text)
        "*/games/THE BROKEN SEAL/SRC/FIELD/KOROSSEO_MARUTA/HOOKS.o"(.text)
        "*/games/THE BROKEN SEAL/SRC/FIELD/KOROSSEO_MARUTA/MARUTA.o"(.text)
        "*/games/THE BROKEN SEAL/SRC/FIELD/KOROSSEO_MARUTA/ACTOR_MOTION.o"(.text)
        "*/games/THE BROKEN SEAL/SRC/FIELD/COMMON/KOROSSEO/SOLO_COMPETITOR.o"(.text)
        "*/games/THE BROKEN SEAL/SRC/FIELD/KOROSSEO_MARUTA/OBSTACLE.o"(.text)
        "*/games/THE BROKEN SEAL/SRC/FIELD/COMMON/KOROSSEO/SOLO_ROUND.o"(.text)
        "*/games/THE BROKEN SEAL/SRC/FIELD/KOROSSEO_MARUTA/INTERACT.o"(.text)
        "*/games/THE BROKEN SEAL/SRC/FIELD/COMMON/KOROSSEO/KOROSSEO.o"(.text)
        "*/games/THE BROKEN SEAL/SRC/FIELD/KOROSSEO_MARUTA/TRANSITION.o"(.text)
        "*/games/THE BROKEN SEAL/SRC/FIELD/COMMON/KOROSSEO/COMPETE.o"(.text)
        "*/games/THE BROKEN SEAL/SRC/FIELD/KOROSSEO_MARUTA/MOTION_RESET.o"(.text)
        "*/games/THE BROKEN SEAL/SRC/FIELD/COMMON/KOROSSEO/MARKER.o"(.text)
        "*/games/THE BROKEN SEAL/SRC/FIELD/KOROSSEO_MARUTA/PALETTE_TASK.o"(.text)
        "*/games/THE BROKEN SEAL/SRC/FIELD/COMMON/KOROSSEO/ITEM_ICON.o"(.text)
        "*/games/THE BROKEN SEAL/SRC/FIELD/KOROSSEO_MARUTA/EFFECT.o"(.text)
        "*/games/THE BROKEN SEAL/SRC/FIELD/COMMON/KOROSSEO/PATH_RIVAL.o"(.text)
        "*/games/THE BROKEN SEAL/SRC/FIELD/KOROSSEO_MARUTA/CONTROL.o"(.text)
        "*/games/THE BROKEN SEAL/SRC/FIELD/COMMON/KOROSSEO/SCENE_STATE.o"(.text)
        "*/games/THE BROKEN SEAL/SRC/FIELD/KOROSSEO_MARUTA/PUSH.o"(.text)
        "*/games/THE BROKEN SEAL/SRC/FIELD/KOROSSEO_MARUTA/IMPORT.o"(.text)
        *libgcc.a:_call_via_rX.o(.text)
        "*/games/THE BROKEN SEAL/SRC/FIELD/KOROSSEO_MARUTA/DATA.o"(.data)
        "*/games/THE BROKEN SEAL/SRC/GRAPHICS/KOROSSEO/GAUGE.o"(.rodata)
        "*/games/THE BROKEN SEAL/SRC/FIELD/KOROSSEO_MARUTA/DATA2.o"(.data)
    }
    .bss (NOLOAD) : { "*/resource_3bc_overlay.o"(.bss) }
    /DISCARD/ : { *(.ARM.attributes) *(.comment) *(.note*) }
}
