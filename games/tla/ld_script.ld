/* The Lost Age, all six editions: the one linker script, run through the C
   preprocessor with -DTLA_EDITION_<LANG>=1 as the C is. version.h gives it
   LANGUAGE and the patch levels, so an edition's differences here are the
   same tests the C makes.

   The build preprocesses it once for the main image, and once for each
   overlay with OVERLAY defined as the overlay's number; it reads each
   image's objects from the statements below, in order, and links them in
   that order.

   The main image lists its objects in the order the Game Pak holds them;
   each statement names the sections of its object it places there. */
#include "version.h"

/* The shift test (make SHIFT=n) moves everything after the header n bytes,
   so every bank starts n bytes later; 0 in every other build. */
#ifndef ROM_SHIFT
#define ROM_SHIFT 0
#endif
#if ROM_SHIFT % 4 != 0
#error "SHIFT must be a multiple of 4: words and Thumb literal pools in byte-aligned sections would misalign"
#endif

/* Where the far-call banks that move start, in each edition. English and
   Italian share every address; Japanese and French share the last ones
   with them. The other banks start at the same address in every edition. */
#if LANGUAGE == LANGUAGE_JAPANESE
#define GAME_BANK_START           0x080a8000
#define FIELD_SEQUENCE_BANK_START 0x080c8000
#define MENU_BANK_START           0x080f8000
#define SHOP_BANK_START           0x08108000
#elif LANGUAGE == LANGUAGE_GERMAN
#define GAME_BANK_START           0x080ba000
#define FIELD_SEQUENCE_BANK_START 0x080d5000
#define MENU_BANK_START           0x08102000
#define SHOP_BANK_START           0x08110000
#elif LANGUAGE == LANGUAGE_SPANISH
#define GAME_BANK_START           0x080b6000
#define FIELD_SEQUENCE_BANK_START 0x080d1000
#define MENU_BANK_START           0x080fe000
#define SHOP_BANK_START           0x0810c000
#elif LANGUAGE == LANGUAGE_FRENCH
#define GAME_BANK_START           0x080b2000
#define FIELD_SEQUENCE_BANK_START 0x080cd000
#define MENU_BANK_START           0x080fa000
#define SHOP_BANK_START           0x08108000
#else
#define GAME_BANK_START           0x080ad000
#define FIELD_SEQUENCE_BANK_START 0x080c8000
#define MENU_BANK_START           0x080f8000
#define SHOP_BANK_START           0x08108000
#endif

#ifdef OVERLAY
#include "src/system/overlay/overlay.ld"
#else
OUTPUT_ARCH(arm)
ENTRY(Entry)
Decompress_MoveToFrontLzCommandsCodeSize = Decompress_MoveToFrontLzCommandsEnd - Decompress_MoveToFrontLzCommandsCode;
Tile_Decompress4bppCodeSize = Tile_Decompress4bppEnd - Tile_Decompress4bppCode;
Tile_ExpandMaskedCodeSize = Tile_ExpandMaskedEnd - Tile_ExpandMaskedCode;
Tile_ExpandOpaqueCodeSize = Tile_ExpandOpaqueEnd - Tile_ExpandOpaqueCode;
ScanlineWindow_BuildSpansCodeSize = Tile_Decompress4bppCode - ScanlineWindow_BuildSpansCode;
Glyph_DrawCodeSize = ScanlineWindow_BuildSpansCode - Glyph_DrawCode;
BattleEffect_DecodePictureBlockSize = BattleEffect_DecodePictureEnd - BattleEffect_DecodePictureCode;
Render_DecodePictureBlockSize = Render_DecodePictureEnd - Render_DecodePictureCode;
Text_DecodeSymbolCodeSize = Text_DecodeSymbolEnd - Text_DecodeSymbolCode;
Credits_DecodeBackgroundCodeSize = EndingImage_InnerProduct - Credits_DecodeBackgroundCode;
EndingImage_DecodeCodeSize = EndingImage_DecodeEnd - EndingImage_DecodeCode;
Model_DecodeCodeSize = Model_DecodeEnd - Model_DecodeCode;
Grid_DrawOutlineCodeSize = Resource_GetMetadataRecordFar - Grid_DrawOutlineCode;
WorldMap_UpdateAffineLinesCodeSize = Render_ConvertMapCode - WorldMap_UpdateAffineLinesCode;

MEMORY
{
    EWRAM (rwx) : ORIGIN = 0x2000000, LENGTH = 256K
    IWRAM (rwx) : ORIGIN = 0x3000000, LENGTH = 32K
    ROM    (rx) : ORIGIN = 0x8000000, LENGTH = 32M
}
SECTIONS
{
    ewram (NOLOAD) :
    {
        "*/games/tla/src/system/ewram.o"(.sym_ewram)
    } > EWRAM
    .rom_start :
    {
        "*/games/tla/src/gamepak/rom_header.o"(.text .rodata .data .padding)
        "*/games/tla/src/gamepak/far_call/system.o"(.text .rodata .data .padding)
        "*/games/tla/src/system/entry.o"(.text .padding .text.resampler_records_2 .padding.resampler_records_pad_1 .text.resampler_records_3 .padding.resampler_records_pad_2 .text.resampler_records_4)
        "*/games/tla/src/sound/channel_update_entry.o"(.text)
    } > ROM
    iwram_slots 0x3000000 (NOLOAD) :
    {
        "*/games/tla/src/system/iwram.o"(.sym_iwram_slots)
    } > IWRAM
    .iwram_resident 0x3000100 :
    {
        "*/games/tla/src/system/irq.o"(.text .rodata .data .padding)
        "*/games/tla/src/system/irq_table.o"(.data)
        "*/games/tla/src/system/iwram_routines.o"(.text .data .text.iwram_divide)
        "*/games/tla/src/sound/resident_mixer.o"(.text .text.resident_mixer_lanes)
        "*/games/tla/src/sound/resident_mixer_interpolate.o"(.data .text.resident_mixer_channel)
        "*/games/tla/src/sound/resident_mixer_render.o"(.data .text.resident_mixer_render)
    } > IWRAM AT>ROM
    iwram (NOLOAD) :
    {
        "*/games/tla/src/system/iwram.o"(.sym_iwram)
    } > IWRAM
    .rom_main :
    {
        "*/games/tla/src/system/decompress_byte_lz.o"(.text)
        "*/games/tla/src/system/iwram_entry.o"(.text .rodata .data .padding)
        "*/games/tla/src/system/trig.o"(.text .text.trig .rodata .rodata.reciprocal_table)
        "*/games/tla/src/system/decompress_tagged_lz.o"(.text .rodata .text.decode_2_loop)
        "*/games/tla/src/system/heap_release.o"(.text)
        "*/games/tla/src/system/system.o"(.text)
        "*/games/tla/src/system/bios.o"(.text .padding .text.bios_sound_bias_on)
        "*/games/tla/src/gamepak/flash/flash.o"(.text)
        "*/games/tla/src/gamepak/flash/sst.o"(.text)
        "*/games/tla/src/gamepak/flash/program_flash_sector.o"(.text)
        "*/games/tla/src/gamepak/flash/atmel.o"(.text)
        "*libgcc.a:_call_via_rX.o"(.text)
        "*/games/tla/src/system/irq_table.o"(.rodata)
        "*/games/tla/src/system/math_table.o"(.rodata)
        "*/games/tla/src/graphics/palettes/palettes.o"(.rodata)
        "*/games/tla/src/system/number_text.o"(.rodata)
        "*/games/tla/src/system/inner_product.o"(.text .rodata .data .padding)
        "*/games/tla/src/system/savedata.o"(.rodata)
        "*/games/tla/src/gamepak/flash/flashtab.o"(.rodata)
        "*/games/tla/src/gamepak/flash/flash.o"(.rodata)
        "*/games/tla/src/gamepak/flash/flashsst.o"(.rodata)
        "*/games/tla/src/gamepak/flash/sst.o"(.rodata)
        "*/games/tla/src/gamepak/flash/flashmx.o"(.rodata)
        "*/games/tla/src/gamepak/flash/program_flash_sector.o"(.rodata)
        "*/games/tla/src/gamepak/flash/flashat.o"(.rodata)
        "*/games/tla/src/gamepak/flash/atmel.o"(.rodata)
        . = ABSOLUTE(ROM_SHIFT + 0x08020000);
        "*/games/tla/src/gamepak/far_call/field.o"(.text .rodata .data .padding)
        "*/games/tla/src/field/sprite_color_tables.o"(.rodata)
        "*/games/tla/src/field/picture_decode.o"(.text .rodata .data .padding)
        "*/games/tla/src/field/picture_decode_data.o"(.text .rodata .data .padding)
        "*/games/tla/src/field/draw_map.o"(.text .rodata .data .padding)
        "*/games/tla/src/field/world_map_scanlines.o"(.text)
        "*/games/tla/src/field/world_map_lines_entry.o"(.text)
        "*/games/tla/src/field/world_map_lines.o"(.text)
        "*/games/tla/src/field/world_map_lines_call_thumb.o"(.text .rodata .data .padding)
        "*/games/tla/src/field/map_grid_convert.o"(.text .rodata .data .padding)
        "*/games/tla/src/field/copy_strided.o"(.text .rodata .data .padding)
        "*/games/tla/src/field/grid_outline_entry.o"(.text)
        "*/games/tla/src/field/grid_outline.o"(.text)
        "*/games/tla/src/field/field.o"(.text)
        "*/games/tla/src/field/animdata.o"(.rodata)
        "*/games/tla/src/field/facing.o"(.rodata)
        "*/games/tla/src/field/terrain_tables.o"(.data)
        "*/games/tla/src/field/map_grid_data.o"(.rodata)
        . = ABSOLUTE(ROM_SHIFT + 0x08038000);
        "*/games/tla/src/gamepak/far_call/window.o"(.text .rodata .data .padding)
        "*/games/tla/src/window/message_decode.o"(.text .rodata .data .padding)
        "*/games/tla/src/window/lookup_symbol.o"(.text .rodata .data .padding)
        "*/games/tla/src/window/glyph_arm_entries.o"(.text)
        "*/games/tla/src/window/glyph_arm.o"(.text)
        "*/games/tla/src/window/window_spans_entries.o"(.text)
        "*/games/tla/src/window/window_spans.o"(.text)
        "*/games/tla/src/window/decompress_4bpp.o"(.text .rodata .data .padding)
        "*/games/tla/src/window/decompress_4bpp_loop.o"(.text .rodata .data .padding)
        "*/games/tla/src/window/expand_masked.o"(.text .rodata .data .padding)
        "*/games/tla/src/window/expand_opaque.o"(.text .rodata .data .padding)
        "*/games/tla/src/window/window.o"(.text)
        "*/games/tla/src/window/screens.o"(.text)
        "*/games/tla/src/graphics/ui/slider.o"(.rodata)
        "*/games/tla/src/graphics/ui/marks.o"(.rodata)
        "*/games/tla/src/graphics/ui/menu_icons.o"(.rodata)
        "*/games/tla/src/graphics/ui/pointing_hand.o"(.rodata)
        "*/games/tla/src/graphics/ui/menu_titles.o"(.rodata)
        "*/games/tla/src/graphics/font/text.o"(.rodata)
        "*/games/tla/src/window/articles.o"(.rodata)
        "*/games/tla/src/graphics/ui/sprite_cursors.o"(.rodata)
        "*/games/tla/src/window/scales.o"(.rodata)
        "*/games/tla/src/graphics/ui/page_arrow.o"(.rodata)
        "*/games/tla/src/window/text_tables.o"(.rodata)
        "*/games/tla/src/window/progress.o"(.rodata)
        "*/games/tla/src/window/progress_bar_rows.o"(.rodata)
        "*/games/tla/src/window/screen_tables.o"(.rodata)
        "*/games/tla/src/window/shift_prompt.o"(.rodata)
        "*/games/tla/src/window/menu_title_tables.o"(.data)
        "*/games/tla/src/window/djinn_blink.o"(.rodata)
        "*/games/tla/src/window/status_tables.o"(.rodata)
        "*/games/tla/src/window/icon_menu_tables.o"(.data)
        "*/games/tla/src/window/debug_labels.o"(.rodata)
        "*/games/tla/text/messages.o"(.rodata)
        /* Only German and Italian link the item genders, each its own table. */
#if LANGUAGE == LANGUAGE_GERMAN || LANGUAGE == LANGUAGE_ITALIAN
        "*/games/tla/src/window/item_genders.o"(.rodata)
#endif
        "*/games/tla/src/window/text_speed.o"(.rodata)
        /* Only German links the counted nouns: their own object, since its table
           is word-aligned while the text speeds before it start at an odd
           address, which no one section holding both can do. */
#if LANGUAGE == LANGUAGE_GERMAN
        "*/games/tla/src/window/counted_nouns.o"(.rodata)
#endif
        "*/games/tla/src/graphics/ui/slider_palette.o"(.rodata)
        "*/games/tla/src/window/debug_tables.o"(.rodata)
        "*/games/tla/src/window/keyboard.o"(.rodata)
        "*/games/tla/src/window/fixed_tile_blocks.o"(.data)
        . = ABSOLUTE(ROM_SHIFT + GAME_BANK_START);
        "*/games/tla/src/gamepak/far_call/game.o"(.text .rodata .data .padding)
        "*/games/tla/src/game/game.o"(.text)
        "*/games/tla/src/game/game.o"(.rodata)
        . = ABSOLUTE(ROM_SHIFT + FIELD_SEQUENCE_BANK_START);
        "*/games/tla/src/gamepak/far_call/field_sequence.o"(.text .rodata .data .padding)
        "*/games/tla/src/field/advance_with_gravity.o"(.text .rodata .data .padding)
        "*/games/tla/src/field/field_sequence_sprite_color_tables.o"(.rodata)
        "*/games/tla/src/field/decode_picture.o"(.text .rodata .data .padding)
        "*/games/tla/src/field/decode_picture_data.o"(.text .rodata .data .padding)
        "*/games/tla/src/system/main_routine.o"(.text)
        "*/games/tla/src/field/field_sequence.o"(.text)
        "*/games/tla/src/field/actor_step_angle.o"(.text)
        "*/games/tla/src/field/event_commands.o"(.text)
        "*/games/tla/src/field/field_effect_move.o"(.text)
        "*/games/tla/src/field/field_effect_spawn_resident.o"(.text)
        "*/games/tla/src/field/field_effect_advance_motion.o"(.text)
        "*/games/tla/src/field/field_psynergy.o"(.text)
        "*/games/tla/src/graphics/field_effects/field_effects.o"(.rodata)
        "*/games/tla/src/field/arrow_glint.o"(.rodata)
        "*/games/tla/src/field/encounter_zones.o"(.rodata)
        "*/games/tla/src/field/encounter_rules.o"(.rodata)
        "*/games/tla/src/field/world_map_encounter_rules.o"(.rodata)
        "*/games/tla/src/field/cue_rules.o"(.rodata)
        "*/games/tla/src/field/area_name_rules.o"(.rodata)
        "*/games/tla/src/field/scene_rules.o"(.rodata)
        "*/games/tla/src/graphics/palette_editor/swatch.o"(.rodata)
        "*/games/tla/src/field/field_sequence_tables.o"(.rodata)
        "*/games/tla/src/field/psynergy_reach.o"(.rodata)
        "*/games/tla/src/field/field_effect_scripts.o"(.rodata)
        "*/games/tla/src/field/field_effect_scripts.o"(.data)
        "*/games/tla/src/field/actor_variant_motion.o"(.rodata)
        "*/games/tla/src/field/event_commands_tables.o"(.rodata)
        "*/games/tla/src/field/rope_vine_pictures.o"(.rodata)
        "*/games/tla/src/field/event_commands_scripts.o"(.rodata)
        "*/games/tla/src/field/field_effect_tables.o"(.rodata)
        "*/games/tla/src/field/burst_spark_palette.o"(.rodata)
        "*/games/tla/src/field/field_psynergy_tables.o"(.rodata)
        "*/games/tla/src/field/world_map_cursor_angles.o"(.rodata)
        "*/games/tla/src/field/world_map_places.o"(.rodata)
        "*/games/tla/src/field/scenes.o"(.rodata)
        "*/games/tla/src/field/actor_placement.o"(.rodata)
        "*/games/tla/src/field/scene_items.o"(.data)
        "*/games/tla/src/field/screen_transition_shapes.o"(.data)
        "*/games/tla/src/field/actor_scripts.o"(.rodata)
        "*/games/tla/src/field/field_effect_particles.o"(.rodata)
        "*/games/tla/src/field/field_effect_data.o"(.rodata)
        "*/games/tla/src/field/burst_glow.o"(.rodata)
        "*/games/tla/src/field/field_psynergy_lookups.o"(.rodata)
        . = ABSOLUTE(ROM_SHIFT + MENU_BANK_START);
        "*/games/tla/src/gamepak/far_call/menu.o"(.text .rodata .data .padding)
        "*/games/tla/src/menu/menu.o"(.text)
        "*/games/tla/src/graphics/ui/menu_sprites.o"(.rodata)
        "*/games/tla/src/menu/menu_strings.o"(.rodata)
        "*/games/tla/src/menu/menu_tables.o"(.data)
        . = ABSOLUTE(ROM_SHIFT + SHOP_BANK_START);
        "*/games/tla/src/gamepak/far_call/shop.o"(.text .rodata .data .padding)
        "*/games/tla/src/shop/shop.o"(.text)
        "*/games/tla/src/graphics/ui/shop_sprites.o"(.rodata)
        "*/games/tla/src/shop/shop_tables.o"(.rodata)
        . = ABSOLUTE(ROM_SHIFT + 0x08118000);
        "*/games/tla/src/gamepak/far_call/battle.o"(.text .rodata .data .padding)
        "*/games/tla/src/battle/model_decode.o"(.text .rodata .data .padding)
        "*/games/tla/src/battle/model_bit_dispatch.o"(.text .rodata .data .padding)
        "*/games/tla/src/battle/model_bit_commands.o"(.text .rodata .data .padding)
        "*/games/tla/src/battle/color_scale_kernel.o"(.text .rodata .data .padding)
        "*/games/tla/src/battle/color_scale_loader.o"(.text .rodata .data .padding)
        "*/games/tla/src/battle/battle.o"(.text)
        "*/games/tla/src/battle/battle_tables.o"(.rodata)
        "*/games/tla/src/battle/battle_tables.o"(.data)
        "*/games/tla/src/battle/ability_staging.o"(.rodata)
        "*/games/tla/src/battle/turn_end_tables.o"(.rodata)
        "*/games/tla/src/battle/element_glow_tables.o"(.rodata)
        "*/games/tla/src/battle/unused_portrait_pairs.o"(.rodata)
        "*/games/tla/src/graphics/ui/battle_message_arrow.o"(.rodata)
        "*/games/tla/src/battle/scripted_battle_units.o"(.data)
        "*/games/tla/src/battle/debug_parameter_sets.o"(.data)
        "*/games/tla/src/battle/battle_unit_tables.o"(.rodata)
        "*/games/tla/src/battle/battle_unit_tables.o"(.data)
        "*/games/tla/src/battle/knockback_tables.o"(.rodata)
        "*/games/tla/src/battle/action_weights.o"(.data)
        "*/games/tla/src/battle/transition/curtain.o"(.rodata)
        "*/games/tla/src/battle/highlight_tables.o"(.data)
        "*/games/tla/src/battle/formations.o"(.data)
        "*/games/tla/src/battle/battle_sprites.o"(.data)
        . = ABSOLUTE(ROM_SHIFT + 0x08138000);
        "*/games/tla/src/gamepak/far_call/battle_effect.o"(.text .rodata .data .padding)
        "*/games/tla/src/battle_effect/kernel_bank_advance_with_gravity.o"(.text .rodata .data .padding)
        "*/games/tla/src/battle_effect/render_fill_mesh_kernels.o"(.text .rodata .data .padding)
        "*/games/tla/src/battle_effect/render_solid_kernels.o"(.text .rodata .data .padding)
        "*/games/tla/src/battle_effect/render_textured_kernel.o"(.text .rodata .data .padding)
        "*/games/tla/src/battle_effect/render_textured_max_kernel.o"(.text .rodata .data .padding)
        "*/games/tla/src/battle_effect/render_textured_additive_kernel.o"(.text .rodata .data .padding)
        "*/games/tla/src/battle_effect/render_shaded_max_kernel.o"(.text .rodata .data .padding)
        "*/games/tla/src/battle_effect/render_shaded_additive_kernel.o"(.text .rodata .data .padding)
        "*/games/tla/src/battle_effect/render_shaded_kernel.o"(.text .rodata .data .padding)
        "*/games/tla/src/battle_effect/render_textured_narrow_kernel.o"(.text .rodata .data .padding)
        "*/games/tla/src/battle_effect/render_solid_narrow_and_transform_kernels.o"(.text .rodata .data .padding)
        "*/games/tla/src/battle_effect/battle_effect.o"(.text)
        "*/games/tla/src/battle_effect/effect_constants.o"(.rodata)
        "*/games/tla/src/battle_effect/blitter_fragments.o"(.text)
        "*/games/tla/src/battle_effect/blitter_color_fragments.o"(.text .rodata .data .padding)
        "*/games/tla/src/battle_effect/patch_template.o"(.text .rodata .data .padding)
        "*/games/tla/src/battle_effect/blitter_operands.o"(.rodata)
        "*/games/tla/src/battle_effect/effect_table.o"(.rodata)
        . = ABSOLUTE(ROM_SHIFT + 0x081a0000);
        "*/games/tla/src/gamepak/far_call/credits.o"(.text)
        "*/games/tla/src/menu/credits_background_decode.o"(.text .rodata .data .padding)
        "*/games/tla/src/menu/credits_background_expand.o"(.rodata)
        "*/games/tla/src/menu/credits_background_expand.o"(.text .data .text.credits_background_expand_commands)
        "*/games/tla/src/menu/ending_image_decode.o"(.text .rodata .data .padding)
        "*/games/tla/src/menu/ending_image_expand.o"(.rodata)
        "*/games/tla/src/menu/ending_image_expand.o"(.text .data .text.ending_image_expand_commands)
        "*/games/tla/src/menu/credits.o"(.text)
        "*/games/tla/src/menu/credits.o"(.rodata)
        "*/games/tla/src/menu/credits.o"(.data)
        "*/games/tla/src/graphics/credits/font.o"(.rodata)
        . = ABSOLUTE(ROM_SHIFT + 0x081a6000);
        "*/games/tla/src/gamepak/far_call/title.o"(.text)
        "*/games/tla/src/menu/title_intro.o"(.text)
        "*/games/tla/src/graphics/title/prompt.o"(.rodata)
        "*/games/tla/src/menu/logo.o"(.rodata)
        "*/games/tla/src/menu/title_intro_tables.o"(.rodata)
        "*/games/tla/src/menu/title_intro_tables.o"(.data)
        . = ABSOLUTE(ROM_SHIFT + 0x081ac000);
        "*/games/tla/src/gamepak/far_call/lucky_dice.o"(.text)
        "*/games/tla/src/field/lucky_dice.o"(.text)
        "*/games/tla/src/field/lucky_dice.o"(.rodata)
        . = ABSOLUTE(ROM_SHIFT + 0x081b2000);
        "*/games/tla/src/gamepak/far_call/lucky_wheels.o"(.text)
        "*/games/tla/src/field/lucky_wheels.o"(.text)
        "*/games/tla/src/field/lucky_wheels.o"(.rodata)
        . = ABSOLUTE(ROM_SHIFT + 0x081b8000);
        "*/games/tla/src/gamepak/far_call/super_lucky_dice.o"(.text)
        "*/games/tla/src/field/dice_game.o"(.text)
        "*/games/tla/src/field/dice_game.o"(.rodata)
        . = ABSOLUTE(ROM_SHIFT + 0x081c0000);
        "*/games/tla/src/gamepak/far_call/sound.o"(.text .rodata .data .padding)
        "*/games/tla/src/sound/leftover_driver.o"(.text)
        "*/games/tla/src/sound/dummy_func_work_copy.o"(.text)
        "*/games/tla/src/sound/player_work_copy.o"(.text)
        "*/games/tla/src/sound/mplay_main.o"(.text .rodata .text.channel_unlink)
        "*/games/tla/src/sound/sound_play.o"(.text)
        "*/games/tla/src/sound/bios_sound_driver_mode.o"(.text .rodata .data .padding)
        "*/games/tla/src/sound/sound_test.o"(.text)
        "*/games/tla/src/sound/umul_high.o"(.text .text.mixer_entry)
    } > ROM
    .iwram_mixer 0x3006000 :
    {
        "*/games/tla/src/sound/mixer.o"(.text .rodata .data .padding)
    } > IWRAM AT>ROM
    iwram_high (NOLOAD) :
    {
        "*/games/tla/src/system/iwram_high.o"(.sym_iwram_high)
    } > IWRAM
    .rom_tail :
    {
        "*/games/tla/src/sound/clear_buffer.o"(.text)
        "*/games/tla/src/sound/sound.o"(.text)
        "*/games/tla/src/sound/sound_get_jump_list.o"(.text .rodata .data .padding)
        "*/games/tla/src/sound/driver.o"(.text)
        "*/games/tla/src/sound/empty_callback.o"(.text)
        "*/games/tla/src/sound/sound_test.o"(.rodata)
        "*/games/tla/src/sound/tables.o"(.rodata)
        "*/games/tla/sound/voice_groups.o"(.rodata)
        "*/games/tla/sound/programmable_wave_samples.o"(.rodata)
        "*/games/tla/sound/music_player_table.o"(.rodata)
        "*/games/tla/sound/song_table.o"(.rodata)
        "*/games/tla/sound/direct_sound_samples.o"(.rodata)
        "*/games/tla/sound/songs/mus_silence.o"(.rodata)
        "*/games/tla/sound/songs/mus_super_lucky_dice.o"(.rodata)
        "*/games/tla/sound/songs/mus_alhafra.o"(.rodata)
        "*/games/tla/sound/songs/mus_champa.o"(.rodata)
        "*/games/tla/sound/songs/mus_daila.o"(.rodata)
        "*/games/tla/sound/songs/mus_apojii_islands.o"(.rodata)
        "*/games/tla/sound/songs/mus_izumo_festival.o"(.rodata)
        "*/games/tla/sound/songs/mus_izumo.o"(.rodata)
        "*/games/tla/sound/songs/mus_the_wise_ones_trap.o"(.rodata)
        "*/games/tla/sound/songs/mus_kandorean_temple_caves.o"(.rodata)
        "*/games/tla/sound/songs/mus_kibombo.o"(.rodata)
        "*/games/tla/sound/songs/mus_rituals.o"(.rodata)
        "*/games/tla/sound/songs/mus_lemuria.o"(.rodata)
        "*/games/tla/sound/songs/mus_madra.o"(.rodata)
        "*/games/tla/sound/songs/mus_islands.o"(.rodata)
        "*/games/tla/sound/songs/mus_garoh.o"(.rodata)
        "*/games/tla/sound/songs/mus_yallam.o"(.rodata)
        "*/games/tla/sound/songs/mus_childrens_song.o"(.rodata)
        "*/games/tla/sound/songs/mus_childrens_song_short.o"(.rodata)
        "*/games/tla/sound/songs/mus_airs_rock.o"(.rodata)
        "*/games/tla/sound/songs/mus_aqua_rock.o"(.rodata)
        "*/games/tla/sound/songs/mus_madra_catacombs.o"(.rodata)
        "*/games/tla/sound/songs/mus_caverns.o"(.rodata)
        "*/games/tla/sound/songs/mus_gaia_rock.o"(.rodata)
        "*/games/tla/sound/songs/mus_inside_the_gabomba_statue.o"(.rodata)
        "*/games/tla/sound/songs/mus_jupiter_lighthouse.o"(.rodata)
        "*/games/tla/sound/songs/mus_magma_rock.o"(.rodata)
        "*/games/tla/sound/songs/mus_mars_lighthouse.o"(.rodata)
        "*/games/tla/sound/songs/mus_tundaria_tower.o"(.rodata)
        "*/games/tla/sound/songs/mus_taopo_swamp.o"(.rodata)
        "*/games/tla/sound/songs/mus_ankohl_ruins.o"(.rodata)
        "*/games/tla/sound/songs/mus_karst_and_agatio.o"(.rodata)
        "*/games/tla/sound/songs/mus_briggs_steals_ship.o"(.rodata)
        "*/games/tla/sound/songs/mus_confrontation.o"(.rodata)
        "*/games/tla/sound/songs/mus_shaman_village.o"(.rodata)
        "*/games/tla/sound/songs/mus_shebas_past.o"(.rodata)
        "*/games/tla/sound/songs/mus_alex.o"(.rodata)
        "*/games/tla/sound/songs/mus_main_theme_title.o"(.rodata)
        "*/games/tla/sound/songs/mus_to_the_open_sea.o"(.rodata)
        "*/games/tla/sound/songs/mus_a_journey_around_the_world.o"(.rodata)
        "*/games/tla/sound/songs/mus_journey_to_save_the_world.o"(.rodata)
        "*/games/tla/sound/songs/mus_staff_credit.o"(.rodata)
        "*/games/tla/sound/songs/mus_battle_jenna.o"(.rodata)
        "*/games/tla/sound/songs/mus_battle_the_lost_age.o"(.rodata)
        "*/games/tla/sound/songs/mus_briggs_battle.o"(.rodata)
        "*/games/tla/sound/songs/mus_aqua_hydra.o"(.rodata)
        "*/games/tla/sound/songs/mus_battle_with_flame_dragon.o"(.rodata)
        "*/games/tla/sound/songs/mus_battle_with_doom_dragon.o"(.rodata)
        "*/games/tla/sound/songs/mus_test_your_skills.o"(.rodata)
        "*/games/tla/sound/songs/mus_battle_on_the_sea.o"(.rodata)
        "*/games/tla/sound/songs/mus_battle_with_karst_and_agatio.o"(.rodata)
        "*/games/tla/sound/songs/mus_victory.o"(.rodata)
        "*/games/tla/sound/songs/mus_defeated.o"(.rodata)
        "*/games/tla/sound/songs/mus_wind_adepts.o"(.rodata)
        "*/games/tla/sound/songs/mus_fated_connection_with_sworn_enemies.o"(.rodata)
        "*/games/tla/sound/songs/mus_prox.o"(.rodata)
        "*/games/tla/sound/songs/mus_alchemy_unleashed.o"(.rodata)
        "*/games/tla/sound/songs/mus_unused_title_after_prologue.o"(.rodata)
        "*/games/tla/sound/songs/mus_sea_of_time.o"(.rodata)
        "*/games/tla/sound/songs/mus_epilogue.o"(.rodata)
        "*/games/tla/sound/songs/mus_the_broken_seal.o"(.rodata)
        "*/games/tla/sound/songs/mus_unused_title.o"(.rodata)
        "*/games/tla/sound/songs/mus_password_entry.o"(.rodata)
        "*/games/tla/sound/songs/mus_mercury_lighthouse.o"(.rodata)
        "*/games/tla/sound/songs/mus_epilogue_villagers.o"(.rodata)
        "*/games/tla/sound/songs/mus_the_adventure_resumes.o"(.rodata)
        "*/games/tla/sound/songs/mus_title_after_prologue.o"(.rodata)
        "*/games/tla/sound/songs/mus_trial_road.o"(.rodata)
        "*/games/tla/sound/songs/mus_puzzle_solved.o"(.rodata)
        "*/games/tla/sound/songs/mus_a_new_ally.o"(.rodata)
        "*/games/tla/sound/songs/mus_recovering_after_combat.o"(.rodata)
        "*/games/tla/sound/songs/mus_treasure_found.o"(.rodata)
        "*/games/tla/sound/songs/mus_poison_cured.o"(.rodata)
        "*/games/tla/sound/songs/mus_saved.o"(.rodata)
        "*/games/tla/sound/songs/mus_overnight_at_the_inn.o"(.rodata)
        "*/games/tla/sound/songs/mus_curse_lifted.o"(.rodata)
        "*/games/tla/sound/songs/mus_exorcised.o"(.rodata)
        "*/games/tla/sound/songs/mus_level_up.o"(.rodata)
        "*/games/tla/sound/songs/mus_lucky.o"(.rodata)
        "*/games/tla/sound/songs/mus_very_lucky.o"(.rodata)
        "*/games/tla/sound/songs/mus_super_lucky.o"(.rodata)
        "*/games/tla/sound/songs/mus_unused_silence_jingle.o"(.rodata)
        "*/games/tla/sound/songs/se_bell.o"(.rodata)
        "*/games/tla/sound/songs/se_shop_purchase.o"(.rodata)
        "*/games/tla/sound/songs/se_shop_sell.o"(.rodata)
        "*/games/tla/sound/songs/se_curse.o"(.rodata)
        "*/games/tla/sound/songs/se_launch.o"(.rodata)
        "*/games/tla/sound/songs/se_coin_payout.o"(.rodata)
        "*/games/tla/sound/songs/se_drip.o"(.rodata)
        "*/games/tla/sound/songs/se_tremor.o"(.rodata)
        "*/games/tla/sound/songs/se_triple_tone_low.o"(.rodata)
        "*/games/tla/sound/songs/se_triple_tone_high.o"(.rodata)
        "*/games/tla/sound/songs/se_chime.o"(.rodata)
        "*/games/tla/sound/songs/se_menu_cursor_move.o"(.rodata)
        "*/games/tla/sound/songs/se_menu_confirm.o"(.rodata)
        "*/games/tla/sound/songs/se_menu_cancel.o"(.rodata)
        "*/games/tla/sound/songs/se_menu_error.o"(.rodata)
        "*/games/tla/sound/songs/se_ice.o"(.rodata)
        "*/games/tla/sound/songs/se_tolbi_spring_toss_prompt.o"(.rodata)
        "*/games/tla/sound/songs/se_item_remove.o"(.rodata)
        "*/games/tla/sound/songs/se_footstep.o"(.rodata)
        "*/games/tla/sound/songs/se_unused_footstep_low.o"(.rodata)
        "*/games/tla/sound/songs/se_120.o"(.rodata)
        "*/games/tla/sound/songs/se_scuffle.o"(.rodata)
        "*/games/tla/sound/songs/se_djinni_flees.o"(.rodata)
        "*/games/tla/sound/songs/se_map_exit.o"(.rodata)
        "*/games/tla/sound/songs/se_chest_open.o"(.rodata)
        "*/games/tla/sound/songs/se_chest_close.o"(.rodata)
        "*/games/tla/sound/songs/se_recovery.o"(.rodata)
        "*/games/tla/sound/songs/se_landing_thud.o"(.rodata)
        "*/games/tla/sound/songs/se_stairs_up.o"(.rodata)
        "*/games/tla/sound/songs/se_stairs_down.o"(.rodata)
        "*/games/tla/sound/songs/se_psynergy_start.o"(.rodata)
        "*/games/tla/sound/songs/se_psynergy_sparkle.o"(.rodata)
        "*/games/tla/sound/songs/se_water.o"(.rodata)
        "*/games/tla/sound/songs/se_impact.o"(.rodata)
        "*/games/tla/sound/songs/se_heavy_impact.o"(.rodata)
        "*/games/tla/sound/songs/se_click.o"(.rodata)
        "*/games/tla/sound/songs/se_whoosh.o"(.rodata)
        "*/games/tla/sound/songs/se_kirin.o"(.rodata)
        "*/games/tla/sound/songs/se_item_break.o"(.rodata)
        "*/games/tla/sound/songs/se_djinni_set.o"(.rodata)
        "*/games/tla/sound/songs/se_spin.o"(.rodata)
        "*/games/tla/sound/songs/se_rumble.o"(.rodata)
        "*/games/tla/sound/songs/se_swirl.o"(.rodata)
        "*/games/tla/sound/songs/se_crack.o"(.rodata)
        "*/games/tla/sound/songs/se_clatter.o"(.rodata)
        "*/games/tla/sound/songs/se_crash.o"(.rodata)
        "*/games/tla/sound/songs/se_enemy_cry.o"(.rodata)
        "*/games/tla/sound/songs/se_beast_cry.o"(.rodata)
        "*/games/tla/sound/songs/se_boss_roar.o"(.rodata)
        "*/games/tla/sound/songs/se_monster_roar.o"(.rodata)
        "*/games/tla/sound/songs/se_unused_defeat_cry.o"(.rodata)
        "*/games/tla/sound/songs/se_light_appear.o"(.rodata)
        "*/games/tla/sound/songs/se_jump.o"(.rodata)
        "*/games/tla/sound/songs/se_high_jump.o"(.rodata)
        "*/games/tla/sound/songs/se_cast.o"(.rodata)
        "*/games/tla/sound/songs/se_switch.o"(.rodata)
        "*/games/tla/sound/songs/se_switch_mechanism.o"(.rodata)
        "*/games/tla/sound/songs/se_gate_move.o"(.rodata)
        "*/games/tla/sound/songs/se_door_open.o"(.rodata)
        "*/games/tla/sound/songs/se_door_close.o"(.rodata)
        "*/games/tla/sound/songs/se_160.o"(.rodata)
        "*/games/tla/sound/songs/se_rattle.o"(.rodata)
        "*/games/tla/sound/songs/se_wave.o"(.rodata)
        "*/games/tla/sound/songs/se_wave_high.o"(.rodata)
        "*/games/tla/sound/songs/se_scatter.o"(.rodata)
        "*/games/tla/sound/songs/se_bird_wings.o"(.rodata)
        "*/games/tla/sound/songs/se_unused_ambient_wind_low.o"(.rodata)
        "*/games/tla/sound/songs/se_map_transition.o"(.rodata)
        "*/games/tla/sound/songs/se_unlock.o"(.rodata)
        "*/games/tla/sound/songs/se_ambient_wind.o"(.rodata)
        "*/games/tla/sound/songs/se_ambient_water.o"(.rodata)
        "*/games/tla/sound/songs/se_thunder.o"(.rodata)
        "*/games/tla/sound/songs/se_thunder_loud.o"(.rodata)
        "*/games/tla/sound/songs/se_note_low.o"(.rodata)
        "*/games/tla/sound/songs/se_note_mid.o"(.rodata)
        "*/games/tla/sound/songs/se_note_high.o"(.rodata)
        "*/games/tla/sound/songs/se_kolima_bridge_hop.o"(.rodata)
        "*/games/tla/sound/songs/se_thunder_card.o"(.rodata)
        "*/games/tla/sound/songs/se_gathering_power.o"(.rodata)
        "*/games/tla/sound/songs/se_wind_funnel.o"(.rodata)
        "*/games/tla/sound/songs/se_settle.o"(.rodata)
        "*/games/tla/sound/songs/se_boom.o"(.rodata)
        "*/games/tla/sound/songs/se_gem_set.o"(.rodata)
        "*/games/tla/sound/songs/se_stone_rumble.o"(.rodata)
        "*/games/tla/sound/songs/se_pop_up.o"(.rodata)
        "*/games/tla/sound/songs/se_push.o"(.rodata)
        "*/games/tla/sound/songs/se_sol_sanctum_light_up.o"(.rodata)
        "*/games/tla/sound/songs/se_falling_light.o"(.rodata)
        "*/games/tla/sound/songs/se_thump.o"(.rodata)
        "*/games/tla/sound/songs/se_stone_grind.o"(.rodata)
        "*/games/tla/sound/songs/se_warp.o"(.rodata)
        "*/games/tla/sound/songs/se_tablet_rise_high.o"(.rodata)
        "*/games/tla/sound/songs/se_shriek.o"(.rodata)
        "*/games/tla/sound/songs/se_doll_placed.o"(.rodata)
        "*/games/tla/sound/songs/se_tablet_rise.o"(.rodata)
        "*/games/tla/sound/songs/se_sparks.o"(.rodata)
        "*/games/tla/sound/songs/se_wise_one_quest.o"(.rodata)
        "*/games/tla/sound/songs/se_gabomba_voice.o"(.rodata)
        "*/games/tla/sound/songs/se_kolima_bridge_post.o"(.rodata)
        "*/games/tla/sound/songs/se_water_column.o"(.rodata)
        "*/games/tla/sound/songs/se_sparkle_fall.o"(.rodata)
        "*/games/tla/sound/songs/se_ascend.o"(.rodata)
        "*/games/tla/sound/songs/se_flame_flare.o"(.rodata)
        "*/games/tla/sound/songs/se_203.o"(.rodata)
        "*/games/tla/sound/songs/se_dust_puff.o"(.rodata)
        "*/games/tla/sound/songs/se_unused_ambient_stream_high.o"(.rodata)
        "*/games/tla/sound/songs/se_curse_fall.o"(.rodata)
        "*/games/tla/sound/songs/se_rush.o"(.rodata)
        "*/games/tla/sound/songs/se_bane_escape.o"(.rodata)
        "*/games/tla/sound/songs/se_mercury_lighthouse_door_open.o"(.rodata)
        "*/games/tla/sound/songs/se_hidden_passage_open.o"(.rodata)
        "*/games/tla/sound/songs/se_mercury_lighthouse_mechanism.o"(.rodata)
        "*/games/tla/sound/songs/se_power_up.o"(.rodata)
        "*/games/tla/sound/songs/se_heavy_stop.o"(.rodata)
        "*/games/tla/sound/songs/se_rising_chimes.o"(.rodata)
        "*/games/tla/sound/songs/se_splash_small.o"(.rodata)
        "*/games/tla/sound/songs/se_burst.o"(.rodata)
        "*/games/tla/sound/songs/se_floor_switch.o"(.rodata)
        "*/games/tla/sound/songs/se_218.o"(.rodata)
        "*/games/tla/sound/songs/se_gush.o"(.rodata)
        "*/games/tla/sound/songs/se_shimmer.o"(.rodata)
        "*/games/tla/sound/songs/se_rise_with_sparks.o"(.rodata)
        "*/games/tla/sound/songs/se_whirlwind.o"(.rodata)
        "*/games/tla/sound/songs/se_lift.o"(.rodata)
        "*/games/tla/sound/songs/se_224.o"(.rodata)
        "*/games/tla/sound/songs/se_cloud_billows.o"(.rodata)
        "*/games/tla/sound/songs/se_log_push.o"(.rodata)
        "*/games/tla/sound/songs/se_topple.o"(.rodata)
        "*/games/tla/sound/songs/se_sparkling_passage.o"(.rodata)
        "*/games/tla/sound/songs/se_splash.o"(.rodata)
        "*/games/tla/sound/songs/se_water_drain.o"(.rodata)
        "*/games/tla/sound/songs/se_water_level.o"(.rodata)
        "*/games/tla/sound/songs/se_crunch.o"(.rodata)
        "*/games/tla/sound/songs/se_cart_roll.o"(.rodata)
        "*/games/tla/sound/songs/se_run_back.o"(.rodata)
        "*/games/tla/sound/songs/se_gust.o"(.rodata)
        "*/games/tla/sound/songs/se_colosso_countdown.o"(.rodata)
        "*/games/tla/sound/songs/se_colosso_go.o"(.rodata)
        "*/games/tla/sound/songs/se_push_step.o"(.rodata)
        "*/games/tla/sound/songs/se_heavy_move.o"(.rodata)
        "*/games/tla/sound/songs/se_log_fall.o"(.rodata)
        "*/games/tla/sound/songs/se_water_move.o"(.rodata)
        "*/games/tla/sound/songs/se_unused_curse_rumble.o"(.rodata)
        "*/games/tla/sound/songs/se_lemurian_ship_lift.o"(.rodata)
        "*/games/tla/sound/songs/se_sandstorm.o"(.rodata)
        "*/games/tla/sound/songs/se_ambient_stream.o"(.rodata)
        "*/games/tla/sound/songs/se_glitter.o"(.rodata)
        "*/games/tla/sound/songs/se_colosso_lettering.o"(.rodata)
        "*/games/tla/sound/songs/se_gabomba_statue_arrow.o"(.rodata)
        "*/games/tla/sound/songs/se_249.o"(.rodata)
        "*/games/tla/sound/songs/se_unused_black_crystal_set_low.o"(.rodata)
        "*/games/tla/sound/songs/se_black_crystal_set.o"(.rodata)
        "*/games/tla/sound/songs/se_colosso_warrior_appear.o"(.rodata)
        "*/games/tla/sound/songs/se_unused_colosso_warrior_roar.o"(.rodata)
        "*/games/tla/sound/songs/se_voice_animal_a.o"(.rodata)
        "*/games/tla/sound/songs/se_voice_animal_b.o"(.rodata)
        "*/games/tla/sound/songs/se_voice_animal_c.o"(.rodata)
        "*/games/tla/sound/songs/se_voice_animal_d.o"(.rodata)
        "*/games/tla/sound/songs/se_voice_girl_a.o"(.rodata)
        "*/games/tla/sound/songs/se_voice_girl_b.o"(.rodata)
        "*/games/tla/sound/songs/se_voice_girl_c.o"(.rodata)
        "*/games/tla/sound/songs/se_voice_girl_d.o"(.rodata)
        "*/games/tla/sound/songs/se_voice_boy_a.o"(.rodata)
        "*/games/tla/sound/songs/se_voice_boy_b.o"(.rodata)
        "*/games/tla/sound/songs/se_voice_boy_c.o"(.rodata)
        "*/games/tla/sound/songs/se_voice_boy_d.o"(.rodata)
        "*/games/tla/sound/songs/se_voice_young_woman_a.o"(.rodata)
        "*/games/tla/sound/songs/se_voice_young_woman_b.o"(.rodata)
        "*/games/tla/sound/songs/se_voice_young_woman_c.o"(.rodata)
        "*/games/tla/sound/songs/se_voice_young_woman_d.o"(.rodata)
        "*/games/tla/sound/songs/se_voice_young_man_a.o"(.rodata)
        "*/games/tla/sound/songs/se_voice_young_man_b.o"(.rodata)
        "*/games/tla/sound/songs/se_voice_young_man_c.o"(.rodata)
        "*/games/tla/sound/songs/se_voice_young_man_d.o"(.rodata)
        "*/games/tla/sound/songs/se_voice_woman_a.o"(.rodata)
        "*/games/tla/sound/songs/se_voice_woman_b.o"(.rodata)
        "*/games/tla/sound/songs/se_voice_woman_c.o"(.rodata)
        "*/games/tla/sound/songs/se_voice_woman_d.o"(.rodata)
        "*/games/tla/sound/songs/se_voice_old_man_a.o"(.rodata)
        "*/games/tla/sound/songs/se_voice_old_man_b.o"(.rodata)
        "*/games/tla/sound/songs/se_voice_old_man_c.o"(.rodata)
        "*/games/tla/sound/songs/se_voice_old_man_d.o"(.rodata)
        "*/games/tla/sound/songs/se_voice_man_a.o"(.rodata)
        "*/games/tla/sound/songs/se_voice_man_b.o"(.rodata)
        "*/games/tla/sound/songs/se_voice_man_c.o"(.rodata)
        "*/games/tla/sound/songs/se_voice_man_d.o"(.rodata)
        "*/games/tla/sound/songs/se_stop_action_se.o"(.rodata)
        "*/games/tla/sound/songs/se_unused_take_flight_high.o"(.rodata)
        "*/games/tla/sound/songs/se_take_flight.o"(.rodata)
        "*/games/tla/sound/songs/se_eruption_columns.o"(.rodata)
        "*/games/tla/sound/songs/se_unused_eruption_columns_low.o"(.rodata)
        "*/games/tla/sound/songs/se_stop_exit_se.o"(.rodata)
        "*/games/tla/sound/songs/se_tolbi_spring_toss.o"(.rodata)
        "*/games/tla/sound/songs/se_tolbi_spring_obstacle_hit.o"(.rodata)
        "*/games/tla/sound/songs/se_lucky_dice_throw.o"(.rodata)
        "*/games/tla/sound/songs/se_lucky_dice_number.o"(.rodata)
        "*/games/tla/sound/songs/se_lucky_wheels_spin.o"(.rodata)
        "*/games/tla/sound/songs/se_lucky_wheels_hold.o"(.rodata)
        "*/games/tla/sound/songs/se_lucky_wheels_stop_prompt.o"(.rodata)
        "*/games/tla/sound/songs/se_lucky_wheels_stop.o"(.rodata)
        "*/games/tla/sound/songs/se_materialize.o"(.rodata)
        "*/games/tla/sound/songs/se_star_bounce.o"(.rodata)
        "*/games/tla/sound/songs/se_fall.o"(.rodata)
        "*/games/tla/sound/songs/se_unused_sparkling_lettering.o"(.rodata)
        "*/games/tla/sound/songs/se_lash.o"(.rodata)
        "*/games/tla/sound/songs/se_unused_cast_low.o"(.rodata)
        "*/games/tla/sound/songs/se_unused_spin_away_single.o"(.rodata)
        "*/games/tla/sound/songs/se_jupiter_lighthouse_beams.o"(.rodata)
        "*/games/tla/sound/songs/se_unused_mars_lighthouse_doorway_a.o"(.rodata)
        "*/games/tla/sound/songs/se_524.o"(.rodata)
        "*/games/tla/sound/songs/se_howl.o"(.rodata)
        "*/games/tla/sound/songs/se_unused_howl_slow.o"(.rodata)
        "*/games/tla/sound/songs/se_unused_gabomba_jaws_open_held.o"(.rodata)
        "*/games/tla/sound/songs/se_528.o"(.rodata)
        "*/games/tla/sound/songs/se_529.o"(.rodata)
        "*/games/tla/sound/songs/se_sea_of_time_opens.o"(.rodata)
        "*/games/tla/sound/songs/se_unused_sandstorm_low.o"(.rodata)
        "*/games/tla/sound/songs/se_532.o"(.rodata)
        "*/games/tla/sound/songs/se_533.o"(.rodata)
        "*/games/tla/sound/songs/se_534.o"(.rodata)
        "*/games/tla/sound/songs/se_bookshelf_slide.o"(.rodata)
        "*/games/tla/sound/songs/se_536.o"(.rodata)
        "*/games/tla/sound/songs/se_538.o"(.rodata)
        "*/games/tla/sound/songs/se_sand_emerge.o"(.rodata)
        "*/games/tla/sound/songs/se_parch.o"(.rodata)
        "*/games/tla/sound/songs/se_unused_parch_high.o"(.rodata)
        "*/games/tla/sound/songs/se_sand_end.o"(.rodata)
        "*/games/tla/sound/songs/se_unused_curse_rumble_low.o"(.rodata)
        "*/games/tla/sound/songs/se_unused_settle_short.o"(.rodata)
        "*/games/tla/sound/songs/se_unused_tablet_rise_low.o"(.rodata)
        "*/games/tla/sound/songs/se_548.o"(.rodata)
        "*/games/tla/sound/songs/se_unused_bookshelf_slide_high.o"(.rodata)
        "*/games/tla/sound/songs/se_drop_through_hole.o"(.rodata)
        "*/games/tla/sound/songs/se_551.o"(.rodata)
        "*/games/tla/sound/songs/se_552.o"(.rodata)
        "*/games/tla/sound/songs/se_flame_grow.o"(.rodata)
        "*/games/tla/sound/songs/se_unused_flame_grow_low.o"(.rodata)
        "*/games/tla/sound/songs/se_rise_with_sparks_high.o"(.rodata)
        "*/games/tla/sound/songs/se_rise_with_sparks_low.o"(.rodata)
        "*/games/tla/sound/songs/se_unused_thunder_run.o"(.rodata)
        "*/games/tla/sound/songs/se_unused_coin_payout_low.o"(.rodata)
        "*/games/tla/sound/songs/se_mars_lighthouse_doorway.o"(.rodata)
        "*/games/tla/sound/songs/se_unused_mars_lighthouse_doorway_b.o"(.rodata)
        "*/games/tla/sound/songs/se_562.o"(.rodata)
        "*/games/tla/sound/songs/se_unused_coin_payout_a.o"(.rodata)
        "*/games/tla/sound/songs/se_eyes_glow.o"(.rodata)
        "*/games/tla/sound/songs/se_unused_lucky_wheels_hold_low.o"(.rodata)
        "*/games/tla/sound/songs/se_spiral.o"(.rodata)
        "*/games/tla/sound/songs/se_pound.o"(.rodata)
        "*/games/tla/sound/songs/se_unused_spin_away_b.o"(.rodata)
        "*/games/tla/sound/songs/se_unused_spin_away_high_a.o"(.rodata)
        "*/games/tla/sound/songs/se_unused_current_held.o"(.rodata)
        "*/games/tla/sound/songs/se_unused_loud_current_a.o"(.rodata)
        "*/games/tla/sound/songs/se_crumble.o"(.rodata)
        "*/games/tla/sound/songs/se_ice_crack.o"(.rodata)
        "*/games/tla/sound/songs/se_flash.o"(.rodata)
        "*/games/tla/sound/songs/se_ankohl_ruins_piece.o"(.rodata)
        "*/games/tla/sound/songs/se_statue_stirs.o"(.rodata)
        "*/games/tla/sound/songs/se_gabomba_jaws_open.o"(.rodata)
        "*/games/tla/sound/songs/se_unused_loud_current_b.o"(.rodata)
        "*/games/tla/sound/songs/se_579.o"(.rodata)
        "*/games/tla/sound/songs/se_unused_gabomba_statue_hole_high.o"(.rodata)
        "*/games/tla/sound/songs/se_gabomba_statue_hole.o"(.rodata)
        "*/games/tla/sound/songs/se_lemurian_ship_lift_fast.o"(.rodata)
        "*/games/tla/sound/songs/se_unused_ice_crack_single.o"(.rodata)
        "*/games/tla/sound/songs/se_button_press.o"(.rodata)
        "*/games/tla/sound/songs/se_unused_spark.o"(.rodata)
        "*/games/tla/sound/songs/se_gabomba_statue_cogs.o"(.rodata)
        "*/games/tla/sound/songs/se_587.o"(.rodata)
        "*/games/tla/sound/songs/se_588.o"(.rodata)
        "*/games/tla/sound/songs/se_unused_surf_fall.o"(.rodata)
        "*/games/tla/sound/songs/se_statue_rise.o"(.rodata)
        "*/games/tla/sound/songs/se_unused_statue_stirs_short.o"(.rodata)
        "*/games/tla/sound/songs/se_unused_impact_doubled.o"(.rodata)
        "*/games/tla/sound/songs/se_593.o"(.rodata)
        "*/games/tla/sound/songs/se_unused_rumble_low.o"(.rodata)
        "*/games/tla/sound/songs/se_dragon_flicker.o"(.rodata)
        "*/games/tla/sound/songs/se_sand_move.o"(.rodata)
        "*/games/tla/sound/songs/se_current.o"(.rodata)
        "*/games/tla/sound/songs/se_rising_rings.o"(.rodata)
        "*/games/tla/sound/songs/se_unused_spin_away_crash.o"(.rodata)
        "*/games/tla/sound/songs/se_unused_coin_payout_b.o"(.rodata)
        "*/games/tla/sound/songs/se_spin_away.o"(.rodata)
        "*/games/tla/sound/songs/se_unused_spin_away_high_b.o"(.rodata)
        "*/games/tla/sound/songs/se_unused_spin_away_high_c.o"(.rodata)
        "*/games/tla/sound/songs/se_unused_kolima_bridge_hop.o"(.rodata)
        "*/games/tla/sound/songs/se_unused_whirlwind_low_a.o"(.rodata)
        "*/games/tla/sound/songs/se_unused_whirlwind_low_b.o"(.rodata)
        "*/games/tla/sound/songs/se_unused_rise_with_sparks_short.o"(.rodata)
        "*/games/tla/sound/songs/se_bird_call.o"(.rodata)
        "*/games/tla/sound/songs/se_unused_coin_payout_c.o"(.rodata)
        "*/games/tla/sound/songs/se_unused_coin_payout_high.o"(.rodata)
        "*/games/tla/sound/songs/se_unused_wade_short.o"(.rodata)
        "*/games/tla/sound/songs/se_wade.o"(.rodata)
        "*/games/tla/sound/songs/mus_village_theme.o"(.rodata)
        "*/games/tla/sound/songs/mus_gondowan_settlement.o"(.rodata)
        "*/games/tla/sound/songs/mus_an_unsettling_feeling.o"(.rodata)
        "*/games/tla/sound/songs/mus_lemurian_palace.o"(.rodata)
        "*/games/tla/sound/songs/mus_sinking_into_sorrow.o"(.rodata)
        "*/games/tla/sound/songs/mus_reuniting_with_hama.o"(.rodata)
        "*/games/tla/sound/songs/mus_port_town_theme.o"(.rodata)
        "*/games/tla/sound/songs/mus_colosso_intro.o"(.rodata)
        "*/games/tla/sound/songs/mus_colosseum.o"(.rodata)
        "*/games/tla/sound/songs/mus_try_your_luck.o"(.rodata)
        "*/games/tla/sound/songs/mus_tolbi.o"(.rodata)
        "*/games/tla/sound/songs/mus_anemos_inner_sanctum.o"(.rodata)
        "*/games/tla/sound/songs/mus_contigo.o"(.rodata)
        "*/games/tla/sound/songs/mus_elemental_stars.o"(.rodata)
        "*/games/tla/sound/songs/mus_dungeon_theme.o"(.rodata)
        "*/games/tla/sound/songs/mus_suhalla_gate.o"(.rodata)
        "*/games/tla/sound/songs/mus_yampi_desert.o"(.rodata)
        "*/games/tla/sound/songs/mus_remote_village.o"(.rodata)
        "*/games/tla/sound/songs/mus_venus_lighthouse_entrance.o"(.rodata)
        "*/games/tla/sound/songs/mus_dehkan_plateau.o"(.rodata)
        "*/games/tla/sound/songs/mus_gabomba_catacombs.o"(.rodata)
        "*/games/tla/sound/songs/mus_babis_theme.o"(.rodata)
        "*/games/tla/sound/songs/mus_set_sail_on_the_karagol_sea.o"(.rodata)
        "*/games/tla/sound/songs/mus_idejima.o"(.rodata)
        "*/games/tla/sound/songs/mus_venus_lighthouse.o"(.rodata)
        "*/games/tla/sound/songs/mus_battle_the_broken_seal.o"(.rodata)
        "*/games/tla/sound/songs/mus_battle_with_star_magician.o"(.rodata)
        "*/games/tla/sound/songs/mus_battle_with_valukar.o"(.rodata)
        "*/games/tla/sound/songs/mus_battle_with_sentinel.o"(.rodata)
        "*/games/tla/sound/songs/mus_battle_with_dullahan.o"(.rodata)
        "*/games/tla/sound/songs/mus_to_be_continued.o"(.rodata)
        . = ABSOLUTE(ROM_SHIFT + 0x08300000);
        "*/games/tla/src/graphics/sprite/sprites.o"(.rodata)
        . = ABSOLUTE(ROM_SHIFT + 0x08680000);
        "*/games/tla/src/gamepak/resource_directory.o"(.rodata)
        "*/games/tla/src/graphics/ui/ui.o"(.rodata.a)
        "*/games/tla/src/graphics/field/clock_digits.o"(.rodata)
        "*/games/tla/src/graphics/title/title.o"(.rodata.c)
        "*/games/tla/src/graphics/title/title.o"(.rodata)
        "*/games/tla/src/graphics/title/title.o"(.rodata.d)
        "*/games/tla/src/graphics/title/title.o"(.rodata.a)
        "*/games/tla/src/graphics/title/logo_on_black.o"(.rodata)
        "*/games/tla/src/graphics/title/title.o"(.rodata.b)
        "*/games/tla/src/graphics/ui/headings.o"(.rodata)
        "*/games/tla/src/graphics/battle_backgrounds/battle_backgrounds.o"(.rodata)
        "*/games/tla/src/graphics/battle_backgrounds/stone_corridor.o"(.rodata)
        "*/games/tla/src/graphics/battle_backgrounds/battle_backgrounds.o"(.rodata.a)
        "*/games/tla/src/graphics/ending/ending.o"(.rodata)
        "*/games/tla/src/graphics/lucky_wheels/lucky_wheels.o"(.rodata)
        "*/games/tla/src/graphics/lucky_dice/board.o"(.rodata)
        "*/games/tla/src/graphics/lucky_wheels/dome.o"(.rodata)
        "*/games/tla/src/graphics/lucky_dice/lucky_dice.o"(.rodata)
        "*/games/tla/src/graphics/lucky_wheels/lucky_wheels.o"(.rodata.a)
        "*/games/tla/src/graphics/summon/summon.o"(.rodata)
        "*/games/tla/src/graphics/summon/crimson_beast.o"(.rodata)
        "*/games/tla/src/graphics/summon/summon.o"(.rodata.a)
        "*/games/tla/src/graphics/summon/summon.o"(.rodata.d)
        "*/games/tla/src/graphics/summon/summon.o"(.rodata.b)
        "*/games/tla/src/graphics/summon/golden_dragon.o"(.rodata)
        "*/games/tla/src/graphics/summon/summon.o"(.rodata.c)
        "*/games/tla/src/graphics/battle_effects/battle_effects.o"(.rodata)
        "*/games/tla/src/graphics/battle_effects/music_note_sheet.o"(.rodata)
        "*/games/tla/src/graphics/battle_effects/battle_effects.o"(.rodata.a)
        "*/games/tla/src/graphics/battle_effects/corner_rune_a.o"(.rodata)
        "*/games/tla/src/graphics/battle_effects/battle_effects.o"(.rodata.b)
        "*/games/tla/src/graphics/battle_effects/cloud_puff.o"(.rodata)
        "*/games/tla/src/graphics/battle_effects/battle_effects.o"(.rodata.c)
        "*/games/tla/src/graphics/battle_effects/comet_b.o"(.rodata)
        "*/games/tla/src/graphics/battle_effects/battle_effects.o"(.rodata.d)
        "*/games/tla/src/graphics/battle_effects/rock_wall.o"(.rodata)
        "*/games/tla/src/graphics/battle_effects/battle_effects.o"(.rodata.e)
        "*/games/tla/src/graphics/battle_effects/paths.o"(.rodata)
        "*/games/tla/src/map/world/blocks.o"(.rodata)
        "*/games/tla/src/map/default/default.o"(.rodata)
        "*/games/tla/src/graphics/world_map/palette_a.o"(.rodata)
        "*/games/tla/src/map/default/default.o"(.rodata.a)
        "*/games/tla/src/graphics/world_map/world_map.o"(.rodata)
        "*/games/tla/src/graphics/world_map/anim_c.o"(.rodata)
        "*/games/tla/src/graphics/world_map/world_map.o"(.rodata.a)
        "*/games/tla/src/graphics/field/field.o"(.rodata)
        "*/games/tla/src/graphics/lettering/banner.o"(.rodata)
        "*/games/tla/src/graphics/ui/ui.o"(.rodata)
        "*/games/tla/src/graphics/field_effects/field_effects.o"(.rodata.a)
        "*/games/tla/src/graphics/field_effects/field_effects.o"(.rodata.d)
        "*/games/tla/src/graphics/field_effects/field_effects.o"(.rodata.b)
        "*/games/tla/src/graphics/field_effects/coloured_orbs.o"(.rodata)
        "*/games/tla/src/graphics/field_effects/field_effects.o"(.rodata.c)
        "*/games/tla/src/graphics/field/green_panel.o"(.rodata)
        "*/games/tla/src/graphics/ui/menu_sprites_packed.o"(.rodata)
        "*/games/tla/src/graphics/monster/monster.o"(.rodata)
        "*/games/tla/src/graphics/monster/serpent.o"(.rodata)
        "*/games/tla/src/graphics/monster/monster.o"(.rodata.a)
        "*/games/tla/src/map/maps.o"(.rodata)
        "*/games/tla/src/system/overlay/overlays.o"(.overlays)
    } > ROM
    IwramResident_Rom = LOADADDR(.iwram_resident);
    SoundMainRAM_Rom = LOADADDR(.iwram_mixer) + 1;
    Mixer_CallViaR3Rom = LOADADDR(.iwram_mixer) + (Mixer_CallViaR3 - ADDR(.iwram_mixer));
    /DISCARD/ : { *(.ARM.attributes) *(.comment) *(.note*) }
}
#endif
