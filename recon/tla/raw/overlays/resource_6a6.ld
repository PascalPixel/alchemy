SECTIONS
{
    .text 0x2008000 :
    {
        "*/games/tla/src/scene/loho/entry.o"(.text)
        "*/games/tla/src/scene/loho/start.o"(.text)
        "*/games/tla/src/scene/loho/scene_tables.o"(.text)
        "*/games/tla/src/scene/loho/regions.o"(.text)
        "*/games/tla/src/scene/loho/exits.o"(.text)
        "*/games/tla/src/scene/loho/s0080.o"(.text)
        "*/resource_6a6_overlay.o"(.text.x02008198)
        "*/games/tla/src/scene/loho/s0bf4.o"(.text)
        "*/games/tla/src/scene/loho/lights.o"(.text)
        "*/games/tla/src/scene/loho/s0c84.o"(.text)
        "*/games/tla/src/scene/loho/call_d40.o"(.text)
        "*/games/tla/src/scene/loho/s0d4c.o"(.text)
        "*/games/tla/src/scene/loho/switch.o"(.text)
        "*/games/tla/src/scene/loho/s0e54.o"(.text)
        "*/games/tla/src/scene/loho/s0eec.o"(.text)
        "*/games/tla/src/scene/loho/s0f38.o"(.text)
        "*/games/tla/src/scene/loho/push.o"(.text)
        "*/games/tla/src/scene/loho/s10c0.o"(.text)
        "*/games/tla/src/scene/loho/s11ec.o"(.text)
        "*/games/tla/src/scene/loho/import.o"(.text)
        "*/games/tla/src/graphics/field/pal685.o"(.rodata)
        "*/games/tla/src/scene/loho/data.o"(.data)
    }
    /DISCARD/ : { *(.ARM.attributes) *(.comment) *(.note*) }
}
