SECTIONS
{
    .text 0x2008000 :
    {
        "*/games/tla/src/scene/ankohl_ruins/entry.o"(.text)
        "*/games/tla/src/field/object/set_sprite_priority.o"(.text)
        "*/games/tla/src/field/object/prepare_object.o"(.text)
        "*/games/tla/src/scene/ankohl_ruins/spawn.o"(.text)
        "*/games/tla/src/field/field_effect/move.o"(.text)
        "*/resource_686_overlay.o"(.text.x0200815a)
        "*/recon/tla/raw/src/scene/ankohl_ruins/s015c.o"(.text)
        "*/games/tla/src/scene/ankohl_ruins/scene_tables.o"(.text)
        "*/games/tla/src/scene/ankohl_ruins/placements.o"(.text)
        "*/games/tla/src/scene/ankohl_ruins/exits.o"(.text)
        "*/games/tla/src/scene/ankohl_ruins/events_a.o"(.text)
        "*/games/tla/src/scene/ankohl_ruins/effadv.o"(.text)
        "*/resource_686_overlay.o"(.text.x02008416)
        "*/recon/tla/raw/src/scene/ankohl_ruins/s0418.o"(.text)
        "*/resource_686_overlay.o"(.text.x02008418)
        "*/recon/tla/raw/src/scene/ankohl_ruins/events_b.o"(.text)
        "*/recon/tla/raw/src/scene/ankohl_ruins/s06d0.o"(.text)
        "*/recon/tla/raw/src/scene/ankohl_ruins/s0850.o"(.text)
        "*/recon/tla/raw/src/scene/ankohl_ruins/s0a68.o"(.text)
        "*/games/tla/src/scene/ankohl_ruins/s0b30.o"(.text)
        "*/recon/tla/raw/src/scene/ankohl_ruins/s0b78.o"(.text)
        "*/recon/tla/raw/src/scene/ankohl_ruins/s104c.o"(.text)
        "*/recon/tla/raw/src/scene/ankohl_ruins/s10f4.o"(.text)
        "*/recon/tla/raw/src/scene/ankohl_ruins/events_d.o"(.text)
        "*/recon/tla/raw/src/scene/ankohl_ruins/s1264.o"(.text)
        "*/resource_686_overlay.o"(.text.x020092c4)
        "*/recon/tla/raw/src/scene/ankohl_ruins/s1420.o"(.text)
        "*/games/tla/src/scene/ankohl_ruins/events_e.o"(.text)
        "*/recon/tla/raw/src/scene/ankohl_ruins/s160c.o"(.text)
        "*/recon/tla/raw/src/scene/ankohl_ruins/s19a0.o"(.text)
        "*/recon/tla/raw/src/scene/ankohl_ruins/s1d34.o"(.text)
        "*/recon/tla/raw/src/scene/ankohl_ruins/s1f7c.o"(.text)
        "*/recon/tla/raw/src/scene/ankohl_ruins/s20fc.o"(.text)
        "*/recon/tla/raw/src/scene/ankohl_ruins/events_f.o"(.text)
        "*/recon/tla/raw/src/scene/ankohl_ruins/s2438.o"(.text)
        "*/games/tla/src/scene/ankohl_ruins/prepare.o"(.text)
        "*/games/tla/src/scene/ankohl_ruins/import.o"(.text)
        "*/games/tla/src/scene/ankohl_ruins/data.o"(.data)
    }
    .bss : { "*/resource_686_overlay.o"(.bss) }
    /DISCARD/ : { *(.ARM.attributes) *(.comment) *(.note*) }
}
