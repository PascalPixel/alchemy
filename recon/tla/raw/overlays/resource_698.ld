SECTIONS
{
    .text 0x2008000 :
    {
        "*/games/tla/src/scene/jupiter_lighthouse_entrance/entry.o"(.text)
        "*/games/tla/src/scene/jupiter_lighthouse_entrance/scene_tables.o"(.text)
        "*/games/tla/src/scene/jupiter_lighthouse_entrance/s0054.o"(.text)
        "*/games/tla/src/scene/jupiter_lighthouse_entrance/s0074.o"(.text)
        "*/games/tla/src/scene/jupiter_lighthouse_entrance/s0094.o"(.text)
        "*/games/tla/src/scene/jupiter_lighthouse_entrance/s00b4.o"(.text)
        "*/games/tla/src/scene/jupiter_lighthouse_entrance/s00d4.o"(.text)
        "*/recon/tla/raw/src/scene/jupiter_lighthouse_entrance/s00f4.o"(.text)
        "*/games/tla/src/scene/jupiter_lighthouse_entrance/s0184.o"(.text)
        "*/games/tla/src/scene/jupiter_lighthouse_entrance/scene_events.o"(.text)
        "*/recon/tla/raw/src/scene/jupiter_lighthouse_entrance/s0198.o"(.text)
        "*/games/tla/src/scene/jupiter_lighthouse_entrance/prepare.o"(.text)
        "*/recon/tla/raw/src/scene/shared/scene_set_arrival_flags.o"(.text)
        "*/resource_698_overlay.o"(.text.x0200822a)
        "*/games/tla/src/scene/jupiter_lighthouse_entrance/s022c.o"(.text)
        "*/recon/tla/raw/src/scene/jupiter_lighthouse_entrance/s0238.o"(.text)
        "*/recon/tla/raw/src/scene/jupiter_lighthouse_entrance/lightset.o"(.text)
        "*/recon/tla/raw/src/scene/jupiter_lighthouse_entrance/s03cc.o"(.text)
        "*/recon/tla/raw/src/scene/jupiter_lighthouse_entrance/dist.o"(.text)
        "*/recon/tla/raw/src/scene/jupiter_lighthouse_entrance/s05e4.o"(.text)
        "*/recon/tla/raw/src/scene/jupiter_lighthouse_entrance/s07a4.o"(.text)
        "*/recon/tla/raw/src/scene/jupiter_lighthouse_entrance/s087c.o"(.text)
        "*/recon/tla/raw/src/scene/jupiter_lighthouse_entrance/s091c.o"(.text)
        "*/recon/tla/raw/src/scene/jupiter_lighthouse_entrance/s0aac.o"(.text)
        "*/recon/tla/raw/src/scene/jupiter_lighthouse_entrance/light.o"(.text)
        "*/recon/tla/raw/src/scene/jupiter_lighthouse_entrance/lightcue.o"(.text)
        "*/games/tla/src/field/object/set_sprite_priority.o"(.text)
        "*/resource_698_overlay.o"(.text.x02008e72)
        "*/recon/tla/raw/src/field/field_effect/move.o"(.text)
        "*/resource_698_overlay.o"(.text.x02008eaa)
        "*/recon/tla/raw/src/scene/jupiter_lighthouse_entrance/s0eac.o"(.text)
        "*/recon/tla/raw/src/scene/jupiter_lighthouse_entrance/s1074.o"(.text)
        "*/recon/tla/raw/src/scene/jupiter_lighthouse_entrance/s11a0.o"(.text)
        "*/recon/tla/raw/src/scene/jupiter_lighthouse_entrance/s13e4.o"(.text)
        "*/recon/tla/raw/src/scene/jupiter_lighthouse_entrance/s14dc.o"(.text)
        "*/recon/tla/raw/src/field/field_effect/advance_motion.o"(.text)
        "*/resource_698_overlay.o"(.text.x02009672)
        "*/recon/tla/raw/src/scene/jupiter_lighthouse_entrance/s1674.o"(.text)
        "*/recon/tla/raw/src/scene/jupiter_lighthouse_entrance/s180c.o"(.text)
        "*/recon/tla/raw/src/scene/jupiter_lighthouse_entrance/s18bc.o"(.text)
        "*/games/tla/src/scene/jupiter_lighthouse_entrance/import.o"(.text)
        "*/games/tla/src/graphics/field/cached_a.o"(.rodata)
        "*/games/tla/src/graphics/field/cached_b.o"(.rodata)
        "*/games/tla/src/graphics/field/cached_c.o"(.rodata)
        "*/games/tla/src/scene/jupiter_lighthouse_entrance/data.o"(.data)
    }
    .bss : { "*/resource_698_overlay.o"(.bss) }
    /DISCARD/ : { *(.ARM.attributes) *(.comment) *(.note*) }
}
