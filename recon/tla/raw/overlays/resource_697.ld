SECTIONS
{
    .text 0x2008000 :
    {
        "*/games/tla/src/scene/trial_road/entry.o"(.text)
        "*/games/tla/src/scene/trial_road/start.o"(.text)
        "*/games/tla/src/scene/trial_road/scene_tables.o"(.text)
        "*/games/tla/src/scene/trial_road/events_a.o"(.text)
        "*/games/tla/src/scene/trial_road/s0138.o"(.text)
        "*/games/tla/src/scene/trial_road/s0218.o"(.text)
        "*/games/tla/src/scene/trial_road/s0330.o"(.text)
        "*/games/tla/src/scene/trial_road/events_b.o"(.text)
        "*/games/tla/src/scene/trial_road/s0428.o"(.text)
        "*/games/tla/src/scene/trial_road/s04f4.o"(.text)
        "*/games/tla/src/scene/trial_road/events_c.o"(.text)
        "*/games/tla/src/scene/trial_road/events_d.o"(.text)
        "*/games/tla/src/scene/trial_road/s0728.o"(.text)
        "*/games/tla/src/scene/trial_road/events_e.o"(.text)
        "*/games/tla/src/scene/trial_road/events_l.o"(.text)
        "*/games/tla/src/scene/trial_road/s082c.o"(.text)
        "*/games/tla/src/scene/trial_road/events_f.o"(.text)
        "*/games/tla/src/scene/trial_road/events_g.o"(.text)
        "*/games/tla/src/scene/trial_road/s09ac.o"(.text)
        "*/games/tla/src/scene/trial_road/s0a18.o"(.text)
        "*/games/tla/src/scene/trial_road/events_h.o"(.text)
        "*/games/tla/src/scene/trial_road/s0b7c.o"(.text)
        "*/games/tla/src/scene/trial_road/events_i.o"(.text)
        "*/games/tla/src/scene/trial_road/events_m.o"(.text)
        "*/games/tla/src/scene/trial_road/s0cf8.o"(.text)
        "*/games/tla/src/scene/trial_road/s0d70.o"(.text)
        "*/recon/tla/raw/src/scene/trial_road/s0e40.o"(.text)
        "*/games/tla/src/scene/trial_road/events_j.o"(.text)
        "*/games/tla/src/scene/trial_road/events_n.o"(.text)
        "*/games/tla/src/scene/trial_road/events_o.o"(.text)
        "*/games/tla/src/field/object/set_sprite_priority.o"(.text)
        "*/resource_697_overlay.o"(.text.x02009262)
        "*/games/tla/src/field/field_effect/move.o"(.text)
        "*/resource_697_overlay.o"(.text.x0200929a)
        "*/games/tla/src/scene/trial_road/s129c.o"(.text)
        "*/games/tla/src/field/field_effect/advance_motion_priority.o"(.text)
        "*/games/tla/src/scene/trial_road/s14e4.o"(.text)
        "*/games/tla/src/scene/trial_road/s15a8.o"(.text)
        "*/games/tla/src/scene/trial_road/s1890.o"(.text)
        "*/games/tla/src/scene/trial_road/s1afc.o"(.text)
        "*/games/tla/src/scene/trial_road/s1c6c.o"(.text)
        "*/games/tla/src/scene/trial_road/s1d8c.o"(.text)
        "*/games/tla/src/scene/trial_road/s1dd4.o"(.text)
        "*/recon/tla/raw/src/scene/trial_road/s1efc.o"(.text)
        "*/games/tla/src/scene/trial_road/s1f08.o"(.text)
        "*/games/tla/src/scene/trial_road/s1fc4.o"(.text)
        "*/games/tla/src/scene/trial_road/s200c.o"(.text)
        "*/games/tla/src/scene/trial_road/s20c4.o"(.text)
        "*/recon/tla/raw/src/scene/trial_road/s217c.o"(.text)
        "*/games/tla/src/scene/trial_road/s223c.o"(.text)
        "*/recon/tla/raw/src/scene/trial_road/s242c.o"(.text)
        "*/games/tla/src/scene/trial_road/s2c30.o"(.text)
        "*/games/tla/src/scene/trial_road/mirror.o"(.text)
        "*/games/tla/src/scene/trial_road/s2dec.o"(.text)
        "*/games/tla/src/scene/trial_road/s322c.o"(.text)
        "*/games/tla/src/scene/trial_road/s34b4.o"(.text)
        "*/games/tla/src/scene/trial_road/s37c8.o"(.text)
        "*/games/tla/src/scene/trial_road/s3900.o"(.text)
        "*/resource_697_overlay.o"(.text.x0200bda0)
        "*/recon/tla/raw/src/scene/trial_road/s3f68.o"(.text)
        "*/games/tla/src/scene/trial_road/s4188.o"(.text)
        "*/games/tla/src/scene/trial_road/s4224.o"(.text)
        "*/games/tla/src/scene/trial_road/s42f0.o"(.text)
        "*/recon/tla/raw/src/scene/trial_road/s4418.o"(.text)
        "*/games/tla/src/scene/trial_road/s45ac.o"(.text)
        "*/games/tla/src/scene/trial_road/s468c.o"(.text)
        "*/recon/tla/raw/src/scene/trial_road/s46a4.o"(.text)
        "*/games/tla/src/scene/trial_road/s480c.o"(.text)
        "*/recon/tla/raw/src/scene/trial_road/s4828.o"(.text)
        "*/games/tla/src/scene/trial_road/s4a14.o"(.text)
        "*/recon/tla/raw/src/scene/trial_road/s4a94.o"(.text)
        "*/games/tla/src/scene/trial_road/s4bc8.o"(.text)
        "*/games/tla/src/scene/trial_road/s4ce0.o"(.text)
        "*/games/tla/src/scene/trial_road/s4d6c.o"(.text)
        "*/games/tla/src/scene/trial_road/s4d84.o"(.text)
        "*/games/tla/src/scene/trial_road/balance.o"(.text)
        "*/games/tla/src/scene/trial_road/s4ddc.o"(.text)
        "*/resource_697_overlay.o"(.text.x0200d1a0)
        "*/games/tla/src/scene/trial_road/s55c4.o"(.text)
        "*/games/tla/src/scene/trial_road/s5688.o"(.text)
        "*/games/tla/src/scene/trial_road/import.o"(.text)
        "*/games/tla/src/scene/trial_road/data.o"(.data)
        "*/games/tla/src/graphics/field/tiles64d.o"(.rodata)
        "*/games/tla/src/scene/trial_road/data2.o"(.data)
        "*/games/tla/src/scene/trial_road/picture.o"(.rodata)
        "*/games/tla/src/scene/trial_road/data3.o"(.data)
    }
    .bss : { "*/resource_697_overlay.o"(.bss) }
    /DISCARD/ : { *(.ARM.attributes) *(.comment) *(.note*) }
}
