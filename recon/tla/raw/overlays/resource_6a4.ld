SECTIONS
{
    .text 0x2008000 :
    {
        "*/games/tla/src/scene/jupiter_lighthouse_aerie/entry.o"(.text)
        "*/games/tla/src/scene/jupiter_lighthouse_aerie/scene_tables.o"(.text)
        "*/resource_6a4_overlay.o"(.text.x02008054)
        "*/games/tla/src/scene/jupiter_lighthouse_aerie/lever.o"(.text)
        "*/games/tla/src/scene/jupiter_lighthouse_aerie/s032c.o"(.text)
        "*/games/tla/src/scene/jupiter_lighthouse_aerie/scene_events.o"(.text)
        "*/games/tla/src/scene/jupiter_lighthouse_aerie/s0538.o"(.text)
        "*/games/tla/src/scene/shared/scene_set_arrival_flags.o"(.text)
        "*/games/tla/src/scene/jupiter_lighthouse_aerie/lighton.o"(.text)
        "*/games/tla/src/scene/jupiter_lighthouse_aerie/s079c.o"(.text)
        "*/games/tla/src/scene/jupiter_lighthouse_aerie/lightset.o"(.text)
        "*/games/tla/src/scene/jupiter_lighthouse_aerie/s0930.o"(.text)
        "*/games/tla/src/scene/jupiter_lighthouse_aerie/dist.o"(.text)
        "*/games/tla/src/scene/jupiter_lighthouse_aerie/s0b48.o"(.text)
        "*/games/tla/src/scene/jupiter_lighthouse_aerie/s0d08.o"(.text)
        "*/games/tla/src/scene/jupiter_lighthouse_aerie/s0de0.o"(.text)
        "*/games/tla/src/scene/jupiter_lighthouse_aerie/s0e80.o"(.text)
        "*/games/tla/src/scene/jupiter_lighthouse_aerie/s1010.o"(.text)
        "*/games/tla/src/scene/jupiter_lighthouse_aerie/s105c.o"(.text)
        "*/games/tla/src/scene/jupiter_lighthouse_aerie/s1080.o"(.text)
        "*/games/tla/src/scene/jupiter_lighthouse_aerie/s17a8.o"(.text)
        "*/games/tla/src/scene/jupiter_lighthouse_aerie/s1a78.o"(.text)
        "*/games/tla/src/scene/jupiter_lighthouse_aerie/light.o"(.text)
        "*/games/tla/src/scene/jupiter_lighthouse_aerie/lightcue.o"(.text)
        "*/games/tla/src/field/object/set_sprite_priority.o"(.text)
        "*/games/tla/src/field/field_effect/move.o"(.text)
        "*/games/tla/src/scene/jupiter_lighthouse_aerie/s1e78.o"(.text)
        "*/games/tla/src/scene/jupiter_lighthouse_aerie/s2040.o"(.text)
        "*/games/tla/src/scene/jupiter_lighthouse_aerie/s216c.o"(.text)
        "*/games/tla/src/scene/jupiter_lighthouse_aerie/s23b0.o"(.text)
        "*/games/tla/src/scene/jupiter_lighthouse_aerie/s24a8.o"(.text)
        "*/games/tla/src/field/field_effect/advance_motion.o"(.text)
        "*/games/tla/src/scene/jupiter_lighthouse_aerie/s2640.o"(.text)
        "*/games/tla/src/scene/jupiter_lighthouse_aerie/s27d8.o"(.text)
        "*/games/tla/src/scene/jupiter_lighthouse_aerie/s2888.o"(.text)
        "*/games/tla/src/scene/jupiter_lighthouse_aerie/import.o"(.text)
        "*/games/tla/src/graphics/field/cached_a.o"(.rodata)
        "*/games/tla/src/graphics/field/cached_b.o"(.rodata)
        "*/games/tla/src/graphics/field/cached_c.o"(.rodata)
        "*/games/tla/src/scene/jupiter_lighthouse_aerie/data.o"(.data)
    }
    .bss : { "*/resource_6a4_overlay.o"(.bss) }
    /DISCARD/ : { *(.ARM.attributes) *(.comment) *(.note*) }
}
