SECTIONS
{
    .text 0x2008000 :
    {
        "*/games/tla/src/scene/mars_lighthouse_room_m/entry.o"(.text)
        "*/games/tla/src/scene/mars_lighthouse_room_m/scene_tables.o"(.text)
        "*/games/tla/src/scene/mars_lighthouse_room_m/hide.o"(.text)
        "*/games/tla/src/scene/mars_lighthouse_room_m/s0080.o"(.text)
        "*/resource_6ac_overlay.o"(.text.x020080c0)
        "*/games/tla/src/scene/mars_lighthouse_room_m/start.o"(.text)
        "*/games/tla/src/scene/mars_lighthouse_room_m/s030c.o"(.text)
        "*/resource_6ac_overlay.o"(.text.x020083c4)
        "*/resource_6ac_overlay.o"(.text.x0200855c)
        "*/games/tla/src/scene/mars_lighthouse_room_m/s06c8.o"(.text)
        "*/resource_6ac_overlay.o"(.text.x02008934)
        "*/games/tla/src/scene/mars_lighthouse_room_m/finish.o"(.text)
        "*/games/tla/src/scene/mars_lighthouse_room_m/s0af4.o"(.text)
        "*/resource_6ac_overlay.o"(.text.x02008b64)
        "*/resource_6ac_overlay.o"(.text.x02008e84)
        "*/games/tla/src/scene/mars_lighthouse_room_m/s10e4.o"(.text)
        "*/resource_6ac_overlay.o"(.text.x0200954c)
        "*/games/tla/src/scene/mars_lighthouse_room_m/s1608.o"(.text)
        "*/games/tla/src/scene/mars_lighthouse_room_m/stop.o"(.text)
        "*/games/tla/src/scene/mars_lighthouse_room_m/s168c.o"(.text)
        "*/resource_6ac_overlay.o"(.text.x020096e8)
        "*/resource_6ac_overlay.o"(.text.x0200970c)
        "*/games/tla/src/scene/mars_lighthouse_room_m/s183c.o"(.text)
        "*/games/tla/src/scene/mars_lighthouse_room_m/s18c4.o"(.text)
        "*/resource_6ac_overlay.o"(.text.x02009988)
        "*/games/tla/src/scene/mars_lighthouse_room_m/s1aec.o"(.text)
        "*/resource_6ac_overlay.o"(.text.x02009b64)
        "*/games/tla/src/scene/mars_lighthouse_room_m/s1d08.o"(.text)
        "*/games/tla/src/scene/mars_lighthouse_room_m/s1e38.o"(.text)
        "*/games/tla/src/scene/mars_lighthouse_room_m/s1ed4.o"(.text)
        "*/games/tla/src/scene/mars_lighthouse_room_m/s1f14.o"(.text)
        "*/resource_6ac_overlay.o"(.text.x02009f94)
        "*/games/tla/src/scene/mars_lighthouse_room_m/s2118.o"(.text)
        "*/games/tla/src/scene/mars_lighthouse_room_m/ride_handle.o"(.text)
        "*/resource_6ac_overlay.o"(.text.x0200a18c)
        "*/games/tla/src/scene/mars_lighthouse_room_m/ride.o"(.text)
        "*/resource_6ac_overlay.o"(.text.x0200a368)
        "*/games/tla/src/field/common/effect/advance_spin.o"(.text)
        "*/games/tla/src/scene/mars_lighthouse_room_m/flash.o"(.text)
        "*/resource_6ac_overlay.o"(.text.x0200a4e4)
        "*/games/tla/src/scene/mars_lighthouse_room_m/ride_step.o"(.text)
        "*/resource_6ac_overlay.o"(.text.x0200a708)
        "*/games/tla/src/scene/mars_lighthouse_room_m/ride_active.o"(.text)
        "*/resource_6ac_overlay.o"(.text.x0200a870)
        "*/games/tla/src/scene/mars_lighthouse_room_m/s29f4.o"(.text)
        "*/games/tla/src/scene/mars_lighthouse_room_m/flag_state.o"(.text)
        "*/resource_6ac_overlay.o"(.text.x0200aae8)
        "*/games/tla/src/scene/mars_lighthouse_room_m/s2df4.o"(.text)
        "*/resource_6ac_overlay.o"(.text.x0200ae6c)
        "*/games/tla/src/scene/mars_lighthouse_room_m/s2f34.o"(.text)
        "*/games/tla/src/scene/mars_lighthouse_room_m/reset.o"(.text)
        "*/games/tla/src/scene/mars_lighthouse_room_m/import.o"(.text)
        "*/games/tla/src/scene/mars_lighthouse_room_m/data.o"(.data)
    }
    .bss : { "*/resource_6ac_overlay.o"(.bss) }
    /DISCARD/ : { *(.ARM.attributes) *(.comment) *(.note*) }
}
