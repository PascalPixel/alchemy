SECTIONS
{
    .text 0x2008000 :
    {
        "*/games/tla/src/scene/magma_rock_inside/entry.o"(.text)
        "*/games/tla/src/field/object/set_sprite_priority.o"(.text)
        "*/resource_692_overlay.o"(.text.x0200807e)
        "*/games/tla/src/field/object/prepare_object.o"(.text)
        "*/resource_692_overlay.o"(.text.x020080ce)
        "*/games/tla/src/scene/magma_rock_inside/s00d0.o"(.text)
        "*/recon/tla/raw/src/field/field_effect/move.o"(.text)
        "*/resource_692_overlay.o"(.text.x0200815a)
        "*/recon/tla/raw/src/scene/magma_rock_inside/s015c.o"(.text)
        "*/recon/tla/raw/src/scene/magma_rock_inside/s033c.o"(.text)
        "*/recon/tla/raw/src/field/object/find_in_cell.o"(.text)
        "*/recon/tla/raw/src/scene/magma_rock_inside/s03b4.o"(.text)
        "*/recon/tla/raw/src/scene/magma_rock_inside/s0538.o"(.text)
        "*/games/tla/src/scene/magma_rock_inside/s0594.o"(.text)
        "*/recon/tla/raw/src/scene/magma_rock_inside/dist.o"(.text)
        "*/recon/tla/raw/src/scene/magma_rock_inside/s05dc.o"(.text)
        "*/games/tla/src/scene/magma_rock_inside/map.o"(.text)
        "*/recon/tla/raw/src/scene/magma_rock_inside/s06dc.o"(.text)
        "*/recon/tla/raw/src/scene/magma_rock_inside/s075c.o"(.text)
        "*/games/tla/src/scene/magma_rock_inside/s07ac.o"(.text)
        "*/recon/tla/raw/src/scene/magma_rock_inside/s0800.o"(.text)
        "*/recon/tla/raw/src/scene/magma_rock_inside/s0880.o"(.text)
        "*/games/tla/src/scene/magma_rock_inside/scene_tables.o"(.text)
        "*/recon/tla/raw/src/scene/magma_rock_inside/s08f8.o"(.text)
        "*/recon/tla/raw/src/scene/magma_rock_inside/s0a30.o"(.text)
        "*/recon/tla/raw/src/scene/magma_rock_inside/s0ce4.o"(.text)
        "*/recon/tla/raw/src/scene/magma_rock_inside/s0d1c.o"(.text)
        "*/games/tla/src/scene/magma_rock_inside/blink.o"(.text)
        "*/recon/tla/raw/src/scene/magma_rock_inside/s0dcc.o"(.text)
        "*/games/tla/src/scene/magma_rock_inside/s0e14.o"(.text)
        "*/recon/tla/raw/src/scene/magma_rock_inside/s0e20.o"(.text)
        "*/recon/tla/raw/src/scene/magma_rock_inside/s0ea4.o"(.text)
        "*/recon/tla/raw/src/scene/magma_rock_inside/s0ed0.o"(.text)
        "*/recon/tla/raw/src/scene/magma_rock_inside/s1148.o"(.text)
        "*/recon/tla/raw/src/scene/magma_rock_inside/s11fc.o"(.text)
        "*/recon/tla/raw/src/scene/magma_rock_inside/s1350.o"(.text)
        "*/resource_692_overlay.o"(.text.x02009828)
        "*/recon/tla/raw/src/scene/magma_rock_inside/s1ca0.o"(.text)
        "*/recon/tla/raw/src/scene/magma_rock_inside/s1d64.o"(.text)
        "*/recon/tla/raw/src/scene/magma_rock_inside/s2128.o"(.text)
        "*/games/tla/src/scene/magma_rock_inside/s217c.o"(.text)
        "*/recon/tla/raw/src/scene/magma_rock_inside/s21c0.o"(.text)
        "*/games/tla/src/scene/magma_rock_inside/s2318.o"(.text)
        "*/games/tla/src/scene/magma_rock_inside/s23e8.o"(.text)
        "*/recon/tla/raw/src/scene/magma_rock_inside/s24ac.o"(.text)
        "*/recon/tla/raw/src/scene/magma_rock_inside/s255c.o"(.text)
        "*/recon/tla/raw/src/scene/magma_rock_inside/s26a4.o"(.text)
        "*/recon/tla/raw/src/scene/magma_rock_inside/s27d4.o"(.text)
        "*/games/tla/src/scene/magma_rock_inside/s2868.o"(.text)
        "*/recon/tla/raw/src/scene/magma_rock_inside/s28ac.o"(.text)
        "*/games/tla/src/scene/magma_rock_inside/s29dc.o"(.text)
        "*/recon/tla/raw/src/scene/magma_rock_inside/s2a14.o"(.text)
        "*/recon/tla/raw/src/scene/magma_rock_inside/s2a6c.o"(.text)
        "*/recon/tla/raw/src/scene/magma_rock_inside/s2b2c.o"(.text)
        "*/recon/tla/raw/src/scene/magma_rock_inside/s2bd0.o"(.text)
        "*/games/tla/src/scene/magma_rock_inside/s2c1c.o"(.text)
        "*/recon/tla/raw/src/scene/magma_rock_inside/s2c48.o"(.text)
        "*/recon/tla/raw/src/scene/magma_rock_inside/s2cd0.o"(.text)
        "*/recon/tla/raw/src/scene/magma_rock_inside/s30cc.o"(.text)
        "*/games/tla/src/scene/magma_rock_inside/s32d8.o"(.text)
        "*/games/tla/src/scene/magma_rock_inside/s3418.o"(.text)
        "*/games/tla/src/scene/magma_rock_inside/s34bc.o"(.text)
        "*/games/tla/src/scene/magma_rock_inside/s34f0.o"(.text)
        "*/recon/tla/raw/src/scene/magma_rock_inside/s3548.o"(.text)
        "*/recon/tla/raw/src/scene/magma_rock_inside/s3678.o"(.text)
        "*/recon/tla/raw/src/scene/magma_rock_inside/s3ee0.o"(.text)
        "*/recon/tla/raw/src/scene/magma_rock_inside/s3f44.o"(.text)
        "*/recon/tla/raw/src/scene/magma_rock_inside/s406c.o"(.text)
        "*/recon/tla/raw/src/scene/magma_rock_inside/s4200.o"(.text)
        "*/games/tla/src/scene/magma_rock_inside/s42e0.o"(.text)
        "*/recon/tla/raw/src/scene/magma_rock_inside/s42f8.o"(.text)
        "*/games/tla/src/scene/magma_rock_inside/s4460.o"(.text)
        "*/recon/tla/raw/src/scene/magma_rock_inside/s447c.o"(.text)
        "*/recon/tla/raw/src/field/field_effect/advance_motion_priority.o"(.text)
        "*/recon/tla/raw/src/scene/magma_rock_inside/s46e8.o"(.text)
        "*/recon/tla/raw/src/scene/magma_rock_inside/s481c.o"(.text)
        "*/recon/tla/raw/src/scene/magma_rock_inside/s4934.o"(.text)
        "*/games/tla/src/scene/magma_rock_inside/s49c0.o"(.text)
        "*/recon/tla/raw/src/scene/magma_rock_inside/s49d8.o"(.text)
        "*/recon/tla/raw/src/scene/magma_rock_inside/s4a5c.o"(.text)
        "*/recon/tla/raw/src/scene/magma_rock_inside/s4b18.o"(.text)
        "*/recon/tla/raw/src/scene/magma_rock_inside/s4bd4.o"(.text)
        "*/games/tla/src/scene/magma_rock_inside/import.o"(.text)
        "*/games/tla/src/scene/magma_rock_inside/data.o"(.data)
    }
    .bss : { "*/resource_692_overlay.o"(.bss) }
    /DISCARD/ : { *(.ARM.attributes) *(.comment) *(.note*) }
}
