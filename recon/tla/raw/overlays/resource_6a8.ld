SECTIONS
{
    .text 0x2008000 :
    {
        "*/games/tla/src/scene/prox/entry.o"(.text)
        "*/games/tla/src/field/object/set_sprite_priority.o"(.text)
        "*/resource_6a8_overlay.o"(.text.x0200807e)
        "*/games/tla/src/field/field_effect/move.o"(.text)
        "*/resource_6a8_overlay.o"(.text.x020080b6)
        "*/recon/tla/raw/src/scene/prox/s00b8.o"(.text)
        "*/games/tla/src/scene/prox/s0280.o"(.text)
        "*/games/tla/src/scene/prox/s0290.o"(.text)
        "*/recon/tla/raw/src/scene/venus_lighthouse/distance.o"(.text)
        "*/recon/tla/raw/src/scene/prox/s02d8.o"(.text)
        "*/recon/tla/raw/src/scene/prox/s03bc.o"(.text)
        "*/games/tla/src/scene/prox/scene_tables.o"(.text)
        "*/recon/tla/raw/src/scene/prox/s048c.o"(.text)
        "*/games/tla/src/scene/prox/s0588.o"(.text)
        "*/games/tla/src/scene/prox/s0598.o"(.text)
        "*/recon/tla/raw/src/scene/prox/s0620.o"(.text)
        "*/recon/tla/raw/src/scene/prox/s0674.o"(.text)
        "*/recon/tla/raw/src/scene/prox/s06c4.o"(.text)
        "*/recon/tla/raw/src/scene/prox/s0714.o"(.text)
        "*/games/tla/src/scene/prox/s0764.o"(.text)
        "*/recon/tla/raw/src/scene/prox/s0914.o"(.text)
        "*/recon/tla/raw/src/scene/prox/s0ad8.o"(.text)
        "*/recon/tla/raw/src/scene/prox/s0dac.o"(.text)
        "*/recon/tla/raw/src/scene/prox/s15d0.o"(.text)
        "*/recon/tla/raw/src/scene/prox/s1770.o"(.text)
        "*/games/tla/src/scene/prox/s17e4.o"(.text)
        "*/games/tla/src/scene/prox/s1800.o"(.text)
        "*/recon/tla/raw/src/scene/prox/s181c.o"(.text)
        "*/recon/tla/raw/src/scene/prox/s1860.o"(.text)
        "*/games/tla/src/scene/prox/s18e0.o"(.text)
        "*/games/tla/src/scene/prox/s19a4.o"(.text)
        "*/games/tla/src/scene/prox/s1a9c.o"(.text)
        "*/games/tla/src/scene/prox/s1ab8.o"(.text)
        "*/games/tla/src/scene/prox/s1ad4.o"(.text)
        "*/games/tla/src/scene/prox/s1af0.o"(.text)
        "*/games/tla/src/scene/prox/s1b0c.o"(.text)
        "*/games/tla/src/scene/prox/s1b28.o"(.text)
        "*/games/tla/src/scene/prox/s1b44.o"(.text)
        "*/games/tla/src/scene/prox/s1b60.o"(.text)
        "*/games/tla/src/scene/prox/s1b7c.o"(.text)
        "*/games/tla/src/scene/prox/s1c24.o"(.text)
        "*/recon/tla/raw/src/scene/prox/s1cf0.o"(.text)
        "*/recon/tla/raw/src/scene/prox/s2614.o"(.text)
        "*/games/tla/src/scene/prox/prepare.o"(.text)
        "*/recon/tla/raw/src/scene/prox/s279c.o"(.text)
        "*/recon/tla/raw/src/scene/prox/s27e4.o"(.text)
        "*/recon/tla/raw/src/scene/prox/s2878.o"(.text)
        "*/games/tla/src/scene/prox/s29a4.o"(.text)
        "*/recon/tla/raw/src/scene/prox/s29c8.o"(.text)
        "*/games/tla/src/scene/prox/s2a08.o"(.text)
        "*/recon/tla/raw/src/scene/prox/s2a38.o"(.text)
        "*/recon/tla/raw/src/scene/prox/s2a8c.o"(.text)
        "*/games/tla/src/scene/prox/s385c.o"(.text)
        "*/recon/tla/raw/src/scene/prox/s38e8.o"(.text)
        "*/recon/tla/raw/src/scene/prox/s391c.o"(.text)
        "*/recon/tla/raw/src/scene/prox/s3bc8.o"(.text)
        "*/games/tla/src/scene/prox/s3edc.o"(.text)
        "*/recon/tla/raw/src/scene/prox/s3ee8.o"(.text)
        "*/recon/tla/raw/src/scene/prox/s4114.o"(.text)
        "*/recon/tla/raw/src/scene/prox/s4198.o"(.text)
        "*/recon/tla/raw/src/scene/prox/s4254.o"(.text)
        "*/recon/tla/raw/src/scene/prox/s4310.o"(.text)
        "*/games/tla/src/scene/prox/import.o"(.text)
        "*/games/tla/src/scene/prox/data.o"(.data)
    }
    .bss : { "*/resource_6a8_overlay.o"(.bss) }
    /DISCARD/ : { *(.ARM.attributes) *(.comment) *(.note*) }
}
