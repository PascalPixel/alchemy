SECTIONS
{
    .text 0x2008000 :
    {
        "*/games/tla/src/scene/dehkan_plateau/entry.o"(.text)
        "*/games/tla/src/scene/dehkan_plateau/s0038.o"(.text)
        "*/games/tla/src/scene/dehkan_plateau/s00a4.o"(.text)
        "*/games/tla/src/scene/dehkan_plateau/s0128.o"(.text)
        "*/games/tla/src/scene/dehkan_plateau/s01d0.o"(.text)
        "*/games/tla/src/scene/dehkan_plateau/s02f8.o"(.text)
        "*/games/tla/src/scene/dehkan_plateau/s048c.o"(.text)
        "*/games/tla/src/scene/dehkan_plateau/events_l.o"(.text)
        "*/games/tla/src/scene/dehkan_plateau/s0584.o"(.text)
        "*/games/tla/src/scene/dehkan_plateau/events_m.o"(.text)
        "*/games/tla/src/scene/dehkan_plateau/s0708.o"(.text)
        "*/games/tla/src/field/field_effect/advance_motion_priority.o"(.text)
        "*/games/tla/src/scene/dehkan_plateau/s0974.o"(.text)
        "*/games/tla/src/scene/dehkan_plateau/s0aa8.o"(.text)
        "*/games/tla/src/scene/dehkan_plateau/s0bc0.o"(.text)
        "*/games/tla/src/scene/dehkan_plateau/events_n.o"(.text)
        "*/games/tla/src/scene/dehkan_plateau/s0c64.o"(.text)
        "*/games/tla/src/scene/dehkan_plateau/s0d78.o"(.text)
        "*/resource_655_overlay.o"(.text.x02008e9c)
        "*/games/tla/src/field/object/set_sprite_priority.o"(.text)
        "*/games/tla/src/field/field_effect/move.o"(.text)
        "*/games/tla/src/scene/dehkan_plateau/s0fc4.o"(.text)
        "*/games/tla/src/scene/dehkan_plateau/events_o.o"(.text)
        "*/games/tla/src/scene/dehkan_plateau/scene_tables.o"(.text)
        "*/games/tla/src/scene/dehkan_plateau/s11b8.o"(.text)
        "*/games/tla/src/scene/dehkan_plateau/events_a.o"(.text)
        "*/games/tla/src/scene/dehkan_plateau/s1368.o"(.text)
        "*/games/tla/src/scene/dehkan_plateau/events_b.o"(.text)
        "*/games/tla/src/scene/dehkan_plateau/s1444.o"(.text)
        "*/games/tla/src/scene/dehkan_plateau/s1474.o"(.text)
        "*/games/tla/src/scene/dehkan_plateau/events_c.o"(.text)
        "*/games/tla/src/scene/dehkan_plateau/s1514.o"(.text)
        "*/games/tla/src/scene/dehkan_plateau/events_d.o"(.text)
        "*/games/tla/src/scene/dehkan_plateau/s1820.o"(.text)
        "*/games/tla/src/scene/dehkan_plateau/s18a8.o"(.text)
        "*/games/tla/src/scene/dehkan_plateau/s1930.o"(.text)
        "*/games/tla/src/scene/dehkan_plateau/s19b8.o"(.text)
        "*/games/tla/src/scene/dehkan_plateau/s1a30.o"(.text)
        "*/games/tla/src/scene/dehkan_plateau/events_e.o"(.text)
        "*/games/tla/src/scene/dehkan_plateau/s2124.o"(.text)
        "*/games/tla/src/scene/dehkan_plateau/events_f.o"(.text)
        "*/games/tla/src/scene/dehkan_plateau/events_g.o"(.text)
        "*/games/tla/src/scene/dehkan_plateau/events_h.o"(.text)
        "*/games/tla/src/field/field_effect/advance_motion.o"(.text)
        "*/games/tla/src/scene/dehkan_plateau/s2698.o"(.text)
        "*/games/tla/src/scene/dehkan_plateau/s27e0.o"(.text)
        "*/games/tla/src/scene/dehkan_plateau/s2a5c.o"(.text)
        "*/games/tla/src/scene/dehkan_plateau/s2b68.o"(.text)
        "*/games/tla/src/scene/dehkan_plateau/events_i.o"(.text)
        "*/games/tla/src/scene/dehkan_plateau/s2c14.o"(.text)
        "*/games/tla/src/scene/dehkan_plateau/s2dd4.o"(.text)
        "*/games/tla/src/scene/dehkan_plateau/s2f08.o"(.text)
        "*/games/tla/src/scene/dehkan_plateau/events_j.o"(.text)
        "*/games/tla/src/scene/dehkan_plateau/s2ff4.o"(.text)
        "*/games/tla/src/scene/dehkan_plateau/events_k.o"(.text)
        "*/games/tla/src/scene/dehkan_plateau/s30e4.o"(.text)
        "*/games/tla/src/scene/dehkan_plateau/s3164.o"(.text)
        "*/games/tla/src/scene/dehkan_plateau/s3284.o"(.text)
        "*/games/tla/src/scene/dehkan_plateau/s353c.o"(.text)
        "*/games/tla/src/scene/dehkan_plateau/s35ec.o"(.text)
        "*/games/tla/src/scene/dehkan_plateau/s369c.o"(.text)
        "*/games/tla/src/scene/dehkan_plateau/s3764.o"(.text)
        "*/games/tla/src/scene/dehkan_plateau/s390c.o"(.text)
        "*/games/tla/src/scene/dehkan_plateau/s3a30.o"(.text)
        "*/games/tla/src/scene/dehkan_plateau/s3aa0.o"(.text)
        "*/games/tla/src/scene/dehkan_plateau/prepare.o"(.text)
        "*/games/tla/src/scene/dehkan_plateau/import.o"(.text)
        "*/games/tla/src/scene/dehkan_plateau/data.o"(.data)
    }
    .bss : { "*/resource_655_overlay.o"(.bss) }
    /DISCARD/ : { *(.ARM.attributes) *(.comment) *(.note*) }
}
