SECTIONS
{
    .text 0x2008000 :
    {
        "*/games/tla/src/scene/apojii_islands/entry.o"(.text)
        "*/games/tla/src/field/object/set_sprite_priority.o"(.text)
        "*/resource_679_overlay.o"(.text.x0200807e)
        "*/games/tla/src/field/object/prepare_object.o"(.text)
        "*/games/tla/src/scene/apojii_islands/object.o"(.text)
        "*/recon/tla/raw/src/field/field_effect/move.o"(.text)
        "*/resource_679_overlay.o"(.text.x0200815a)
        "*/recon/tla/raw/src/scene/apojii_islands/s015c.o"(.text)
        "*/games/tla/src/scene/apojii_islands/scene_tables.o"(.text)
        "*/games/tla/src/scene/apojii_islands/s0360.o"(.text)
        "*/games/tla/src/scene/apojii_islands/events_a.o"(.text)
        "*/recon/tla/raw/src/scene/apojii_islands/s03e8.o"(.text)
        "*/recon/tla/raw/src/scene/apojii_islands/s0540.o"(.text)
        "*/games/tla/src/scene/apojii_islands/events_b.o"(.text)
        "*/recon/tla/raw/src/scene/apojii_islands/s06bc.o"(.text)
        "*/recon/tla/raw/src/scene/apojii_islands/events_c.o"(.text)
        "*/recon/tla/raw/src/scene/apojii_islands/s07a4.o"(.text)
        "*/recon/tla/raw/src/scene/apojii_islands/events_d.o"(.text)
        "*/games/tla/src/scene/apojii_islands/s0d90.o"(.text)
        "*/recon/tla/raw/src/scene/apojii_islands/events_e.o"(.text)
        "*/recon/tla/raw/src/scene/apojii_islands/s0ef8.o"(.text)
        "*/recon/tla/raw/src/scene/apojii_islands/events_f.o"(.text)
        "*/games/tla/src/scene/apojii_islands/prepare.o"(.text)
        "*/games/tla/src/scene/apojii_islands/s1054.o"(.text)
        "*/recon/tla/raw/src/scene/apojii_islands/events_g.o"(.text)
        "*/recon/tla/raw/src/scene/apojii_islands/s10d8.o"(.text)
        "*/recon/tla/raw/src/scene/apojii_islands/events_h.o"(.text)
        "*/recon/tla/raw/src/scene/apojii_islands/s11a8.o"(.text)
        "*/recon/tla/raw/src/scene/apojii_islands/events_i.o"(.text)
        "*/recon/tla/raw/src/scene/apojii_islands/s1464.o"(.text)
        "*/resource_679_overlay.o"(.text.x020095f8)
        "*/recon/tla/raw/src/scene/apojii_islands/s17bc.o"(.text)
        "*/resource_679_overlay.o"(.text.x020097f8)
        "*/recon/tla/raw/src/scene/apojii_islands/s1940.o"(.text)
        "*/recon/tla/raw/src/scene/apojii_islands/s1ad8.o"(.text)
        "*/games/tla/src/scene/apojii_islands/events_j.o"(.text)
        "*/games/tla/src/scene/apojii_islands/import.o"(.text)
        "*/games/tla/src/scene/apojii_islands/data.o"(.data)
        "*/games/tla/src/graphics/field/tiles679.o"(.rodata)
    }
    .bss : { "*/resource_679_overlay.o"(.bss) }
    /DISCARD/ : { *(.ARM.attributes) *(.comment) *(.note*) }
}
