SECTIONS
{
    .text 0x2008000 :
    {
        "*/games/tla/src/scene/jupiter_lighthouse_room_1/entry.o"(.text)
        "*/games/tla/src/scene/jupiter_lighthouse_room_1/scene_tables.o"(.text)
        "*/games/tla/src/scene/jupiter_lighthouse_room_1/script0.o"(.text)
        "*/recon/tla/raw/src/scene/jupiter_lighthouse_room_1/script1.o"(.text)
        "*/games/tla/src/scene/jupiter_lighthouse_room_1/script2.o"(.text)
        "*/games/tla/src/scene/jupiter_lighthouse_room_1/scene_events.o"(.text)
        "*/recon/tla/raw/src/scene/jupiter_lighthouse_room_1/setup.o"(.text)
        "*/games/tla/src/scene/jupiter_lighthouse_room_1/prepare.o"(.text)
        "*/recon/tla/raw/src/scene/shared/scene_set_arrival_flags.o"(.text)
        "*/games/tla/src/scene/jupiter_lighthouse_room_1/lightmod.o"(.text)
        "*/recon/tla/raw/src/scene/jupiter_lighthouse_room_1/s02c8.o"(.text)
        "*/recon/tla/raw/src/scene/jupiter_lighthouse_room_1/lightset.o"(.text)
        "*/recon/tla/raw/src/scene/jupiter_lighthouse_room_1/s045c.o"(.text)
        "*/recon/tla/raw/src/scene/jupiter_lighthouse_room_1/dist.o"(.text)
        "*/recon/tla/raw/src/scene/jupiter_lighthouse_room_1/s0674.o"(.text)
        "*/recon/tla/raw/src/scene/jupiter_lighthouse_room_1/s0834.o"(.text)
        "*/recon/tla/raw/src/scene/jupiter_lighthouse_room_1/s090c.o"(.text)
        "*/recon/tla/raw/src/scene/jupiter_lighthouse_room_1/s09ac.o"(.text)
        "*/recon/tla/raw/src/scene/jupiter_lighthouse_room_1/s0b3c.o"(.text)
        "*/recon/tla/raw/src/scene/jupiter_lighthouse_room_1/light.o"(.text)
        "*/games/tla/src/scene/jupiter_lighthouse_room_1/lightcue.o"(.text)
        "*/games/tla/src/field/object/set_sprite_priority.o"(.text)
        "*/games/tla/src/field/field_effect/move.o"(.text)
        "*/recon/tla/raw/src/scene/jupiter_lighthouse_room_1/s0f3c.o"(.text)
        "*/recon/tla/raw/src/scene/jupiter_lighthouse_room_1/s1104.o"(.text)
        "*/recon/tla/raw/src/scene/jupiter_lighthouse_room_1/s1230.o"(.text)
        "*/recon/tla/raw/src/scene/jupiter_lighthouse_room_1/s1474.o"(.text)
        "*/recon/tla/raw/src/scene/jupiter_lighthouse_room_1/s156c.o"(.text)
        "*/games/tla/src/field/field_effect/advance_motion.o"(.text)
        "*/recon/tla/raw/src/scene/jupiter_lighthouse_room_1/s1704.o"(.text)
        "*/games/tla/src/scene/jupiter_lighthouse_room_1/s189c.o"(.text)
        "*/recon/tla/raw/src/scene/jupiter_lighthouse_room_1/s194c.o"(.text)
        "*/games/tla/src/scene/jupiter_lighthouse_room_1/import.o"(.text)
        "*/games/tla/src/graphics/field/cached_a.o"(.rodata)
        "*/games/tla/src/graphics/field/cached_b.o"(.rodata)
        "*/games/tla/src/graphics/field/cached_c.o"(.rodata)
        "*/games/tla/src/scene/jupiter_lighthouse_room_1/data.o"(.data)
    }
    .bss : { "*/resource_69a_overlay.o"(.bss) }
    /DISCARD/ : { *(.ARM.attributes) *(.comment) *(.note*) }
}
