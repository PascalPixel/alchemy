SECTIONS
{
    .text 0x2008000 :
    {
        "*/games/tla/src/scene/settlements/entry.o"(.text)
        "*/games/tla/src/field/object/set_sprite_priority.o"(.text)
        "*/resource_690_overlay.o"(.text.x0200807e)
        "*/recon/tla/raw/src/field/field_effect/move.o"(.text)
        "*/resource_690_overlay.o"(.text.x020080b6)
        "*/recon/tla/raw/src/scene/settlements/s00b8.o"(.text)
        "*/games/tla/src/scene/settlements/s0280.o"(.text)
        "*/games/tla/src/scene/settlements/scene_tables.o"(.text)
        "*/games/tla/src/scene/settlements/placements.o"(.text)
        "*/games/tla/src/scene/settlements/exits.o"(.text)
        "*/games/tla/src/scene/settlements/s0358.o"(.text)
        "*/recon/tla/raw/src/scene/settlements/events_a.o"(.text)
        "*/games/tla/src/scene/settlements/s0668.o"(.text)
        "*/recon/tla/raw/src/scene/settlements/s0758.o"(.text)
        "*/games/tla/src/scene/settlements/s07fc.o"(.text)
        "*/recon/tla/raw/src/scene/settlements/s0860.o"(.text)
        "*/recon/tla/raw/src/scene/settlements/s0988.o"(.text)
        "*/recon/tla/raw/src/scene/settlements/s0b18.o"(.text)
        "*/recon/tla/raw/src/scene/settlements/s0c1c.o"(.text)
        "*/games/tla/src/scene/settlements/s0c44.o"(.text)
        "*/recon/tla/raw/src/scene/settlements/s0cfc.o"(.text)
        "*/recon/tla/raw/src/scene/settlements/s0d14.o"(.text)
        "*/games/tla/src/scene/settlements/s0e04.o"(.text)
        "*/recon/tla/raw/src/scene/settlements/s0e30.o"(.text)
        "*/recon/tla/raw/src/scene/settlements/s0ed0.o"(.text)
        "*/recon/tla/raw/src/scene/settlements/s0f2c.o"(.text)
        "*/recon/tla/raw/src/scene/settlements/s0fd0.o"(.text)
        "*/recon/tla/raw/src/scene/settlements/s11bc.o"(.text)
        "*/games/tla/src/scene/settlements/s1304.o"(.text)
        "*/recon/tla/raw/src/scene/settlements/s138c.o"(.text)
        "*/games/tla/src/scene/settlements/s155c.o"(.text)
        "*/recon/tla/raw/src/scene/settlements/s156c.o"(.text)
        "*/recon/tla/raw/src/field/field_effect/advance_motion.o"(.text)
        "*/resource_690_overlay.o"(.text.x0200961e)
        "*/recon/tla/raw/src/scene/settlements/s1620.o"(.text)
        "*/games/tla/src/scene/settlements/s16a4.o"(.text)
        "*/recon/tla/raw/src/scene/settlements/s16b0.o"(.text)
        "*/recon/tla/raw/src/scene/settlements/s173c.o"(.text)
        "*/recon/tla/raw/src/scene/settlements/s1770.o"(.text)
        "*/recon/tla/raw/src/scene/settlements/s1a1c.o"(.text)
        "*/games/tla/src/scene/settlements/s1d30.o"(.text)
        "*/recon/tla/raw/src/scene/settlements/s1d3c.o"(.text)
        "*/resource_690_overlay.o"(.text.x02009f66)
        "*/games/tla/src/scene/settlements/import.o"(.text)
        "*/games/tla/src/scene/settlements/data.o"(.data)
    }
    .bss : { "*/resource_690_overlay.o"(.bss) }
    /DISCARD/ : { *(.ARM.attributes) *(.comment) *(.note*) }
}
