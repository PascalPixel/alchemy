SECTIONS
{
    .text 0x2008000 :
    {
        "*/games/tla/src/scene/alhafra/entry.o"(.text)
        "*/games/tla/src/scene/alhafra/scene_tables.o"(.text)
        "*/games/tla/src/scene/alhafra/events_a.o"(.text)
        "*/games/tla/src/scene/alhafra/s0124.o"(.text)
        "*/games/tla/src/scene/alhafra/s0130.o"(.text)
        "*/games/tla/src/scene/alhafra/events_b.o"(.text)
        "*/games/tla/src/scene/alhafra/s023c.o"(.text)
        "*/games/tla/src/scene/alhafra/s0248.o"(.text)
        "*/games/tla/src/scene/alhafra/s0254.o"(.text)
        "*/games/tla/src/scene/alhafra/s0260.o"(.text)
        "*/games/tla/src/scene/alhafra/s026c.o"(.text)
        "*/games/tla/src/scene/alhafra/s0288.o"(.text)
        "*/games/tla/src/scene/alhafra/s02f8.o"(.text)
        "*/games/tla/src/scene/alhafra/s0398.o"(.text)
        "*/games/tla/src/scene/alhafra/s047c.o"(.text)
        "*/games/tla/src/scene/alhafra/s066c.o"(.text)
        "*/games/tla/src/scene/alhafra/s0760.o"(.text)
        "*/games/tla/src/scene/alhafra/s0774.o"(.text)
        "*/games/tla/src/scene/alhafra/s0788.o"(.text)
        "*/games/tla/src/scene/alhafra/s07d4.o"(.text)
        "*/resource_665_overlay.o"(.text.x02008a18)
        "*/games/tla/src/scene/alhafra/s0a98.o"(.text)
        "*/games/tla/src/scene/alhafra/s0aa0.o"(.text)
        "*/games/tla/src/scene/alhafra/s1958.o"(.text)
        "*/games/tla/src/scene/alhafra/import.o"(.text)
        "*/games/tla/src/scene/alhafra/data.o"(.data)
    }
    /DISCARD/ : { *(.ARM.attributes) *(.comment) *(.note*) }
}
