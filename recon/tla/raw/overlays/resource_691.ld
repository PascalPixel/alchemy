SECTIONS
{
    .text 0x2008000 :
    {
        "*/games/tla/src/scene/magma_rock/entry.o"(.text)
        "*/games/tla/src/field/object/set_sprite_priority.o"(.text)
        "*/games/tla/src/field/object/prepare_object.o"(.text)
        "*/games/tla/src/scene/magma_rock/create.o"(.text)
        "*/games/tla/src/field/field_effect/move.o"(.text)
        "*/games/tla/src/scene/magma_rock/s015c.o"(.text)
        "*/games/tla/src/scene/venus_lighthouse/distance.o"(.text)
        "*/games/tla/src/field/object/find_in_cell.o"(.text)
        "*/games/tla/src/scene/magma_rock/s03b4.o"(.text)
        "*/games/tla/src/field/map/cell_fill_byte.o"(.text)
        "*/games/tla/src/scene/magma_rock/distance.o"(.text)
        "*/games/tla/src/scene/magma_rock/s05cc.o"(.text)
        "*/games/tla/src/field/map/cell_get.o"(.text)
        "*/games/tla/src/scene/magma_rock/s0668.o"(.text)
        "*/games/tla/src/scene/magma_rock/s06cc.o"(.text)
        "*/games/tla/src/scene/magma_rock/s074c.o"(.text)
        "*/games/tla/src/scene/magma_rock/s079c.o"(.text)
        "*/games/tla/src/scene/magma_rock/scene_tables.o"(.text)
        "*/games/tla/src/scene/magma_rock/exits.o"(.text)
        "*/games/tla/src/scene/magma_rock/s0940.o"(.text)
        "*/games/tla/src/scene/magma_rock/s0a48.o"(.text)
        "*/games/tla/src/scene/magma_rock/s0c08.o"(.text)
        "*/games/tla/src/scene/magma_rock/s0c40.o"(.text)
        "*/games/tla/src/scene/magma_rock/s0d40.o"(.text)
        "*/games/tla/src/scene/magma_rock/s0dc0.o"(.text)
        "*/games/tla/src/scene/magma_rock/s0ee4.o"(.text)
        "*/games/tla/src/scene/magma_rock/blink.o"(.text)
        "*/games/tla/src/scene/magma_rock/s0ff4.o"(.text)
        "*/games/tla/src/scene/magma_rock/s1084.o"(.text)
        "*/games/tla/src/scene/magma_rock/s10cc.o"(.text)
        "*/games/tla/src/scene/magma_rock/s1110.o"(.text)
        "*/games/tla/src/scene/magma_rock/decay.o"(.text)
        "*/games/tla/src/scene/magma_rock/s11e4.o"(.text)
        "*/games/tla/src/scene/magma_rock/target.o"(.text)
        "*/games/tla/src/scene/magma_rock/s1528.o"(.text)
        "*/games/tla/src/scene/magma_rock/s15e4.o"(.text)
        "*/resource_691_overlay.o"(.text.x02009738)
        "*/games/tla/src/scene/magma_rock/s19e8.o"(.text)
        "*/games/tla/src/scene/magma_rock/switch.o"(.text)
        "*/games/tla/src/scene/magma_rock/calls.o"(.text)
        "*/games/tla/src/scene/magma_rock/s1c00.o"(.text)
        "*/games/tla/src/scene/magma_rock/s1e08.o"(.text)
        "*/games/tla/src/scene/magma_rock/s1edc.o"(.text)
        "*/games/tla/src/scene/magma_rock/copy.o"(.text)
        "*/games/tla/src/scene/magma_rock/s2024.o"(.text)
        "*/games/tla/src/scene/magma_rock/blink_b.o"(.text)
        "*/games/tla/src/scene/magma_rock/s20f8.o"(.text)
        "*/games/tla/src/scene/magma_rock/events_b.o"(.text)
        "*/games/tla/src/field/field_effect/advance_motion.o"(.text)
        "*/games/tla/src/scene/magma_rock/s22ac.o"(.text)
        "*/games/tla/src/scene/magma_rock/s244c.o"(.text)
        "*/games/tla/src/scene/magma_rock/s24c8.o"(.text)
        "*/resource_691_overlay.o"(.text.x0200a518)
        "*/games/tla/src/scene/magma_rock/s2618.o"(.text)
        "*/games/tla/src/scene/magma_rock/prepare.o"(.text)
        "*/games/tla/src/scene/magma_rock/s2d08.o"(.text)
        "*/games/tla/src/scene/magma_rock/s2e30.o"(.text)
        "*/games/tla/src/scene/magma_rock/s2fc4.o"(.text)
        "*/games/tla/src/scene/magma_rock/set_state.o"(.text)
        "*/resource_691_overlay.o"(.text.x0200b0bc)
        "*/games/tla/src/scene/magma_rock/swap_position.o"(.text)
        "*/games/tla/src/scene/magma_rock/s3240.o"(.text)
        "*/games/tla/src/field/field_effect/advance_motion_priority.o"(.text)
        "*/games/tla/src/scene/magma_rock/s34ac.o"(.text)
        "*/games/tla/src/scene/magma_rock/s35e0.o"(.text)
        "*/games/tla/src/scene/magma_rock/s36f8.o"(.text)
        "*/games/tla/src/scene/magma_rock/leader_call.o"(.text)
        "*/games/tla/src/scene/magma_rock/s379c.o"(.text)
        "*/games/tla/src/scene/magma_rock/s3820.o"(.text)
        "*/games/tla/src/scene/magma_rock/s38dc.o"(.text)
        "*/games/tla/src/scene/magma_rock/sparks.o"(.text)
        "*/games/tla/src/scene/magma_rock/import.o"(.text)
        "*/games/tla/src/scene/magma_rock/data.o"(.data)
    }
    /DISCARD/ : { *(.ARM.attributes) *(.comment) *(.note*) }
}
