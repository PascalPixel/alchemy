SECTIONS
{
    .text 0x2008000 :
    {
        "*/games/tla/src/scene/kibombo_mountains/entry.o"(.text)
        "*/games/tla/src/scene/kibombo_mountains/start.o"(.text)
        "*/games/tla/src/scene/kibombo_mountains/scene_tables.o"(.text)
        "*/games/tla/src/scene/kibombo_mountains/s0058.o"(.text)
        "*/games/tla/src/scene/kibombo_mountains/s00ac.o"(.text)
        "*/games/tla/src/scene/kibombo_mountains/s00ec.o"(.text)
        "*/games/tla/src/scene/kibombo_mountains/s015c.o"(.text)
        "*/games/tla/src/scene/kibombo_mountains/action.o"(.text)
        "*/resource_66f_overlay.o"(.text.x020081a0)
        "*/games/tla/src/scene/kibombo_mountains/s036c.o"(.text)
        "*/games/tla/src/scene/kibombo_mountains/flags.o"(.text)
        "*/games/tla/src/scene/kibombo_mountains/s0440.o"(.text)
        "*/games/tla/src/scene/kibombo_mountains/s04b0.o"(.text)
        "*/games/tla/src/scene/kibombo_mountains/cell_call.o"(.text)
        "*/games/tla/src/scene/kibombo_mountains/s051c.o"(.text)
        "*/games/tla/src/scene/kibombo_mountains/s05ec.o"(.text)
        "*/resource_66f_overlay.o"(.text.x0200863c)
        "*/games/tla/src/scene/kibombo_mountains/prepare.o"(.text)
        "*/games/tla/src/scene/kibombo_mountains/s0960.o"(.text)
        "*/games/tla/src/scene/kibombo_mountains/speed.o"(.text)
        "*/games/tla/src/scene/kibombo_mountains/s0af0.o"(.text)
        "*/games/tla/src/scene/kibombo_mountains/s0d80.o"(.text)
        "*/games/tla/src/scene/kibombo_mountains/triggers.o"(.text)
        "*/games/tla/src/scene/kibombo_mountains/import.o"(.text)
        "*/games/tla/src/scene/kibombo_mountains/data.o"(.data)
    }
    /DISCARD/ : { *(.ARM.attributes) *(.comment) *(.note*) }
}
