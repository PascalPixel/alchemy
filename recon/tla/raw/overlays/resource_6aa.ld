SECTIONS
{
    .text 0x2008000 :
    {
        "*/games/tla/src/scene/mars_lighthouse_entrance/entry.o"(.text)
        "*/games/tla/src/scene/mars_lighthouse_entrance/calls.o"(.text)
        "*/games/tla/src/scene/mars_lighthouse_entrance/scene_tables.o"(.text)
        "*/games/tla/src/scene/mars_lighthouse_entrance/s0070.o"(.text)
        "*/games/tla/src/scene/mars_lighthouse_entrance/map.o"(.text)
        "*/games/tla/src/field/object/set_sprite_priority.o"(.text)
        "*/games/tla/src/scene/mars_lighthouse_entrance/s01f8.o"(.text)
        "*/games/tla/src/scene/mars_lighthouse_entrance/s02bc.o"(.text)
        "*/games/tla/src/scene/mars_lighthouse_entrance/s0338.o"(.text)
        "*/games/tla/src/scene/mars_lighthouse_entrance/s040c.o"(.text)
        "*/games/tla/src/scene/mars_lighthouse_entrance/s0414.o"(.text)
        "*/games/tla/src/scene/mars_lighthouse_entrance/s051c.o"(.text)
        "*/games/tla/src/scene/mars_lighthouse_entrance/s0564.o"(.text)
        "*/games/tla/src/scene/mars_lighthouse_entrance/s0590.o"(.text)
        "*/games/tla/src/scene/mars_lighthouse_entrance/s0710.o"(.text)
        "*/games/tla/src/scene/mars_lighthouse_entrance/s0718.o"(.text)
        "*/games/tla/src/scene/mars_lighthouse_entrance/s0930.o"(.text)
        "*/games/tla/src/scene/mars_lighthouse_entrance/s093c.o"(.text)
        "*/games/tla/src/scene/mars_lighthouse_entrance/s09c0.o"(.text)
        "*/games/tla/src/scene/mars_lighthouse_entrance/s0a74.o"(.text)
        "*/games/tla/src/scene/mars_lighthouse_entrance/s0a7c.o"(.text)
        "*/games/tla/src/scene/mars_lighthouse_entrance/s0c68.o"(.text)
        "*/games/tla/src/scene/mars_lighthouse_entrance/s0c84.o"(.text)
        "*/games/tla/src/scene/mars_lighthouse_entrance/s0d18.o"(.text)
        "*/games/tla/src/scene/mars_lighthouse_entrance/s0df0.o"(.text)
        "*/resource_6aa_overlay.o"(.text.x02008e3c)
        "*/games/tla/src/scene/mars_lighthouse_entrance/s0fa4.o"(.text)
        "*/games/tla/src/scene/mars_lighthouse_entrance/s0fd4.o"(.text)
        "*/games/tla/src/scene/mars_lighthouse_entrance/s0fe0.o"(.text)
        "*/games/tla/src/scene/mars_lighthouse_entrance/s112c.o"(.text)
        "*/games/tla/src/scene/mars_lighthouse_entrance/s1138.o"(.text)
        "*/games/tla/src/scene/mars_lighthouse_entrance/dismiss.o"(.text)
        "*/resource_6aa_overlay.o"(.text.x02009254)
        "*/games/tla/src/scene/mars_lighthouse_entrance/s12bc.o"(.text)
        "*/games/tla/src/scene/mars_lighthouse_entrance/s12e4.o"(.text)
        "*/games/tla/src/scene/mars_lighthouse_entrance/s1344.o"(.text)
        "*/games/tla/src/scene/mars_lighthouse_entrance/s1378.o"(.text)
        "*/games/tla/src/scene/mars_lighthouse_entrance/s138c.o"(.text)
        "*/games/tla/src/scene/mars_lighthouse_entrance/s1930.o"(.text)
        "*/games/tla/src/scene/mars_lighthouse_entrance/s1ae0.o"(.text)
        "*/games/tla/src/scene/mars_lighthouse_entrance/s1c44.o"(.text)
        "*/games/tla/src/scene/mars_lighthouse_entrance/s1cbc.o"(.text)
        "*/games/tla/src/scene/mars_lighthouse_entrance/s1e60.o"(.text)
        "*/games/tla/src/scene/mars_lighthouse_entrance/s20ec.o"(.text)
        "*/games/tla/src/scene/mars_lighthouse_entrance/s2270.o"(.text)
        "*/games/tla/src/scene/mars_lighthouse_entrance/ride.o"(.text)
        "*/games/tla/src/scene/mars_lighthouse_entrance/s22e4.o"(.text)
        "*/games/tla/src/scene/mars_lighthouse_entrance/ride_row.o"(.text)
        "*/resource_6aa_overlay.o"(.text.x0200a4c0)
        "*/games/tla/src/field/field_effect/advance_spin.o"(.text)
        "*/games/tla/src/scene/mars_lighthouse_entrance/flash.o"(.text)
        "*/resource_6aa_overlay.o"(.text.x0200a63c)
        "*/games/tla/src/scene/mars_lighthouse_entrance/ride_step.o"(.text)
        "*/games/tla/src/scene/mars_lighthouse_entrance/s2860.o"(.text)
        "*/games/tla/src/scene/mars_lighthouse_entrance/ride_active.o"(.text)
        "*/resource_6aa_overlay.o"(.text.x0200a9c8)
        "*/games/tla/src/scene/mars_lighthouse_entrance/s2b4c.o"(.text)
        "*/games/tla/src/scene/mars_lighthouse_entrance/flag_state.o"(.text)
        "*/games/tla/src/scene/mars_lighthouse_entrance/s2c40.o"(.text)
        "*/games/tla/src/scene/mars_lighthouse_entrance/s2f4c.o"(.text)
        "*/resource_6aa_overlay.o"(.text.x0200afc4)
        "*/games/tla/src/scene/mars_lighthouse_entrance/s308c.o"(.text)
        "*/games/tla/src/scene/mars_lighthouse_entrance/reset.o"(.text)
        "*/games/tla/src/scene/mars_lighthouse_entrance/s31f8.o"(.text)
        "*/games/tla/src/scene/mars_lighthouse_entrance/s3284.o"(.text)
        "*/games/tla/src/scene/mars_lighthouse_entrance/s32b8.o"(.text)
        "*/games/tla/src/scene/mars_lighthouse_entrance/s3564.o"(.text)
        "*/resource_6aa_overlay.o"(.text.x0200b564)
        "*/games/tla/src/scene/mars_lighthouse_entrance/s3878.o"(.text)
        "*/games/tla/src/scene/mars_lighthouse_entrance/s3884.o"(.text)
        "*/games/tla/src/field/object/set_sprite_priority_b.o"(.text)
        "*/games/tla/src/field/field_effect/move.o"(.text)
        "*/games/tla/src/scene/mars_lighthouse_entrance/s3b30.o"(.text)
        "*/games/tla/src/scene/mars_lighthouse_entrance/s3cf8.o"(.text)
        "*/games/tla/src/scene/mars_lighthouse_entrance/s3e24.o"(.text)
        "*/games/tla/src/scene/mars_lighthouse_entrance/s4068.o"(.text)
        "*/games/tla/src/scene/mars_lighthouse_entrance/s4160.o"(.text)
        "*/games/tla/src/field/field_effect/advance_motion.o"(.text)
        "*/games/tla/src/scene/mars_lighthouse_entrance/s42f8.o"(.text)
        "*/games/tla/src/scene/mars_lighthouse_entrance/s4490.o"(.text)
        "*/games/tla/src/scene/mars_lighthouse_entrance/s4540.o"(.text)
        "*/games/tla/src/scene/mars_lighthouse_entrance/s45f8.o"(.text)
        "*/games/tla/src/scene/mars_lighthouse_entrance/s46b4.o"(.text)
        "*/games/tla/src/scene/mars_lighthouse_entrance/stop.o"(.text)
        "*/games/tla/src/scene/mars_lighthouse_entrance/s4738.o"(.text)
        "*/games/tla/src/scene/mars_lighthouse_entrance/s4794.o"(.text)
        "*/resource_6aa_overlay.o"(.text.x0200c7b8)
        "*/games/tla/src/scene/mars_lighthouse_entrance/s48e8.o"(.text)
        "*/games/tla/src/scene/mars_lighthouse_entrance/s4970.o"(.text)
        "*/games/tla/src/scene/mars_lighthouse_entrance/s49dc.o"(.text)
        "*/games/tla/src/scene/mars_lighthouse_entrance/s4a60.o"(.text)
        "*/games/tla/src/scene/mars_lighthouse_entrance/import.o"(.text)
        "*/games/tla/src/scene/mars_lighthouse_entrance/data.o"(.data)
        "*/games/tla/src/scene/mars_lighthouse_entrance/data2.o"(.data)
    }
    .bss : { "*/resource_6aa_overlay.o"(.bss) }
    /DISCARD/ : { *(.ARM.attributes) *(.comment) *(.note*) }
}
