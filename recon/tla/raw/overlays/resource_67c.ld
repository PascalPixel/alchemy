SECTIONS
{
    .text 0x2008000 :
    {
        "*/games/tla/src/scene/aqua_rock_inside/entry.o"(.text)
        "*/games/tla/src/field/common/object/set_sprite_priority.o"(.text)
        "*/resource_67c_overlay.o"(.text.x0200807e)
        "*/games/tla/src/field/common/object/prepare_object.o"(.text)
        "*/resource_67c_overlay.o"(.text.x020080ce)
        "*/games/tla/src/scene/aqua_rock_inside/s00d0.o"(.text)
        "*/games/tla/src/field/common/effect/move.o"(.text)
        "*/resource_67c_overlay.o"(.text.x0200815a)
        "*/resource_67c_overlay.o"(.text.x0200815c)
        "*/games/tla/src/scene/aqua_rock_inside/s033c.o"(.text)
        "*/games/tla/src/scene/aqua_rock_inside/scene_tables.o"(.text)
        "*/games/tla/src/scene/aqua_rock_inside/s035c.o"(.text)
        "*/games/tla/src/scene/aqua_rock_inside/s042c.o"(.text)
        "*/games/tla/src/scene/aqua_rock_inside/s04b4.o"(.text)
        "*/games/tla/src/scene/aqua_rock_inside/s0574.o"(.text)
        "*/games/tla/src/scene/aqua_rock_inside/s05f8.o"(.text)
        "*/games/tla/src/scene/aqua_rock_inside/s061c.o"(.text)
        "*/games/tla/src/scene/aqua_rock_inside/s0644.o"(.text)
        "*/games/tla/src/scene/aqua_rock_inside/s0690.o"(.text)
        "*/games/tla/src/scene/aqua_rock_inside/s071c.o"(.text)
        "*/games/tla/src/scene/aqua_rock_inside/s07a8.o"(.text)
        "*/resource_67c_overlay.o"(.text.x020087d4)
        "*/games/tla/src/scene/aqua_rock_inside/s0958.o"(.text)
        "*/games/tla/src/scene/aqua_rock_inside/s0a24.o"(.text)
        "*/games/tla/src/scene/aqua_rock_inside/s0a98.o"(.text)
        "*/games/tla/src/scene/aqua_rock_inside/s0ad8.o"(.text)
        "*/games/tla/src/scene/aqua_rock_inside/s0bd4.o"(.text)
        "*/games/tla/src/scene/aqua_rock_inside/s0c28.o"(.text)
        "*/resource_67c_overlay.o"(.text.x02008cc8)
        "*/games/tla/src/scene/aqua_rock_inside/s0de4.o"(.text)
        "*/games/tla/src/scene/aqua_rock_inside/s0e18.o"(.text)
        "*/games/tla/src/scene/aqua_rock_inside/s0ecc.o"(.text)
        "*/games/tla/src/scene/aqua_rock_inside/s101c.o"(.text)
        "*/games/tla/src/scene/aqua_rock_inside/s10d0.o"(.text)
        "*/games/tla/src/scene/aqua_rock_inside/s11d4.o"(.text)
        "*/games/tla/src/scene/aqua_rock_inside/s124c.o"(.text)
        "*/games/tla/src/scene/aqua_rock_inside/s1328.o"(.text)
        "*/resource_67c_overlay.o"(.text.x020093bc)
        "*/resource_67c_overlay.o"(.text.x0200947c)
        "*/games/tla/src/scene/aqua_rock_inside/s1520.o"(.text)
        "*/games/tla/src/scene/aqua_rock_inside/s156c.o"(.text)
        "*/resource_67c_overlay.o"(.text.x02009598)
        "*/resource_67c_overlay.o"(.text.x02009620)
        "*/games/tla/src/scene/aqua_rock_inside/s1a1c.o"(.text)
        "*/games/tla/src/scene/aqua_rock_inside/s1c68.o"(.text)
        "*/games/tla/src/scene/aqua_rock_inside/s1da8.o"(.text)
        "*/games/tla/src/scene/aqua_rock_inside/s1e78.o"(.text)
        "*/games/tla/src/scene/aqua_rock_inside/s1ea0.o"(.text)
        "*/games/tla/src/scene/aqua_rock_inside/s1f04.o"(.text)
        "*/games/tla/src/scene/aqua_rock_inside/s1fcc.o"(.text)
        "*/resource_67c_overlay.o"(.text.x0200a020)
        "*/resource_67c_overlay.o"(.text.x0200a340)
        "*/resource_67c_overlay.o"(.text.x0200abd4)
        "*/games/tla/src/scene/aqua_rock_inside/s2c3c.o"(.text)
        "*/resource_67c_overlay.o"(.text.x0200aca4)
        "*/games/tla/src/scene/aqua_rock_inside/s2e04.o"(.text)
        "*/games/tla/src/scene/aqua_rock_inside/s2f60.o"(.text)
        "*/resource_67c_overlay.o"(.text.x0200b0f4)
        "*/games/tla/src/scene/aqua_rock_inside/s3278.o"(.text)
        "*/resource_67c_overlay.o"(.text.x0200b2d4)
        "*/games/tla/src/scene/aqua_rock_inside/s3420.o"(.text)
        "*/resource_67c_overlay.o"(.text.x0200b49c)
        "*/resource_67c_overlay.o"(.text.x0200b4fc)
        "*/games/tla/src/scene/aqua_rock_inside/s3628.o"(.text)
        "*/games/tla/src/scene/aqua_rock_inside/s3688.o"(.text)
        "*/resource_67c_overlay.o"(.text.x0200b6b8)
        "*/games/tla/src/scene/aqua_rock_inside/s3844.o"(.text)
        "*/resource_67c_overlay.o"(.text.x0200b994)
        "*/games/tla/src/scene/aqua_rock_inside/s39f0.o"(.text)
        "*/resource_67c_overlay.o"(.text.x0200bab0)
        "*/games/tla/src/scene/aqua_rock_inside/s3ba4.o"(.text)
        "*/games/tla/src/scene/aqua_rock_inside/s3bb8.o"(.text)
        "*/games/tla/src/scene/aqua_rock_inside/s3bcc.o"(.text)
        "*/games/tla/src/scene/aqua_rock_inside/s3c00.o"(.text)
        "*/games/tla/src/scene/aqua_rock_inside/s3c14.o"(.text)
        "*/games/tla/src/scene/aqua_rock_inside/import.o"(.text)
        "*/games/tla/src/scene/aqua_rock_inside/data.o"(.data)
        "*/games/tla/src/scene/aqua_rock_inside/tiles.o"(.rodata)
        "*/games/tla/src/scene/aqua_rock_inside/data2.o"(.data)
    }
    .bss : { "*/resource_67c_overlay.o"(.bss) }
    /DISCARD/ : { *(.ARM.attributes) *(.comment) *(.note*) }
}
