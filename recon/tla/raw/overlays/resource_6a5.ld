SECTIONS
{
    .text 0x2008000 :
    {
        "*/games/tla/src/scene/jupiter_lighthouse_aerie_beacon/entry.o"(.text)
        "*/games/tla/src/scene/jupiter_lighthouse_aerie_beacon/s0038.o"(.text)
        "*/games/tla/src/scene/jupiter_lighthouse_aerie_beacon/s0050.o"(.text)
        "*/games/tla/src/scene/jupiter_lighthouse_aerie_beacon/scene_tables.o"(.text)
        "*/games/tla/src/field/object/park_record.o"(.text)
        "*/recon/tla/raw/src/scene/jupiter_lighthouse_aerie_beacon/s0090.o"(.text)
        "*/games/tla/src/field/object/step_angle.o"(.text)
        "*/recon/tla/raw/src/scene/jupiter_lighthouse_aerie_beacon/s0198.o"(.text)
        "*/recon/tla/raw/src/scene/jupiter_lighthouse_aerie_beacon/s045c.o"(.text)
        "*/recon/tla/raw/src/scene/jupiter_lighthouse_aerie_beacon/s04c8.o"(.text)
        "*/recon/tla/raw/src/scene/jupiter_lighthouse_aerie_beacon/s05b8.o"(.text)
        "*/recon/tla/raw/src/scene/jupiter_lighthouse_aerie_beacon/s065c.o"(.text)
        "*/recon/tla/raw/src/scene/jupiter_lighthouse_aerie_beacon/s0cd0.o"(.text)
        "*/recon/tla/raw/src/scene/jupiter_lighthouse_aerie_beacon/s1388.o"(.text)
        "*/recon/tla/raw/src/scene/jupiter_lighthouse_aerie_beacon/s16e8.o"(.text)
        "*/games/tla/src/scene/jupiter_lighthouse_aerie_beacon/s1ac4.o"(.text)
        "*/recon/tla/raw/src/scene/jupiter_lighthouse_aerie_beacon/s1bc4.o"(.text)
        "*/recon/tla/raw/src/scene/jupiter_lighthouse_aerie_beacon/s2ae4.o"(.text)
        "*/games/tla/src/scene/jupiter_lighthouse_aerie_beacon/scene_events.o"(.text)
        "*/games/tla/src/scene/jupiter_lighthouse_aerie_beacon/s3a28.o"(.text)
        "*/recon/tla/raw/src/scene/jupiter_lighthouse_aerie_beacon/s3a6c.o"(.text)
        "*/recon/tla/raw/src/scene/jupiter_lighthouse_aerie_beacon/s3c58.o"(.text)
        "*/recon/tla/raw/src/scene/jupiter_lighthouse_aerie_beacon/s3d9c.o"(.text)
        "*/games/tla/src/scene/jupiter_lighthouse_aerie_beacon/prepare.o"(.text)
        "*/recon/tla/raw/src/scene/shared/scene_set_arrival_flags.o"(.text)
        "*/games/tla/src/scene/jupiter_lighthouse_aerie_beacon/s3f54.o"(.text)
        "*/recon/tla/raw/src/scene/jupiter_lighthouse_aerie_beacon/s3f60.o"(.text)
        "*/recon/tla/raw/src/scene/jupiter_lighthouse_aerie_beacon/lightset.o"(.text)
        "*/recon/tla/raw/src/scene/jupiter_lighthouse_aerie_beacon/s40f4.o"(.text)
        "*/recon/tla/raw/src/scene/jupiter_lighthouse_aerie_beacon/dist.o"(.text)
        "*/recon/tla/raw/src/scene/jupiter_lighthouse_aerie_beacon/s430c.o"(.text)
        "*/recon/tla/raw/src/scene/jupiter_lighthouse_aerie_beacon/s44cc.o"(.text)
        "*/recon/tla/raw/src/scene/jupiter_lighthouse_aerie_beacon/s45a4.o"(.text)
        "*/recon/tla/raw/src/scene/jupiter_lighthouse_aerie_beacon/s4644.o"(.text)
        "*/recon/tla/raw/src/scene/jupiter_lighthouse_aerie_beacon/s47d4.o"(.text)
        "*/games/tla/src/scene/jupiter_lighthouse_aerie_beacon/light.o"(.text)
        "*/recon/tla/raw/src/scene/jupiter_lighthouse_aerie_beacon/lightcue.o"(.text)
        "*/games/tla/src/field/object/set_sprite_priority.o"(.text)
        "*/recon/tla/raw/src/field/field_effect/move.o"(.text)
        "*/recon/tla/raw/src/scene/jupiter_lighthouse_aerie_beacon/s4bd4.o"(.text)
        "*/recon/tla/raw/src/scene/jupiter_lighthouse_aerie_beacon/s4d9c.o"(.text)
        "*/recon/tla/raw/src/scene/jupiter_lighthouse_aerie_beacon/s4ec8.o"(.text)
        "*/recon/tla/raw/src/scene/jupiter_lighthouse_aerie_beacon/s510c.o"(.text)
        "*/recon/tla/raw/src/scene/jupiter_lighthouse_aerie_beacon/s5204.o"(.text)
        "*/recon/tla/raw/src/field/field_effect/advance_motion.o"(.text)
        "*/recon/tla/raw/src/scene/jupiter_lighthouse_aerie_beacon/s539c.o"(.text)
        "*/recon/tla/raw/src/scene/jupiter_lighthouse_aerie_beacon/s5534.o"(.text)
        "*/recon/tla/raw/src/scene/jupiter_lighthouse_aerie_beacon/s55e4.o"(.text)
        "*/games/tla/src/scene/jupiter_lighthouse_aerie_beacon/import.o"(.text)
        "*/games/tla/src/scene/jupiter_lighthouse_aerie_beacon/data.o"(.data)
        "*/games/tla/src/graphics/field/cached_a.o"(.rodata)
        "*/games/tla/src/graphics/field/cached_b.o"(.rodata)
        "*/games/tla/src/graphics/field/cached_c.o"(.rodata)
        "*/games/tla/src/scene/jupiter_lighthouse_aerie_beacon/data2.o"(.data)
        "*/games/tla/src/scene/jupiter_lighthouse_aerie_beacon/data3.o"(.data)
    }
    .bss : { "*/resource_6a5_overlay.o"(.bss) }
    /DISCARD/ : { *(.ARM.attributes) *(.comment) *(.note*) }
}
