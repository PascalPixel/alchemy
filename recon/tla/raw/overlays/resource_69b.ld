SECTIONS
{
    .text 0x2008000 :
    {
        "*/games/tla/src/scene/jupiter_lighthouse_room_2/entry.o"(.text)
        "*/games/tla/src/scene/jupiter_lighthouse_room_2/scene_tables.o"(.text)
        "*/games/tla/src/scene/jupiter_lighthouse_room_2/s0054.o"(.text)
        "*/games/tla/src/scene/jupiter_lighthouse_room_2/s00b4.o"(.text)
        "*/resource_69b_overlay.o"(.text.x020080d0)
        "*/resource_69b_overlay.o"(.text.x02008230)
        "*/games/tla/src/scene/jupiter_lighthouse_room_2/s03f4.o"(.text)
        "*/games/tla/src/scene/jupiter_lighthouse_room_2/s042c.o"(.text)
        "*/games/tla/src/scene/jupiter_lighthouse_room_2/s0440.o"(.text)
        "*/games/tla/src/scene/jupiter_lighthouse_room_2/s0454.o"(.text)
        "*/games/tla/src/scene/jupiter_lighthouse_room_2/s04d0.o"(.text)
        "*/games/tla/src/scene/jupiter_lighthouse_room_2/s0500.o"(.text)
        "*/games/tla/src/scene/jupiter_lighthouse_room_2/s0674.o"(.text)
        "*/games/tla/src/scene/jupiter_lighthouse_room_2/s0680.o"(.text)
        "*/games/tla/src/scene/jupiter_lighthouse_room_2/s06dc.o"(.text)
        "*/games/tla/src/scene/jupiter_lighthouse_room_2/s0704.o"(.text)
        "*/games/tla/src/scene/jupiter_lighthouse_room_2/scene_events.o"(.text)
        "*/games/tla/src/scene/jupiter_lighthouse_room_2/s0720.o"(.text)
        "*/games/tla/src/scene/jupiter_lighthouse_room_2/s07d0.o"(.text)
        "*/games/tla/src/scene/jupiter_lighthouse_room_2/s099c.o"(.text)
        "*/games/tla/src/scene/shared/scene_set_arrival_flags.o"(.text)
        "*/resource_69b_overlay.o"(.text.x020089da)
        "*/games/tla/src/scene/jupiter_lighthouse_room_2/s09dc.o"(.text)
        "*/games/tla/src/scene/jupiter_lighthouse_room_2/s09e8.o"(.text)
        "*/games/tla/src/scene/jupiter_lighthouse_room_2/s0aa4.o"(.text)
        "*/games/tla/src/scene/jupiter_lighthouse_room_2/s0b28.o"(.text)
        "*/games/tla/src/scene/jupiter_lighthouse_room_2/s0b7c.o"(.text)
        "*/games/tla/src/scene/jupiter_lighthouse_room_2/s0d68.o"(.text)
        "*/games/tla/src/scene/jupiter_lighthouse_room_2/s0d94.o"(.text)
        "*/games/tla/src/scene/jupiter_lighthouse_room_2/s0f54.o"(.text)
        "*/games/tla/src/scene/jupiter_lighthouse_room_2/s102c.o"(.text)
        "*/games/tla/src/scene/jupiter_lighthouse_room_2/s10cc.o"(.text)
        "*/resource_69b_overlay.o"(.text.x0200925c)
        "*/games/tla/src/scene/jupiter_lighthouse_room_2/s1418.o"(.text)
        "*/games/tla/src/scene/jupiter_lighthouse_room_2/s15a0.o"(.text)
        "*/games/tla/src/scene/jupiter_lighthouse_room_2/s15d0.o"(.text)
        "*/games/tla/src/field/object/set_sprite_priority.o"(.text)
        "*/resource_69b_overlay.o"(.text.x02009622)
        "*/games/tla/src/field/field_effect/move.o"(.text)
        "*/resource_69b_overlay.o"(.text.x0200965a)
        "*/games/tla/src/scene/jupiter_lighthouse_room_2/s165c.o"(.text)
        "*/games/tla/src/scene/jupiter_lighthouse_room_2/s1824.o"(.text)
        "*/games/tla/src/scene/jupiter_lighthouse_room_2/s1950.o"(.text)
        "*/games/tla/src/scene/jupiter_lighthouse_room_2/s1b94.o"(.text)
        "*/games/tla/src/scene/jupiter_lighthouse_room_2/s1c8c.o"(.text)
        "*/games/tla/src/field/field_effect/advance_motion.o"(.text)
        "*/resource_69b_overlay.o"(.text.x02009e22)
        "*/games/tla/src/scene/jupiter_lighthouse_room_2/s1e24.o"(.text)
        "*/games/tla/src/scene/jupiter_lighthouse_room_2/s1fbc.o"(.text)
        "*/games/tla/src/scene/jupiter_lighthouse_room_2/s206c.o"(.text)
        "*/games/tla/src/scene/jupiter_lighthouse_room_2/import.o"(.text)
        "*/games/tla/src/graphics/field/cached_a.o"(.rodata)
        "*/games/tla/src/graphics/field/cached_b.o"(.rodata)
        "*/games/tla/src/graphics/field/cached_c.o"(.rodata)
        "*/games/tla/src/scene/jupiter_lighthouse_room_2/data.o"(.data)
    }
    .bss : { "*/resource_69b_overlay.o"(.bss) }
    /DISCARD/ : { *(.ARM.attributes) *(.comment) *(.note*) }
}
