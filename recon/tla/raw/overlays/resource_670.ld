SECTIONS
{
    .text 0x2008000 :
    {
        "*/games/tla/src/scene/kibombo/entry.o"(.text)
        "*/games/tla/src/scene/kibombo/s0038.o"(.text)
        "*/games/tla/src/scene/kibombo/s0054.o"(.text)
        "*/games/tla/src/scene/kibombo/s00a0.o"(.text)
        "*/games/tla/src/scene/kibombo/scene_tables.o"(.text)
        "*/games/tla/src/scene/kibombo/exits.o"(.text)
        "*/games/tla/src/scene/kibombo/events_a.o"(.text)
        "*/games/tla/src/scene/kibombo/s0c90.o"(.text)
        "*/games/tla/src/scene/kibombo/s0d74.o"(.text)
        "*/games/tla/src/scene/kibombo/s1218.o"(.text)
        "*/games/tla/src/scene/kibombo/s1318.o"(.text)
        "*/games/tla/src/scene/kibombo/s2050.o"(.text)
        "*/games/tla/src/scene/kibombo/s2ad8.o"(.text)
        "*/games/tla/src/scene/kibombo/s2b18.o"(.text)
        "*/games/tla/src/scene/kibombo/s2ba4.o"(.text)
        "*/games/tla/src/scene/kibombo/s2c34.o"(.text)
        "*/games/tla/src/scene/kibombo/s2e60.o"(.text)
        "*/games/tla/src/field/common/effect/advance_motion.o"(.text)
        "*/resource_670_overlay.o"(.text.x0200af32)
        "*/games/tla/src/scene/kibombo/s2f34.o"(.text)
        "*/games/tla/src/scene/kibombo/s2fec.o"(.text)
        "*/games/tla/src/scene/kibombo/s30b8.o"(.text)
        "*/games/tla/src/scene/kibombo/s3184.o"(.text)
        "*/games/tla/src/scene/kibombo/s31f0.o"(.text)
        "*/games/tla/src/scene/kibombo/s32b0.o"(.text)
        "*/resource_670_overlay.o"(.text.x0200b308)
        "*/resource_670_overlay.o"(.text.x0200b504)
        "*/games/tla/src/scene/kibombo/s3610.o"(.text)
        "*/games/tla/src/scene/kibombo/s37e4.o"(.text)
        "*/games/tla/src/scene/kibombo/s3a08.o"(.text)
        "*/games/tla/src/scene/kibombo/s3ac8.o"(.text)
        "*/games/tla/src/scene/kibombo/s3c84.o"(.text)
        "*/games/tla/src/scene/kibombo/s3dec.o"(.text)
        "*/games/tla/src/scene/kibombo/s40cc.o"(.text)
        "*/games/tla/src/scene/kibombo/s4424.o"(.text)
        "*/resource_670_overlay.o"(.text.x0200c524)
        "*/games/tla/src/scene/kibombo/s45d0.o"(.text)
        "*/games/tla/src/scene/kibombo/s489c.o"(.text)
        "*/resource_670_overlay.o"(.text.x0200ca28)
        "*/games/tla/src/scene/kibombo/s4cf4.o"(.text)
        "*/games/tla/src/scene/kibombo/s5034.o"(.text)
        "*/games/tla/src/scene/kibombo/prepare.o"(.text)
        "*/games/tla/src/scene/kibombo/s50ac.o"(.text)
        "*/games/tla/src/scene/kibombo/s516c.o"(.text)
        "*/games/tla/src/scene/kibombo/s538c.o"(.text)
        "*/games/tla/src/scene/kibombo/s54e0.o"(.text)
        "*/games/tla/src/scene/kibombo/s5594.o"(.text)
        "*/games/tla/src/scene/kibombo/s57e0.o"(.text)
        "*/resource_670_overlay.o"(.text.x0200d898)
        "*/games/tla/src/scene/kibombo/s5994.o"(.text)
        "*/games/tla/src/scene/kibombo/import.o"(.text)
        "*/games/tla/src/scene/kibombo/data.o"(.data)
    }
    .bss : { "*/resource_670_overlay.o"(.bss) }
    /DISCARD/ : { *(.ARM.attributes) *(.comment) *(.note*) }
}
