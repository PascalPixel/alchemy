SECTIONS
{
    .text 0x2008000 :
    {
        "*/games/tla/src/scene/kandorean_temple/entry.o"(.text)
        "*/games/tla/src/field/shared/object/set_sprite_priority.o"(.text)
        "*/resource_653_overlay.o"(.text.x0200807e)
        "*/games/tla/src/field/shared/effect/move.o"(.text)
        "*/resource_653_overlay.o"(.text.x020080b6)
        "*/games/tla/src/scene/kandorean_temple/s00b8.o"(.text)
        "*/games/tla/src/scene/kandorean_temple/events_a.o"(.text)
        "*/games/tla/src/scene/kandorean_temple/s02dc.o"(.text)
        "*/games/tla/src/scene/kandorean_temple/scene_tables.o"(.text)
        "*/games/tla/src/scene/kandorean_temple/s0390.o"(.text)
        "*/games/tla/src/scene/kandorean_temple/exits.o"(.text)
        "*/games/tla/src/scene/kandorean_temple/s03d0.o"(.text)
        "*/games/tla/src/scene/kandorean_temple/events_b.o"(.text)
        "*/games/tla/src/scene/kandorean_temple/s0580.o"(.text)
        "*/games/tla/src/scene/kandorean_temple/events_c.o"(.text)
        "*/resource_653_overlay.o"(.text.x02008668)
        "*/games/tla/src/scene/kandorean_temple/events_d.o"(.text)
        "*/games/tla/src/scene/kandorean_temple/s0778.o"(.text)
        "*/games/tla/src/scene/kandorean_temple/events_e.o"(.text)
        "*/games/tla/src/scene/kandorean_temple/s0930.o"(.text)
        "*/games/tla/src/scene/kandorean_temple/s098c.o"(.text)
        "*/games/tla/src/scene/kandorean_temple/s0adc.o"(.text)
        "*/games/tla/src/scene/kandorean_temple/events_f.o"(.text)
        "*/resource_653_overlay.o"(.text.x02008f60)
        "*/resource_653_overlay.o"(.text.x020092c4)
        "*/games/tla/src/scene/kandorean_temple/s1634.o"(.text)
        "*/games/tla/src/scene/kandorean_temple/s1804.o"(.text)
        "*/resource_653_overlay.o"(.text.x020099d4)
        "*/resource_653_overlay.o"(.text.x02009b50)
        "*/games/tla/src/scene/kandorean_temple/s1c8c.o"(.text)
        "*/games/tla/src/scene/kandorean_temple/s1f3c.o"(.text)
        "*/resource_653_overlay.o"(.text.x0200a3e8)
        "*/games/tla/src/scene/kandorean_temple/s2674.o"(.text)
        "*/games/tla/src/scene/kandorean_temple/prepare.o"(.text)
        "*/games/tla/src/scene/kandorean_temple/s2a5c.o"(.text)
        "*/resource_653_overlay.o"(.text.x0200aa84)
        "*/games/tla/src/scene/kandorean_temple/s2c1c.o"(.text)
        "*/games/tla/src/field/shared/effect/advance_motion.o"(.text)
        "*/resource_653_overlay.o"(.text.x0200aec2)
        "*/resource_653_overlay.o"(.text.x0200aec4)
        "*/resource_653_overlay.o"(.text.x0200b06c)
        "*/resource_653_overlay.o"(.text.x0200b2c8)
        "*/games/tla/src/scene/kandorean_temple/s3524.o"(.text)
        "*/games/tla/src/scene/kandorean_temple/s3684.o"(.text)
        "*/resource_653_overlay.o"(.text.x0200ba14)
        "*/games/tla/src/scene/kandorean_temple/s3a5c.o"(.text)
        "*/games/tla/src/scene/kandorean_temple/s3b2c.o"(.text)
        "*/games/tla/src/scene/kandorean_temple/s3c54.o"(.text)
        "*/games/tla/src/scene/kandorean_temple/s3e34.o"(.text)
        "*/resource_653_overlay.o"(.text.x0200be8c)
        "*/games/tla/src/scene/kandorean_temple/s47f0.o"(.text)
        "*/resource_653_overlay.o"(.text.x0200c82c)
        "*/games/tla/src/scene/kandorean_temple/s5028.o"(.text)
        "*/games/tla/src/scene/kandorean_temple/import.o"(.text)
        "*/games/tla/src/scene/kandorean_temple/data.o"(.data)
    }
    .bss : { "*/resource_653_overlay.o"(.bss) }
    /DISCARD/ : { *(.ARM.attributes) *(.comment) *(.note*) }
}
