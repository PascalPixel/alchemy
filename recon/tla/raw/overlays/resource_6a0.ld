SECTIONS
{
    .text 0x2008000 :
    {
        "*/games/tla/src/scene/jupiter_lighthouse_room_7/entry.o"(.text)
        "*/games/tla/src/scene/jupiter_lighthouse_room_7/flame.o"(.text)
        "*/games/tla/src/scene/jupiter_lighthouse_room_7/scene_tables.o"(.text)
        "*/games/tla/src/scene/jupiter_lighthouse_room_7/s0060.o"(.text)
        "*/games/tla/src/scene/jupiter_lighthouse_room_7/wait.o"(.text)
        "*/games/tla/src/scene/jupiter_lighthouse_room_7/s0194.o"(.text)
        "*/games/tla/src/scene/jupiter_lighthouse_room_7/s0290.o"(.text)
        "*/games/tla/src/scene/jupiter_lighthouse_room_7/s02f0.o"(.text)
        "*/resource_6a0_overlay.o"(.text.x020085a0)
        "*/resource_6a0_overlay.o"(.text.x020085e8)
        "*/games/tla/src/scene/jupiter_lighthouse_room_7/marker.o"(.text)
        "*/resource_6a0_overlay.o"(.text.x020087a4)
        "*/games/tla/src/scene/jupiter_lighthouse_room_7/calls.o"(.text)
        "*/games/tla/src/scene/jupiter_lighthouse_room_7/s09f8.o"(.text)
        "*/resource_6a0_overlay.o"(.text.x02008a74)
        "*/games/tla/src/scene/jupiter_lighthouse_room_7/s0c7c.o"(.text)
        "*/resource_6a0_overlay.o"(.text.x02008cec)
        "*/games/tla/src/scene/jupiter_lighthouse_room_7/call_e20.o"(.text)
        "*/games/tla/src/scene/jupiter_lighthouse_room_7/scene_events.o"(.text)
        "*/games/tla/src/scene/jupiter_lighthouse_room_7/s0e30.o"(.text)
        "*/games/tla/src/scene/jupiter_lighthouse_room_7/s0fc0.o"(.text)
        "*/games/tla/src/field/common/scene_set_arrival_flags.o"(.text)
        "*/resource_6a0_overlay.o"(.text.x0200915a)
        "*/games/tla/src/scene/jupiter_lighthouse_room_7/set_value.o"(.text)
        "*/resource_6a0_overlay.o"(.text.x02009168)
        "*/games/tla/src/scene/jupiter_lighthouse_room_7/lightset.o"(.text)
        "*/games/tla/src/scene/jupiter_lighthouse_room_7/s12a8.o"(.text)
        "*/resource_6a0_overlay.o"(.text.x020092fc)
        "*/games/tla/src/scene/jupiter_lighthouse_room_7/distance.o"(.text)
        "*/resource_6a0_overlay.o"(.text.x02009514)
        "*/resource_6a0_overlay.o"(.text.x020096d4)
        "*/games/tla/src/scene/jupiter_lighthouse_room_7/s17ac.o"(.text)
        "*/resource_6a0_overlay.o"(.text.x0200984c)
        "*/games/tla/src/scene/jupiter_lighthouse_room_7/s19dc.o"(.text)
        "*/resource_6a0_overlay.o"(.text.x02009a48)
        "*/games/tla/src/scene/jupiter_lighthouse_room_7/s1acc.o"(.text)
        "*/resource_6a0_overlay.o"(.text.x02009b74)
        "*/games/tla/src/scene/jupiter_lighthouse_room_7/light.o"(.text)
        "*/games/tla/src/scene/jupiter_lighthouse_room_7/list.o"(.text)
        "*/games/tla/src/field/common/object/set_sprite_priority.o"(.text)
        "*/resource_6a0_overlay.o"(.text.x02009f3a)
        "*/games/tla/src/field/common/effect/move.o"(.text)
        "*/resource_6a0_overlay.o"(.text.x02009f72)
        "*/games/tla/src/scene/jupiter_lighthouse_room_7/s1f74.o"(.text)
        "*/games/tla/src/scene/jupiter_lighthouse_room_7/s213c.o"(.text)
        "*/resource_6a0_overlay.o"(.text.x0200a268)
        "*/games/tla/src/scene/jupiter_lighthouse_room_7/s24ac.o"(.text)
        "*/resource_6a0_overlay.o"(.text.x0200a5a4)
        "*/games/tla/src/field/common/effect/advance_motion.o"(.text)
        "*/resource_6a0_overlay.o"(.text.x0200a73a)
        "*/resource_6a0_overlay.o"(.text.x0200a73c)
        "*/resource_6a0_overlay.o"(.text.x0200a8d4)
        "*/games/tla/src/scene/jupiter_lighthouse_room_7/s2984.o"(.text)
        "*/games/tla/src/scene/jupiter_lighthouse_room_7/import.o"(.text)
        "*/games/tla/src/scene/jupiter_lighthouse_room_7/data.o"(.data)
        "*/games/tla/src/graphics/field/cached_a.o"(.rodata)
        "*/games/tla/src/graphics/field/cached_b.o"(.rodata)
        "*/games/tla/src/graphics/field/cached_c.o"(.rodata)
        "*/games/tla/src/scene/jupiter_lighthouse_room_7/data2.o"(.data)
    }
    .bss : { "*/resource_6a0_overlay.o"(.bss) }
    /DISCARD/ : { *(.ARM.attributes) *(.comment) *(.note*) }
}
