SECTIONS
{
    .text 0x2008000 :
    {
        "*/games/tla/src/scene/jupiter_lighthouse_room_5/entry.o"(.text)
        "*/games/tla/src/scene/jupiter_lighthouse_room_5/scene_tables.o"(.text)
        "*/recon/tla/raw/src/scene/jupiter_lighthouse_room_5/s0064.o"(.text)
        "*/games/tla/src/scene/jupiter_lighthouse_room_5/animate.o"(.text)
        "*/games/tla/src/scene/jupiter_lighthouse_room_5/s0148.o"(.text)
        "*/recon/tla/raw/src/scene/jupiter_lighthouse_room_5/s01a4.o"(.text)
        "*/games/tla/src/scene/jupiter_lighthouse_room_5/cue.o"(.text)
        "*/recon/tla/raw/src/scene/jupiter_lighthouse_room_5/s02b8.o"(.text)
        "*/recon/tla/raw/src/scene/jupiter_lighthouse_room_5/s06ac.o"(.text)
        "*/recon/tla/raw/src/scene/jupiter_lighthouse_room_5/s0810.o"(.text)
        "*/recon/tla/raw/src/scene/jupiter_lighthouse_room_5/s08a4.o"(.text)
        "*/games/tla/src/scene/jupiter_lighthouse_room_5/scene_events.o"(.text)
        "*/recon/tla/raw/src/scene/jupiter_lighthouse_room_5/s0ae8.o"(.text)
        "*/recon/tla/raw/src/scene/jupiter_lighthouse_room_5/s0bf0.o"(.text)
        "*/recon/tla/raw/src/scene/shared/scene_set_arrival_flags.o"(.text)
        "*/resource_69e_overlay.o"(.text.x02008cb6)
        "*/games/tla/src/scene/jupiter_lighthouse_room_5/s0cb8.o"(.text)
        "*/recon/tla/raw/src/scene/jupiter_lighthouse_room_5/s0cc4.o"(.text)
        "*/recon/tla/raw/src/scene/jupiter_lighthouse_room_5/lightset.o"(.text)
        "*/recon/tla/raw/src/scene/jupiter_lighthouse_room_5/s0e58.o"(.text)
        "*/recon/tla/raw/src/scene/jupiter_lighthouse_room_5/s1044.o"(.text)
        "*/recon/tla/raw/src/scene/jupiter_lighthouse_room_5/s1070.o"(.text)
        "*/recon/tla/raw/src/scene/jupiter_lighthouse_room_5/s1230.o"(.text)
        "*/recon/tla/raw/src/scene/jupiter_lighthouse_room_5/s1308.o"(.text)
        "*/recon/tla/raw/src/scene/jupiter_lighthouse_room_5/s13a8.o"(.text)
        "*/recon/tla/raw/src/scene/jupiter_lighthouse_room_5/s1538.o"(.text)
        "*/recon/tla/raw/src/scene/jupiter_lighthouse_room_5/s1650.o"(.text)
        "*/recon/tla/raw/src/scene/jupiter_lighthouse_room_5/s1718.o"(.text)
        "*/recon/tla/raw/src/scene/jupiter_lighthouse_room_5/s185c.o"(.text)
        "*/recon/tla/raw/src/scene/jupiter_lighthouse_room_5/s1888.o"(.text)
        "*/recon/tla/raw/src/scene/jupiter_lighthouse_room_5/light.o"(.text)
        "*/games/tla/src/scene/jupiter_lighthouse_room_5/lightcue.o"(.text)
        "*/games/tla/src/field/object/set_sprite_priority.o"(.text)
        "*/resource_69e_overlay.o"(.text.x02009c4e)
        "*/games/tla/src/field/field_effect/move.o"(.text)
        "*/resource_69e_overlay.o"(.text.x02009c86)
        "*/recon/tla/raw/src/scene/jupiter_lighthouse_room_5/s1c88.o"(.text)
        "*/recon/tla/raw/src/scene/jupiter_lighthouse_room_5/s1e50.o"(.text)
        "*/recon/tla/raw/src/scene/jupiter_lighthouse_room_5/s1f7c.o"(.text)
        "*/recon/tla/raw/src/scene/jupiter_lighthouse_room_5/s21c0.o"(.text)
        "*/recon/tla/raw/src/scene/jupiter_lighthouse_room_5/s22b8.o"(.text)
        "*/games/tla/src/field/field_effect/advance_motion.o"(.text)
        "*/resource_69e_overlay.o"(.text.x0200a44e)
        "*/recon/tla/raw/src/scene/jupiter_lighthouse_room_5/s2450.o"(.text)
        "*/games/tla/src/scene/jupiter_lighthouse_room_5/s25e8.o"(.text)
        "*/recon/tla/raw/src/scene/jupiter_lighthouse_room_5/s2698.o"(.text)
        "*/games/tla/src/scene/jupiter_lighthouse_room_5/import.o"(.text)
        "*/games/tla/src/graphics/field/cached_a.o"(.rodata)
        "*/games/tla/src/graphics/field/cached_b.o"(.rodata)
        "*/games/tla/src/graphics/field/cached_c.o"(.rodata)
        "*/games/tla/src/scene/jupiter_lighthouse_room_5/data.o"(.data)
    }
    .bss : { "*/resource_69e_overlay.o"(.bss) }
    /DISCARD/ : { *(.ARM.attributes) *(.comment) *(.note*) }
}
