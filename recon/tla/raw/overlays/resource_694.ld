SECTIONS
{
    .text 0x2008000 :
    {
        "*/games/tla/src/scene/contigo/entry.o"(.text)
        "*/resource_694_overlay.o"(.text.x02008038)
        "*/games/tla/src/scene/contigo/stop.o"(.text)
        "*/resource_694_overlay.o"(.text.x020081d4)
        "*/resource_694_overlay.o"(.text.x020081f8)
        "*/games/tla/src/scene/contigo/s0328.o"(.text)
        "*/games/tla/src/field/common/object/set_sprite_priority.o"(.text)
        "*/resource_694_overlay.o"(.text.x020083f6)
        "*/games/tla/src/field/common/effect/move.o"(.text)
        "*/resource_694_overlay.o"(.text.x0200842e)
        "*/games/tla/src/scene/contigo/s0430.o"(.text)
        "*/games/tla/src/scene/contigo/event0.o"(.text)
        "*/resource_694_overlay.o"(.text.x02008658)
        "*/resource_694_overlay.o"(.text.x020086d0)
        "*/games/tla/src/scene/contigo/event1.o"(.text)
        "*/games/tla/src/scene/contigo/scene_tables.o"(.text)
        "*/games/tla/src/scene/contigo/s07cc.o"(.text)
        "*/games/tla/src/scene/contigo/s0874.o"(.text)
        "*/games/tla/src/scene/contigo/sign0.o"(.text)
        "*/games/tla/src/scene/contigo/s09d0.o"(.text)
        "*/games/tla/src/scene/contigo/s0a80.o"(.text)
        "*/games/tla/src/scene/contigo/s0af4.o"(.text)
        "*/games/tla/src/scene/contigo/facing.o"(.text)
        "*/games/tla/src/scene/contigo/sign1.o"(.text)
        "*/games/tla/src/scene/contigo/event2.o"(.text)
        "*/games/tla/src/scene/contigo/sign2.o"(.text)
        "*/games/tla/src/scene/contigo/s1094.o"(.text)
        "*/games/tla/src/scene/contigo/s118c.o"(.text)
        "*/games/tla/src/scene/contigo/s1250.o"(.text)
        "*/games/tla/src/scene/contigo/event3.o"(.text)
        "*/games/tla/src/scene/contigo/s12c4.o"(.text)
        "*/games/tla/src/scene/contigo/event4.o"(.text)
        "*/games/tla/src/scene/contigo/s14d4.o"(.text)
        "*/games/tla/src/scene/contigo/event5.o"(.text)
        "*/resource_694_overlay.o"(.text.x020095ac)
        "*/games/tla/src/scene/contigo/event6.o"(.text)
        "*/games/tla/src/scene/contigo/s17bc.o"(.text)
        "*/games/tla/src/scene/contigo/s17f4.o"(.text)
        "*/games/tla/src/scene/contigo/s1938.o"(.text)
        "*/games/tla/src/scene/contigo/s1a60.o"(.text)
        "*/games/tla/src/scene/contigo/dice.o"(.text)
        "*/games/tla/src/scene/contigo/scale.o"(.text)
        "*/games/tla/src/scene/contigo/s1c5c.o"(.text)
        "*/games/tla/src/scene/contigo/event7.o"(.text)
        "*/games/tla/src/scene/contigo/s1d50.o"(.text)
        "*/games/tla/src/scene/contigo/return.o"(.text)
        "*/games/tla/src/scene/contigo/prepare.o"(.text)
        "*/resource_694_overlay.o"(.text.x0200b720)
        "*/games/tla/src/scene/contigo/s3880.o"(.text)
        "*/games/tla/src/scene/contigo/s39d4.o"(.text)
        "*/resource_694_overlay.o"(.text.x0200ba8c)
        "*/games/tla/src/scene/contigo/s3a8c.o"(.text)
        "*/resource_694_overlay.o"(.text.x0200bcd8)
        "*/resource_694_overlay.o"(.text.x0200be54)
        "*/games/tla/src/scene/contigo/mark.o"(.text)
        "*/games/tla/src/scene/contigo/import.o"(.text)
        "*/games/tla/src/scene/contigo/data.o"(.data)
    }
    .bss : { "*/resource_694_overlay.o"(.bss) }
    /DISCARD/ : { *(.ARM.attributes) *(.comment) *(.note*) }
}
