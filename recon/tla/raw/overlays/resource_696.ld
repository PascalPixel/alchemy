SECTIONS
{
    .text 0x2008000 :
    {
        "*/games/tla/src/scene/shaman_village/entry.o"(.text)
        "*/games/tla/src/field/object/set_sprite_priority.o"(.text)
        "*/recon/tla/raw/src/field/field_effect/move.o"(.text)
        "*/recon/tla/raw/src/scene/shaman_village/s00b8.o"(.text)
        "*/games/tla/src/scene/shaman_village/s0280.o"(.text)
        "*/games/tla/src/scene/shaman_village/scene_tables.o"(.text)
        "*/recon/tla/raw/src/scene/shaman_village/s02dc.o"(.text)
        "*/recon/tla/raw/src/scene/shaman_village/s0378.o"(.text)
        "*/recon/tla/raw/src/scene/shaman_village/s0420.o"(.text)
        "*/recon/tla/raw/src/scene/shaman_village/s0458.o"(.text)
        "*/recon/tla/raw/src/field/field_effect/circle_blink.o"(.text)
        "*/recon/tla/raw/src/scene/shaman_village/s0508.o"(.text)
        "*/recon/tla/raw/src/scene/shaman_village/s057c.o"(.text)
        "*/games/tla/src/scene/shaman_village/s0c80.o"(.text)
        "*/recon/tla/raw/src/scene/shaman_village/s0d08.o"(.text)
        "*/recon/tla/raw/src/scene/shaman_village/s0fc4.o"(.text)
        "*/recon/tla/raw/src/scene/shaman_village/s10c8.o"(.text)
        "*/recon/tla/raw/src/scene/shaman_village/s1880.o"(.text)
        "*/recon/tla/raw/src/scene/shaman_village/s1cc8.o"(.text)
        "*/games/tla/src/scene/shared/drift_spawn.o"(.text)
        "*/recon/tla/raw/src/scene/shaman_village/s1fec.o"(.text)
        "*/recon/tla/raw/src/scene/shaman_village/s2068.o"(.text)
        "*/recon/tla/raw/src/scene/shaman_village/s279c.o"(.text)
        "*/resource_696_overlay.o"(.text.x0200a90c)
        "*/recon/tla/raw/src/scene/shaman_village/s2a20.o"(.text)
        "*/recon/tla/raw/src/scene/shaman_village/s2f20.o"(.text)
        "*/recon/tla/raw/src/scene/shaman_village/lettering.o"(.text)
        "*/games/tla/src/scene/shaman_village/s3040.o"(.text)
        "*/recon/tla/raw/src/scene/shaman_village/s30bc.o"(.text)
        "*/games/tla/src/scene/shaman_village/s3b24.o"(.text)
        "*/recon/tla/raw/src/scene/shaman_village/s3ce4.o"(.text)
        "*/recon/tla/raw/src/scene/shaman_village/s3d30.o"(.text)
        "*/recon/tla/raw/src/scene/shaman_village/s3f78.o"(.text)
        "*/games/tla/src/scene/shaman_village/prepare.o"(.text)
        "*/recon/tla/raw/src/scene/shaman_village/s4060.o"(.text)
        "*/recon/tla/raw/src/scene/shaman_village/s42c8.o"(.text)
        "*/recon/tla/raw/src/scene/shaman_village/s430c.o"(.text)
        "*/recon/tla/raw/src/scene/shaman_village/s4394.o"(.text)
        "*/recon/tla/raw/src/scene/shaman_village/s43c8.o"(.text)
        "*/recon/tla/raw/src/scene/shaman_village/s43f8.o"(.text)
        "*/recon/tla/raw/src/scene/shaman_village/s46bc.o"(.text)
        "*/games/tla/src/scene/shaman_village/s46ec.o"(.text)
        "*/games/tla/src/scene/shaman_village/import.o"(.text)
        "*/games/tla/src/scene/shaman_village/data.o"(.data)
        "*/games/tla/src/scene/shaman_village/data2.o"(.data)
        "*/games/tla/src/scene/shaman_village/data3.o"(.data)
    }
    .bss : { "*/resource_696_overlay.o"(.bss) }
    /DISCARD/ : { *(.ARM.attributes) *(.comment) *(.note*) }
}
