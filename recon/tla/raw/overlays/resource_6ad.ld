SECTIONS
{
    .text 0x2008000 :
    {
        "*/games/tla/src/scene/mars_lighthouse_room_f/entry.o"(.text)
        "*/games/tla/src/scene/mars_lighthouse_room_f/scene_tables.o"(.text)
        "*/games/tla/src/scene/mars_lighthouse_room_f/s004c.o"(.text)
        "*/games/tla/src/scene/mars_lighthouse_room_f/s0170.o"(.text)
        "*/games/tla/src/scene/mars_lighthouse_room_f/s01f4.o"(.text)
        "*/games/tla/src/scene/mars_lighthouse_room_f/s03b4.o"(.text)
        "*/games/tla/src/scene/mars_lighthouse_room_f/s055c.o"(.text)
        "*/games/tla/src/scene/mars_lighthouse_room_f/s0670.o"(.text)
        "*/games/tla/src/scene/mars_lighthouse_room_f/s09ec.o"(.text)
        "*/games/tla/src/scene/mars_lighthouse_room_f/s0cf4.o"(.text)
        "*/games/tla/src/scene/mars_lighthouse_room_f/s0e7c.o"(.text)
        "*/games/tla/src/scene/mars_lighthouse_room_f/s140c.o"(.text)
        "*/games/tla/src/scene/shared/scene_set_arrival_flags.o"(.text)
        "*/games/tla/src/scene/mars_lighthouse_room_f/s14dc.o"(.text)
        "*/games/tla/src/scene/mars_lighthouse_room_f/s14e8.o"(.text)
        "*/games/tla/src/scene/mars_lighthouse_room_f/lightset.o"(.text)
        "*/games/tla/src/scene/mars_lighthouse_room_f/s1628.o"(.text)
        "*/games/tla/src/scene/mars_lighthouse_room_f/s167c.o"(.text)
        "*/games/tla/src/scene/mars_lighthouse_room_f/s1868.o"(.text)
        "*/games/tla/src/scene/mars_lighthouse_room_f/s1894.o"(.text)
        "*/games/tla/src/scene/mars_lighthouse_room_f/s1a54.o"(.text)
        "*/games/tla/src/scene/mars_lighthouse_room_f/s1b2c.o"(.text)
        "*/games/tla/src/scene/mars_lighthouse_room_f/s1bcc.o"(.text)
        "*/games/tla/src/scene/mars_lighthouse_room_f/s1d5c.o"(.text)
        "*/games/tla/src/scene/mars_lighthouse_room_f/s1e20.o"(.text)
        "*/games/tla/src/scene/mars_lighthouse_room_f/s1f84.o"(.text)
        "*/games/tla/src/scene/mars_lighthouse_room_f/s1ffc.o"(.text)
        "*/games/tla/src/scene/mars_lighthouse_room_f/s21a0.o"(.text)
        "*/games/tla/src/scene/mars_lighthouse_room_f/s242c.o"(.text)
        "*/games/tla/src/scene/mars_lighthouse_room_f/s25b0.o"(.text)
        "*/games/tla/src/scene/mars_lighthouse_room_f/ride_handle.o"(.text)
        "*/games/tla/src/scene/mars_lighthouse_room_f/s2624.o"(.text)
        "*/games/tla/src/scene/mars_lighthouse_room_f/ride.o"(.text)
        "*/games/tla/src/scene/mars_lighthouse_room_f/s2800.o"(.text)
        "*/games/tla/src/field/field_effect/advance_spin.o"(.text)
        "*/games/tla/src/scene/mars_lighthouse_room_f/flash.o"(.text)
        "*/games/tla/src/scene/mars_lighthouse_room_f/s297c.o"(.text)
        "*/resource_6ad_overlay.o"(.text.x0200a97c)
        "*/games/tla/src/scene/mars_lighthouse_room_f/ride_step.o"(.text)
        "*/games/tla/src/scene/mars_lighthouse_room_f/s2ba0.o"(.text)
        "*/games/tla/src/scene/mars_lighthouse_room_f/ride_active.o"(.text)
        "*/resource_6ad_overlay.o"(.text.x0200ad08)
        "*/games/tla/src/scene/mars_lighthouse_room_f/s2e8c.o"(.text)
        "*/games/tla/src/scene/mars_lighthouse_room_f/flag_state.o"(.text)
        "*/games/tla/src/scene/mars_lighthouse_room_f/s2f80.o"(.text)
        "*/games/tla/src/scene/mars_lighthouse_room_f/s328c.o"(.text)
        "*/games/tla/src/scene/mars_lighthouse_room_f/s3304.o"(.text)
        "*/games/tla/src/scene/mars_lighthouse_room_f/s33cc.o"(.text)
        "*/games/tla/src/scene/mars_lighthouse_room_f/reset.o"(.text)
        "*/games/tla/src/field/object/set_sprite_priority.o"(.text)
        "*/games/tla/src/field/field_effect/move.o"(.text)
        "*/games/tla/src/scene/mars_lighthouse_room_f/s35b8.o"(.text)
        "*/games/tla/src/scene/mars_lighthouse_room_f/s3780.o"(.text)
        "*/games/tla/src/scene/mars_lighthouse_room_f/s38ac.o"(.text)
        "*/games/tla/src/scene/mars_lighthouse_room_f/s3af0.o"(.text)
        "*/games/tla/src/scene/mars_lighthouse_room_f/s3be8.o"(.text)
        "*/games/tla/src/field/field_effect/advance_motion.o"(.text)
        "*/games/tla/src/scene/mars_lighthouse_room_f/s3d80.o"(.text)
        "*/games/tla/src/scene/mars_lighthouse_room_f/s3f18.o"(.text)
        "*/games/tla/src/scene/mars_lighthouse_room_f/s3fc8.o"(.text)
        "*/games/tla/src/scene/mars_lighthouse_room_f/s4080.o"(.text)
        "*/games/tla/src/scene/mars_lighthouse_room_f/s410c.o"(.text)
        "*/games/tla/src/scene/mars_lighthouse_room_f/s4140.o"(.text)
        "*/games/tla/src/scene/mars_lighthouse_room_f/s43ec.o"(.text)
        "*/games/tla/src/scene/mars_lighthouse_room_f/s4700.o"(.text)
        "*/games/tla/src/scene/mars_lighthouse_room_f/s470c.o"(.text)
        "*/games/tla/src/scene/mars_lighthouse_room_f/s4938.o"(.text)
        "*/games/tla/src/scene/mars_lighthouse_room_f/s4a44.o"(.text)
        "*/games/tla/src/scene/mars_lighthouse_room_f/s4a8c.o"(.text)
        "*/games/tla/src/scene/mars_lighthouse_room_f/s4bf4.o"(.text)
        "*/games/tla/src/scene/mars_lighthouse_room_f/s4d10.o"(.text)
        "*/games/tla/src/scene/mars_lighthouse_room_f/s4fc0.o"(.text)
        "*/games/tla/src/scene/mars_lighthouse_room_f/s5048.o"(.text)
        "*/games/tla/src/scene/mars_lighthouse_room_f/light.o"(.text)
        "*/games/tla/src/scene/mars_lighthouse_room_f/s538c.o"(.text)
        "*/games/tla/src/scene/mars_lighthouse_room_f/lightcue.o"(.text)
        "*/games/tla/src/scene/mars_lighthouse_room_f/import.o"(.text)
        "*/games/tla/src/scene/mars_lighthouse_room_f/data.o"(.data)
        "*/games/tla/src/graphics/field/cached_a.o"(.rodata)
        "*/games/tla/src/graphics/field/cached_b.o"(.rodata)
        "*/games/tla/src/graphics/field/cached_c.o"(.rodata)
        "*/games/tla/src/scene/mars_lighthouse_room_f/data2.o"(.data)
    }
    .bss : { "*/resource_6ad_overlay.o"(.bss) }
    /DISCARD/ : { *(.ARM.attributes) *(.comment) *(.note*) }
}
