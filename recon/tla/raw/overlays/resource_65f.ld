SECTIONS
{
    .text 0x2008000 :
    {
        "*/games/tla/src/scene/garoh/entry.o"(.text)
        "*/games/tla/src/field/object/set_sprite_priority.o"(.text)
        "*/resource_65f_overlay.o"(.text.x0200807e)
        "*/games/tla/src/field/field_effect/move.o"(.text)
        "*/resource_65f_overlay.o"(.text.x020080b6)
        "*/games/tla/src/scene/garoh/s00b8.o"(.text)
        "*/games/tla/src/scene/garoh/layer.o"(.text)
        "*/resource_65f_overlay.o"(.text.x020082a4)
        "*/games/tla/src/scene/garoh/s0390.o"(.text)
        "*/games/tla/src/scene/garoh/hide.o"(.text)
        "*/games/tla/src/scene/garoh/scene_tables.o"(.text)
        "*/games/tla/src/scene/garoh/s0440.o"(.text)
        "*/games/tla/src/scene/garoh/talk.o"(.text)
        "*/games/tla/src/scene/garoh/s06ec.o"(.text)
        "*/games/tla/src/scene/garoh/s0808.o"(.text)
        "*/games/tla/src/scene/garoh/gate.o"(.text)
        "*/games/tla/src/scene/garoh/chime.o"(.text)
        "*/games/tla/src/scene/garoh/s0aa8.o"(.text)
        "*/games/tla/src/scene/garoh/prepare.o"(.text)
        "*/games/tla/src/scene/garoh/s0be4.o"(.text)
        "*/games/tla/src/scene/garoh/s0d30.o"(.text)
        "*/games/tla/src/scene/garoh/lift_a.o"(.text)
        "*/games/tla/src/scene/garoh/lift.o"(.text)
        "*/games/tla/src/field/field_effect/advance_motion.o"(.text)
        "*/resource_65f_overlay.o"(.text.x020092a6)
        "*/games/tla/src/scene/garoh/s12a8.o"(.text)
        "*/games/tla/src/scene/garoh/spawn.o"(.text)
        "*/games/tla/src/scene/garoh/push.o"(.text)
        "*/games/tla/src/scene/garoh/s1490.o"(.text)
        "*/games/tla/src/scene/garoh/s22f4.o"(.text)
        "*/games/tla/src/scene/garoh/s2694.o"(.text)
        "*/games/tla/src/scene/garoh/s3878.o"(.text)
        "*/games/tla/src/scene/garoh/import.o"(.text)
        "*/games/tla/src/scene/garoh/data.o"(.data)
    }
    .bss : { "*/resource_65f_overlay.o"(.bss) }
    /DISCARD/ : { *(.ARM.attributes) *(.comment) *(.note*) }
}
