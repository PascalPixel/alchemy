SECTIONS
{
    .text 0x2008000 :
    {
        "*/games/tla/src/scene/caverns/entry.o"(.text)
        "*/games/tla/src/field/object/set_sprite_priority.o"(.text)
        "*/games/tla/src/field/object/prepare_object.o"(.text)
        "*/games/tla/src/scene/caverns/object.o"(.text)
        "*/games/tla/src/field/field_effect/move.o"(.text)
        "*/games/tla/src/scene/caverns/s015c.o"(.text)
        "*/games/tla/src/scene/caverns/scene_tables.o"(.text)
        "*/games/tla/src/scene/caverns/placements.o"(.text)
        "*/games/tla/src/scene/caverns/exits.o"(.text)
        "*/games/tla/src/scene/caverns/map_cell.o"(.text)
        "*/games/tla/src/field/object/wait_until_idle.o"(.text)
        "*/resource_6a9_overlay.o"(.text.x02008454)
        "*/resource_6a9_overlay.o"(.text.x0200853c)
        "*/resource_6a9_overlay.o"(.text.x020086a8)
        "*/games/tla/src/scene/caverns/s07ec.o"(.text)
        "*/games/tla/src/scene/caverns/s0848.o"(.text)
        "*/resource_6a9_overlay.o"(.text.x0200887c)
        "*/games/tla/src/scene/caverns/s0ad0.o"(.text)
        "*/games/tla/src/scene/caverns/s0b64.o"(.text)
        "*/games/tla/src/scene/caverns/s0bf8.o"(.text)
        "*/games/tla/src/scene/caverns/s0cdc.o"(.text)
        "*/games/tla/src/scene/caverns/events2.o"(.text)
        "*/games/tla/src/scene/caverns/s0d68.o"(.text)
        "*/games/tla/src/scene/caverns/events.o"(.text)
        "*/games/tla/src/scene/caverns/tail.o"(.text)
        "*/games/tla/src/scene/caverns/import.o"(.text)
        "*/games/tla/src/scene/caverns/data.o"(.data)
    }
    /DISCARD/ : { *(.ARM.attributes) *(.comment) *(.note*) }
}
