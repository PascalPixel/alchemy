SECTIONS
{
    .text 0x2008000 :
    {
        "*/games/tla/src/scene/jupiter_lighthouse_room_m/entry.o"(.text)
        "*/games/tla/src/scene/jupiter_lighthouse_room_m/s0038.o"(.text)
        "*/games/tla/src/scene/jupiter_lighthouse_room_m/scene_tables.o"(.text)
        "*/games/tla/src/scene/jupiter_lighthouse_room_m/s0060.o"(.text)
        "*/games/tla/src/scene/jupiter_lighthouse_room_m/s00c4.o"(.text)
        "*/games/tla/src/scene/jupiter_lighthouse_room_m/s039c.o"(.text)
        "*/games/tla/src/scene/jupiter_lighthouse_room_m/s03b8.o"(.text)
        "*/games/tla/src/scene/jupiter_lighthouse_room_m/s060c.o"(.text)
        "*/games/tla/src/scene/jupiter_lighthouse_room_m/s08c8.o"(.text)
        "*/games/tla/src/scene/jupiter_lighthouse_room_m/scene_events.o"(.text)
        "*/games/tla/src/scene/jupiter_lighthouse_room_m/s0970.o"(.text)
        "*/games/tla/src/scene/jupiter_lighthouse_room_m/s0a78.o"(.text)
        "*/games/tla/src/scene/jupiter_lighthouse_room_m/s0ad0.o"(.text)
        "*/games/tla/src/scene/jupiter_lighthouse_room_m/s0b48.o"(.text)
        "*/games/tla/src/scene/jupiter_lighthouse_room_m/s0cac.o"(.text)
        "*/games/tla/src/scene/jupiter_lighthouse_room_m/s1c7c.o"(.text)
        "*/games/tla/src/scene/jupiter_lighthouse_room_m/s1e38.o"(.text)
        "*/games/tla/src/scene/jupiter_lighthouse_room_m/s1ed0.o"(.text)
        "*/games/tla/src/scene/jupiter_lighthouse_room_m/s2c54.o"(.text)
        "*/games/tla/src/scene/jupiter_lighthouse_room_m/s2e3c.o"(.text)
        "*/games/tla/src/scene/shared/scene_set_arrival_flags.o"(.text)
        "*/games/tla/src/scene/jupiter_lighthouse_room_m/lighton.o"(.text)
        "*/games/tla/src/scene/jupiter_lighthouse_room_m/s2f08.o"(.text)
        "*/games/tla/src/scene/jupiter_lighthouse_room_m/lightset.o"(.text)
        "*/games/tla/src/scene/jupiter_lighthouse_room_m/s309c.o"(.text)
        "*/games/tla/src/scene/jupiter_lighthouse_room_m/dist.o"(.text)
        "*/games/tla/src/scene/jupiter_lighthouse_room_m/s32b4.o"(.text)
        "*/games/tla/src/scene/jupiter_lighthouse_room_m/s3474.o"(.text)
        "*/games/tla/src/scene/jupiter_lighthouse_room_m/s354c.o"(.text)
        "*/games/tla/src/scene/jupiter_lighthouse_room_m/s35ec.o"(.text)
        "*/games/tla/src/scene/jupiter_lighthouse_room_m/s377c.o"(.text)
        "*/games/tla/src/scene/jupiter_lighthouse_room_m/light.o"(.text)
        "*/games/tla/src/scene/jupiter_lighthouse_room_m/lightcue.o"(.text)
        "*/games/tla/src/field/object/set_sprite_priority.o"(.text)
        "*/games/tla/src/field/field_effect/move.o"(.text)
        "*/games/tla/src/scene/jupiter_lighthouse_room_m/s3b7c.o"(.text)
        "*/games/tla/src/scene/jupiter_lighthouse_room_m/s3d44.o"(.text)
        "*/games/tla/src/scene/jupiter_lighthouse_room_m/s3e70.o"(.text)
        "*/games/tla/src/scene/jupiter_lighthouse_room_m/s40b4.o"(.text)
        "*/games/tla/src/scene/jupiter_lighthouse_room_m/s41ac.o"(.text)
        "*/games/tla/src/field/field_effect/advance_motion.o"(.text)
        "*/games/tla/src/scene/jupiter_lighthouse_room_m/s4344.o"(.text)
        "*/games/tla/src/scene/jupiter_lighthouse_room_m/s44dc.o"(.text)
        "*/games/tla/src/scene/jupiter_lighthouse_room_m/s458c.o"(.text)
        "*/games/tla/src/scene/jupiter_lighthouse_room_m/import.o"(.text)
        "*/games/tla/src/scene/jupiter_lighthouse_room_m/data.o"(.data)
        "*/games/tla/src/graphics/field/cached_a.o"(.rodata)
        "*/games/tla/src/graphics/field/cached_b.o"(.rodata)
        "*/games/tla/src/graphics/field/cached_c.o"(.rodata)
        "*/games/tla/src/scene/jupiter_lighthouse_room_m/data2.o"(.data)
    }
    .bss : { "*/resource_6a3_overlay.o"(.bss) }
    /DISCARD/ : { *(.ARM.attributes) *(.comment) *(.note*) }
}
