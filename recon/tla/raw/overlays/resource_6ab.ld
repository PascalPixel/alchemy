SECTIONS
{
    .text 0x2008000 :
    {
        "*/games/tla/src/scene/mars_lighthouse_star_room/entry.o"(.text)
        "*/games/tla/src/scene/mars_lighthouse_star_room/hide.o"(.text)
        "*/games/tla/src/scene/mars_lighthouse_star_room/scene_tables.o"(.text)
        "*/games/tla/src/scene/mars_lighthouse_star_room/mark.o"(.text)
        "*/games/tla/src/scene/mars_lighthouse_star_room/s0080.o"(.text)
        "*/games/tla/src/scene/mars_lighthouse_star_room/s0188.o"(.text)
        "*/games/tla/src/scene/mars_lighthouse_star_room/s024c.o"(.text)
        "*/games/tla/src/scene/mars_lighthouse_star_room/scene_events.o"(.text)
        "*/games/tla/src/scene/mars_lighthouse_star_room/dismiss.o"(.text)
        "*/games/tla/src/scene/mars_lighthouse_star_room/s02f4.o"(.text)
        "*/games/tla/src/scene/mars_lighthouse_star_room/s055c.o"(.text)
        "*/games/tla/src/scene/mars_lighthouse_star_room/s05b0.o"(.text)
        "*/games/tla/src/scene/mars_lighthouse_star_room/s0714.o"(.text)
        "*/games/tla/src/scene/mars_lighthouse_star_room/s0ab4.o"(.text)
        "*/games/tla/src/scene/mars_lighthouse_star_room/s0ae4.o"(.text)
        "*/games/tla/src/scene/mars_lighthouse_star_room/talk.o"(.text)
        "*/games/tla/src/scene/mars_lighthouse_star_room/s0bd8.o"(.text)
        "*/games/tla/src/scene/mars_lighthouse_star_room/tiles.o"(.text)
        "*/games/tla/src/scene/mars_lighthouse_star_room/s0db8.o"(.text)
        "*/games/tla/src/scene/mars_lighthouse_star_room/note.o"(.text)
        "*/games/tla/src/scene/mars_lighthouse_star_room/s0e80.o"(.text)
        "*/games/tla/src/scene/mars_lighthouse_star_room/s13e4.o"(.text)
        "*/games/tla/src/scene/mars_lighthouse_star_room/s1424.o"(.text)
        "*/games/tla/src/scene/mars_lighthouse_star_room/paths.o"(.text)
        "*/games/tla/src/scene/mars_lighthouse_star_room/s1528.o"(.text)
        "*/games/tla/src/scene/mars_lighthouse_star_room/s15ec.o"(.text)
        "*/games/tla/src/scene/mars_lighthouse_star_room/spawn.o"(.text)
        "*/games/tla/src/scene/mars_lighthouse_star_room/s17c8.o"(.text)
        "*/games/tla/src/scene/mars_lighthouse_star_room/spawn2.o"(.text)
        "*/games/tla/src/scene/mars_lighthouse_star_room/s19b4.o"(.text)
        "*/games/tla/src/scene/mars_lighthouse_star_room/s1a9c.o"(.text)
        "*/games/tla/src/scene/mars_lighthouse_star_room/spawn3.o"(.text)
        "*/games/tla/src/scene/mars_lighthouse_star_room/s1b78.o"(.text)
        "*/games/tla/src/scene/mars_lighthouse_star_room/s1bf8.o"(.text)
        "*/games/tla/src/scene/mars_lighthouse_star_room/s1d7c.o"(.text)
        "*/games/tla/src/scene/mars_lighthouse_star_room/ride_handle.o"(.text)
        "*/games/tla/src/scene/mars_lighthouse_star_room/s1df0.o"(.text)
        "*/games/tla/src/scene/mars_lighthouse_star_room/ride.o"(.text)
        "*/games/tla/src/scene/mars_lighthouse_star_room/s1fcc.o"(.text)
        "*/games/tla/src/field/field_effect/advance_spin.o"(.text)
        "*/games/tla/src/scene/mars_lighthouse_star_room/flash.o"(.text)
        "*/games/tla/src/scene/mars_lighthouse_star_room/s2148.o"(.text)
        "*/resource_6ab_overlay.o"(.text.x0200a148)
        "*/games/tla/src/scene/mars_lighthouse_star_room/ride_step.o"(.text)
        "*/games/tla/src/scene/mars_lighthouse_star_room/s236c.o"(.text)
        "*/games/tla/src/scene/mars_lighthouse_star_room/ride_active.o"(.text)
        "*/games/tla/src/scene/mars_lighthouse_star_room/s24d4.o"(.text)
        "*/games/tla/src/scene/mars_lighthouse_star_room/s2658.o"(.text)
        "*/games/tla/src/scene/mars_lighthouse_star_room/flag_state.o"(.text)
        "*/games/tla/src/scene/mars_lighthouse_star_room/s274c.o"(.text)
        "*/games/tla/src/scene/mars_lighthouse_star_room/s2a58.o"(.text)
        "*/games/tla/src/scene/mars_lighthouse_star_room/s2ad0.o"(.text)
        "*/games/tla/src/scene/mars_lighthouse_star_room/s2b98.o"(.text)
        "*/games/tla/src/scene/mars_lighthouse_star_room/reset.o"(.text)
        "*/games/tla/src/scene/mars_lighthouse_star_room/s2d04.o"(.text)
        "*/games/tla/src/scene/mars_lighthouse_star_room/s2dc4.o"(.text)
        "*/games/tla/src/scene/mars_lighthouse_star_room/s3070.o"(.text)
        "*/games/tla/src/scene/mars_lighthouse_star_room/set_data.o"(.text)
        "*/games/tla/src/scene/mars_lighthouse_star_room/s3390.o"(.text)
        "*/games/tla/src/field/object/set_sprite_priority.o"(.text)
        "*/games/tla/src/field/field_effect/move.o"(.text)
        "*/games/tla/src/scene/mars_lighthouse_star_room/s363c.o"(.text)
        "*/games/tla/src/scene/mars_lighthouse_star_room/s3804.o"(.text)
        "*/games/tla/src/scene/mars_lighthouse_star_room/s3930.o"(.text)
        "*/games/tla/src/scene/mars_lighthouse_star_room/s3b74.o"(.text)
        "*/games/tla/src/scene/mars_lighthouse_star_room/s3c6c.o"(.text)
        "*/games/tla/src/field/field_effect/advance_motion.o"(.text)
        "*/games/tla/src/scene/mars_lighthouse_star_room/s3e04.o"(.text)
        "*/games/tla/src/scene/mars_lighthouse_star_room/s3f9c.o"(.text)
        "*/games/tla/src/scene/mars_lighthouse_star_room/s404c.o"(.text)
        "*/games/tla/src/scene/mars_lighthouse_star_room/import.o"(.text)
        "*/games/tla/src/scene/mars_lighthouse_star_room/data.o"(.data)
    }
    .bss : { "*/resource_6ab_overlay.o"(.bss) }
    /DISCARD/ : { *(.ARM.attributes) *(.comment) *(.note*) }
}
