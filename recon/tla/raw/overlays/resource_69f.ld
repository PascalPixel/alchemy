SECTIONS
{
    .text 0x2008000 :
    {
        "*/games/tla/src/scene/jupiter_room_6/entry.o"(.text)
        "*/games/tla/src/scene/jupiter_room_6/scene_tables.o"(.text)
        "*/games/tla/src/scene/jupiter_room_6/step_check.o"(.text)
        "*/games/tla/src/scene/jupiter_room_6/s00b4.o"(.text)
        "*/games/tla/src/scene/jupiter_room_6/wait.o"(.text)
        "*/games/tla/src/scene/jupiter_room_6/scene_events.o"(.text)
        "*/games/tla/src/scene/jupiter_room_6/s01e8.o"(.text)
        "*/games/tla/src/scene/jupiter_room_6/arrive.o"(.text)
        "*/games/tla/src/field/common/scene_set_arrival_flags.o"(.text)
        "*/resource_69f_overlay.o"(.text.x020082da)
        "*/games/tla/src/scene/jupiter_room_6/set_value.o"(.text)
        "*/resource_69f_overlay.o"(.text.x020082e8)
        "*/games/tla/src/scene/jupiter_room_6/lightset.o"(.text)
        "*/games/tla/src/scene/jupiter_room_6/s0428.o"(.text)
        "*/resource_69f_overlay.o"(.text.x0200847c)
        "*/games/tla/src/scene/jupiter_room_6/distance.o"(.text)
        "*/resource_69f_overlay.o"(.text.x02008694)
        "*/resource_69f_overlay.o"(.text.x02008854)
        "*/resource_69f_overlay.o"(.text.x0200892c)
        "*/resource_69f_overlay.o"(.text.x020089cc)
        "*/resource_69f_overlay.o"(.text.x02008b5c)
        "*/games/tla/src/scene/jupiter_room_6/light.o"(.text)
        "*/games/tla/src/scene/jupiter_room_6/list.o"(.text)
        "*/games/tla/src/field/common/object/set_sprite_priority.o"(.text)
        "*/resource_69f_overlay.o"(.text.x02008f22)
        "*/games/tla/src/field/common/effect/move.o"(.text)
        "*/resource_69f_overlay.o"(.text.x02008f5a)
        "*/resource_69f_overlay.o"(.text.x02008f5c)
        "*/resource_69f_overlay.o"(.text.x02009124)
        "*/resource_69f_overlay.o"(.text.x02009250)
        "*/games/tla/src/scene/jupiter_room_6/s1494.o"(.text)
        "*/resource_69f_overlay.o"(.text.x0200951c)
        "*/resource_69f_overlay.o"(.text.x0200958c)
        "*/games/tla/src/field/common/effect/advance_motion.o"(.text)
        "*/resource_69f_overlay.o"(.text.x02009722)
        "*/resource_69f_overlay.o"(.text.x02009724)
        "*/resource_69f_overlay.o"(.text.x020098bc)
        "*/resource_69f_overlay.o"(.text.x0200996c)
        "*/games/tla/src/scene/jupiter_room_6/import.o"(.text)
        "*/games/tla/src/graphics/field/cached_a.o"(.rodata)
        "*/games/tla/src/graphics/field/cached_b.o"(.rodata)
        "*/games/tla/src/graphics/field/cached_c.o"(.rodata)
        "*/games/tla/src/scene/jupiter_room_6/data.o"(.data)
    }
    .bss : { "*/resource_69f_overlay.o"(.bss) }
    /DISCARD/ : { *(.ARM.attributes) *(.comment) *(.note*) }
}
