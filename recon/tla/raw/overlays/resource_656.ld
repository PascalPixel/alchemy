SECTIONS
{
    .text 0x2008000 :
    {
        "*/games/tla/src/scene/lemurian_ship/entry.o"(.text)
        "*/games/tla/src/scene/lemurian_ship/scene_tables.o"(.text)
        "*/games/tla/src/scene/lemurian_ship/s00b8.o"(.text)
        "*/recon/tla/raw/src/scene/lemurian_ship/s021c.o"(.text)
        "*/recon/tla/raw/src/scene/lemurian_ship/s0324.o"(.text)
        "*/recon/tla/raw/src/scene/lemurian_ship/s0438.o"(.text)
        "*/games/tla/src/scene/lemurian_ship/s04f4.o"(.text)
        "*/recon/tla/raw/src/scene/lemurian_ship/s065c.o"(.text)
        "*/recon/tla/raw/src/scene/lemurian_ship/s0770.o"(.text)
        "*/recon/tla/raw/src/scene/lemurian_ship/s0870.o"(.text)
        "*/recon/tla/raw/src/scene/lemurian_ship/s0af4.o"(.text)
        "*/recon/tla/raw/src/scene/lemurian_ship/s0e2c.o"(.text)
        "*/recon/tla/raw/src/scene/lemurian_ship/s10bc.o"(.text)
        "*/games/tla/src/scene/lemurian_ship/s12b4.o"(.text)
        "*/recon/tla/raw/src/scene/lemurian_ship/s1368.o"(.text)
        "*/recon/tla/raw/src/scene/lemurian_ship/s155c.o"(.text)
        "*/recon/tla/raw/src/scene/lemurian_ship/s1650.o"(.text)
        "*/recon/tla/raw/src/scene/lemurian_ship/s1944.o"(.text)
        "*/games/tla/src/scene/lemurian_ship/s1a9c.o"(.text)
        "*/recon/tla/raw/src/scene/lemurian_ship/s1abc.o"(.text)
        "*/recon/tla/raw/src/scene/lemurian_ship/s1c38.o"(.text)
        "*/recon/tla/raw/src/scene/lemurian_ship/s1c88.o"(.text)
        "*/games/tla/src/scene/lemurian_ship/s1dc8.o"(.text)
        "*/recon/tla/raw/src/scene/lemurian_ship/s1e0c.o"(.text)
        "*/recon/tla/raw/src/scene/lemurian_ship/s23f8.o"(.text)
        "*/recon/tla/raw/src/scene/lemurian_ship/s2498.o"(.text)
        "*/recon/tla/raw/src/scene/lemurian_ship/s27e4.o"(.text)
        "*/recon/tla/raw/src/scene/lemurian_ship/s2820.o"(.text)
        "*/recon/tla/raw/src/scene/lemurian_ship/s2970.o"(.text)
        "*/recon/tla/raw/src/scene/lemurian_ship/s2b98.o"(.text)
        "*/games/tla/src/scene/lemurian_ship/import.o"(.text)
        "*/games/tla/src/scene/lemurian_ship/data.o"(.data)
    }
    /DISCARD/ : { *(.ARM.attributes) *(.comment) *(.note*) }
}
