SECTIONS
{
    .text 0x2008000 :
    {
        "*/games/tla/src/scene/taopo_swamp/entry.o"(.text)
        "*/games/tla/src/scene/taopo_swamp/scene_tables.o"(.text)
        "*/games/tla/src/scene/taopo_swamp/events_a.o"(.text)
        "*/recon/tla/raw/src/scene/taopo_swamp/s013c.o"(.text)
        "*/recon/tla/raw/src/scene/taopo_swamp/events_b.o"(.text)
        "*/recon/tla/raw/src/scene/taopo_swamp/s03c4.o"(.text)
        "*/games/tla/src/scene/taopo_swamp/events_c.o"(.text)
        "*/recon/tla/raw/src/scene/taopo_swamp/s04c8.o"(.text)
        "*/recon/tla/raw/src/scene/taopo_swamp/events_d.o"(.text)
        "*/recon/tla/raw/src/scene/taopo_swamp/s0ca0.o"(.text)
        "*/recon/tla/raw/src/scene/taopo_swamp/events_e.o"(.text)
        "*/recon/tla/raw/src/scene/taopo_swamp/s0d2c.o"(.text)
        "*/games/tla/src/scene/taopo_swamp/events_f.o"(.text)
        "*/recon/tla/raw/src/scene/taopo_swamp/events_g.o"(.text)
        "*/recon/tla/raw/src/scene/taopo_swamp/s1288.o"(.text)
        "*/games/tla/src/scene/taopo_swamp/s1304.o"(.text)
        "*/recon/tla/raw/src/scene/taopo_swamp/events_h.o"(.text)
        "*/recon/tla/raw/src/scene/taopo_swamp/s1618.o"(.text)
        "*/recon/tla/raw/src/scene/taopo_swamp/events_i.o"(.text)
        "*/recon/tla/raw/src/scene/taopo_swamp/s1774.o"(.text)
        "*/games/tla/src/scene/taopo_swamp/prepare.o"(.text)
        "*/recon/tla/raw/src/scene/taopo_swamp/s1ff0.o"(.text)
        "*/recon/tla/raw/src/scene/taopo_swamp/s2084.o"(.text)
        "*/recon/tla/raw/src/scene/taopo_swamp/events_j.o"(.text)
        "*/recon/tla/raw/src/scene/taopo_swamp/s2144.o"(.text)
        "*/games/tla/src/scene/taopo_swamp/events_k.o"(.text)
        "*/recon/tla/raw/src/scene/taopo_swamp/s23a8.o"(.text)
        "*/recon/tla/raw/src/scene/taopo_swamp/s24f8.o"(.text)
        "*/recon/tla/raw/src/scene/taopo_swamp/s2554.o"(.text)
        "*/recon/tla/raw/src/scene/taopo_swamp/s2614.o"(.text)
        "*/recon/tla/raw/src/scene/taopo_swamp/s2708.o"(.text)
        "*/games/tla/src/scene/taopo_swamp/events_l.o"(.text)
        "*/recon/tla/raw/src/scene/taopo_swamp/s2764.o"(.text)
        "*/games/tla/src/scene/taopo_swamp/events_m.o"(.text)
        "*/games/tla/src/scene/taopo_swamp/import.o"(.text)
        "*/games/tla/src/scene/taopo_swamp/data.o"(.data)
    }
    /DISCARD/ : { *(.ARM.attributes) *(.comment) *(.note*) }
}
