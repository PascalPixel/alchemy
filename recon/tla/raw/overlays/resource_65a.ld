SECTIONS
{
    .text 0x2008000 :
    {
        "*/games/tla/src/scene/madra_catacombs/entry.o"(.text)
        "*/resource_65a_overlay.o"(.text.x02008038)
        "*/resource_65a_overlay.o"(.text.x0200814c)
        "*/resource_65a_overlay.o"(.text.x02008270)
        "*/games/tla/src/scene/madra_catacombs/s0318.o"(.text)
        "*/games/tla/src/scene/madra_catacombs/scene_tables.o"(.text)
        "*/games/tla/src/scene/madra_catacombs/s0388.o"(.text)
        "*/games/tla/src/scene/madra_catacombs/events_a.o"(.text)
        "*/games/tla/src/scene/madra_catacombs/events_d.o"(.text)
        "*/games/tla/src/scene/madra_catacombs/s0874.o"(.text)
        "*/games/tla/src/scene/madra_catacombs/events_b.o"(.text)
        "*/games/tla/src/scene/madra_catacombs/s093c.o"(.text)
        "*/games/tla/src/scene/madra_catacombs/s0958.o"(.text)
        "*/games/tla/src/scene/madra_catacombs/events_f.o"(.text)
        "*/games/tla/src/scene/madra_catacombs/s0a88.o"(.text)
        "*/games/tla/src/scene/madra_catacombs/events_c.o"(.text)
        "*/games/tla/src/scene/madra_catacombs/s0d54.o"(.text)
        "*/games/tla/src/scene/madra_catacombs/prepare.o"(.text)
        "*/games/tla/src/scene/madra_catacombs/events_e.o"(.text)
        "*/games/tla/src/scene/madra_catacombs/s102c.o"(.text)
        "*/games/tla/src/scene/madra_catacombs/import.o"(.text)
        "*/games/tla/src/scene/madra_catacombs/data.o"(.data)
    }
    /DISCARD/ : { *(.ARM.attributes) *(.comment) *(.note*) }
}
