SECTIONS
{
    .text 0x2008000 :
    {
        "*/games/tla/src/scene/jupiter_lighthouse_room_4/entry.o"(.text)
        "*/games/tla/src/scene/jupiter_lighthouse_room_4/scene_tables.o"(.text)
        "*/games/tla/src/scene/jupiter_lighthouse_room_4/scene_events.o"(.text)
        "*/games/tla/src/scene/jupiter_lighthouse_room_4/s0244.o"(.text)
        "*/games/tla/src/scene/jupiter_lighthouse_room_4/s0300.o"(.text)
        "*/games/tla/src/scene/jupiter_lighthouse_room_4/s0384.o"(.text)
        "*/games/tla/src/scene/jupiter_lighthouse_room_4/s04fc.o"(.text)
        "*/games/tla/src/scene/shared/scene_set_arrival_flags.o"(.text)
        "*/games/tla/src/scene/jupiter_lighthouse_room_4/s05d8.o"(.text)
        "*/games/tla/src/scene/jupiter_lighthouse_room_4/s05e4.o"(.text)
        "*/games/tla/src/scene/jupiter_lighthouse_room_4/lightset.o"(.text)
        "*/games/tla/src/scene/jupiter_lighthouse_room_4/s0778.o"(.text)
        "*/games/tla/src/scene/jupiter_lighthouse_room_4/dist.o"(.text)
        "*/games/tla/src/scene/jupiter_lighthouse_room_4/s0990.o"(.text)
        "*/games/tla/src/scene/jupiter_lighthouse_room_4/s0b50.o"(.text)
        "*/games/tla/src/scene/jupiter_lighthouse_room_4/s0c28.o"(.text)
        "*/games/tla/src/scene/jupiter_lighthouse_room_4/s0cc8.o"(.text)
        "*/games/tla/src/scene/jupiter_lighthouse_room_4/s0e58.o"(.text)
        "*/games/tla/src/scene/jupiter_lighthouse_room_4/light.o"(.text)
        "*/games/tla/src/scene/jupiter_lighthouse_room_4/lightcue.o"(.text)
        "*/games/tla/src/field/object/set_sprite_priority.o"(.text)
        "*/games/tla/src/field/field_effect/move.o"(.text)
        "*/games/tla/src/scene/jupiter_lighthouse_room_4/s1258.o"(.text)
        "*/games/tla/src/scene/jupiter_lighthouse_room_4/s1420.o"(.text)
        "*/games/tla/src/scene/jupiter_lighthouse_room_4/s154c.o"(.text)
        "*/games/tla/src/scene/jupiter_lighthouse_room_4/s1790.o"(.text)
        "*/games/tla/src/scene/jupiter_lighthouse_room_4/s1888.o"(.text)
        "*/games/tla/src/field/field_effect/advance_motion.o"(.text)
        "*/games/tla/src/scene/jupiter_lighthouse_room_4/s1a20.o"(.text)
        "*/games/tla/src/scene/jupiter_lighthouse_room_4/s1bb8.o"(.text)
        "*/games/tla/src/scene/jupiter_lighthouse_room_4/s1c68.o"(.text)
        "*/games/tla/src/scene/jupiter_lighthouse_room_4/import.o"(.text)
        "*/games/tla/src/graphics/field/cached_a.o"(.rodata)
        "*/games/tla/src/graphics/field/cached_b.o"(.rodata)
        "*/games/tla/src/graphics/field/cached_c.o"(.rodata)
        "*/games/tla/src/scene/jupiter_lighthouse_room_4/data.o"(.data)
    }
    .bss : { "*/resource_69d_overlay.o"(.bss) }
    /DISCARD/ : { *(.ARM.attributes) *(.comment) *(.note*) }
}
